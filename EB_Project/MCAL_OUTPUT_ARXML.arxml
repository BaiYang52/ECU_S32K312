AUTOSAR XML (schema 00050)
package /Mcl
  module config Mcl: implementation-config-variant=VARIANT-POST-BUILD, post-build-variant-used=true
    CommonPublishedInformation:
      ArReleaseMajorVersion = 4
      ArReleaseMinorVersion = 7
      ArReleaseRevisionVersion = 0
      ModuleId = 255
      SwMajorVersion = 4
      SwMinorVersion = 0
      SwPatchVersion = 0
      VendorId = 43
    MclConfig
    MclGeneral: MclEnableDevErrorDetect=0, MclEnableMulticoreSupport=0, MclEnableUserModeSupport=0, MclEnableVirtualAddressMappingSupport=0, Mcl_VersionInfoApi=0
      MclCache: MclEnableCache=0
      MclDma: MclEnableDma=0
      MclEmiosCommon: MclEnableEmiosCommon=0
      MclFlexioCommon: MclEnableFlexioCommon=0
      MclLcuConfig: MclEnableLcu=0, MclEnableLcuAsyncFunc=0, MclEnableLcuSyncFunc=0
      MclTrgMux: MclEnableTrgMux=0
package /EcuM
  module config EcuM
package /Can_43_FLEXCAN
  module config Can: implementation-config-variant=VARIANT-POST-BUILD
    CanConfigSet
      CanController_0 (CanController):
        index = 0
        CanAutoBusOffRecovery = 0
        CanBusoffProcessing = INTERRUPT
        CanClockFromBus = 1
        CanControllerActivation = 1
        CanControllerBaseAddress = 0
        CanControllerEdgeFilter = 0
        CanControllerFdISO = 1
        CanControllerId = 0
        CanControllerPrExcEn = 0
        CanHwChannel = FLEXCAN_0
        CanLoopBackMode = 0
        CanRxProcessing = INTERRUPT
        CanTrippleSamplingEnable = 0
        CanTxProcessing = INTERRUPT
        CanWakeupFunctionalityAPI = 0
        CanWakeupProcessing = POLLING
        CanWakeupSupport = 0
        CanControllerDefaultBaudrate = CanController_0/CanControllerBaudrateConfig_0
        CanCpuClockRef = McuClockReferencePoint_CAN_02_CLK
        CanCpuClockRefAlternate = (unset)
        CanControllerBaudrateConfig_0 (CanControllerBaudrateConfig):
          CanAdvancedSetting = 0
          CanBaudrateTypeSuport = NORMAL_CBT
          CanBusLength = 40
          CanControllerBaudRate = 500.0
          CanControllerBaudRateConfigID = 0
          CanControllerPrescaller = 12
          CanControllerPrescallerAlternate = 10
          CanControllerPropSeg = 4
          CanControllerSeg1 = 3
          CanControllerSeg2 = 2
          CanControllerSyncJumpWidth = 2
          CanControllerSyncSeg = 1
          CanPropDelayTranceiver = 150.0
          CanTxArbitrationStartDelay = 12
        CanRxFiFo
          CanRxFiFo (CanEnhanceFiFo):
            CanEnhanceFiFoDmaEnable = 0
            CanEnhancedSchemeType = MASK_FILTER_SCHEME
            CanFiFoDmaErrorNotif = NULL_PTR
            CanFiFoOverflowNotif = NULL_PTR
            NumberMBTransferDMA = 1
      CanController_1 (CanController):
        index = 1
        CanAutoBusOffRecovery = 0
        CanBusoffProcessing = INTERRUPT
        CanClockFromBus = 1
        CanControllerActivation = 1
        CanControllerBaseAddress = 0
        CanControllerEdgeFilter = 0
        CanControllerFdISO = 1
        CanControllerId = 1
        CanControllerPrExcEn = 0
        CanHwChannel = FLEXCAN_1
        CanLoopBackMode = 0
        CanRxProcessing = INTERRUPT
        CanTrippleSamplingEnable = 0
        CanTxProcessing = INTERRUPT
        CanWakeupFunctionalityAPI = 0
        CanWakeupProcessing = POLLING
        CanWakeupSupport = 0
        CanControllerDefaultBaudrate = CanController_1/CanControllerBaudrateConfig_0
        CanCpuClockRef = McuClockReferencePoint_CAN_02_CLK
        CanCpuClockRefAlternate = (unset)
        CanControllerBaudrateConfig_0 (CanControllerBaudrateConfig):
          CanAdvancedSetting = 0
          CanBaudrateTypeSuport = NORMAL_CBT
          CanBusLength = 40
          CanControllerBaudRate = 500.0
          CanControllerBaudRateConfigID = 0
          CanControllerPrescaller = 12
          CanControllerPrescallerAlternate = 10
          CanControllerPropSeg = 4
          CanControllerSeg1 = 3
          CanControllerSeg2 = 2
          CanControllerSyncJumpWidth = 2
          CanControllerSyncSeg = 1
          CanPropDelayTranceiver = 150.0
          CanTxArbitrationStartDelay = 12
      5 x CanHardwareObject, all with CanIdType=STANDARD:
        CanHardwareObject_CAN0_FULL_Rx_0x119: index=0, CanHandleType=FULL, CanHwObjectCount=1, CanObjectId=1, CanObjectType=RECEIVE, CanControllerRef=CanController_0
          CanHwFilter_0 (CanHwFilter): index=0, CanHwFilterCode=281, CanHwFilterMask=2047
        CanHardwareObject_CAN0_BASIC_Rx: index=1, CanHandleType=BASIC, CanHwObjectCount=8, CanObjectId=0, CanObjectType=RECEIVE, CanControllerRef=CanController_0
          8 x CanHwFilter:
            CanHwFilter_0: index=0, CanHwFilterCode=298, CanHwFilterMask=2047
            CanHwFilter_1: index=1, CanHwFilterCode=512, CanHwFilterMask=2047
            CanHwFilter_2: index=2, CanHwFilterCode=513, CanHwFilterMask=2047
            CanHwFilter_3: index=3, CanHwFilterCode=514, CanHwFilterMask=2047
            CanHwFilter_4: index=4, CanHwFilterCode=515, CanHwFilterMask=2047
            CanHwFilter_5: index=5, CanHwFilterCode=528, CanHwFilterMask=2047
            CanHwFilter_6: index=6, CanHwFilterCode=592, CanHwFilterMask=2047
            CanHwFilter_7: index=7, CanHwFilterCode=1280, CanHwFilterMask=1792
        CanHardwareObject_CAN1_BASIC_Rx: index=2, CanHandleType=BASIC, CanHwObjectCount=1, CanObjectId=2, CanObjectType=RECEIVE, CanControllerRef=CanController_1
          CanHwFilter_0 (CanHwFilter): index=0, CanHwFilterCode=291, CanHwFilterMask=2047
        CanHardwareObject_CAN0_BASIC_Tx: index=3, CanHandleType=BASIC, CanHwObjectCount=1, CanObjectId=3, CanObjectType=TRANSMIT, CanControllerRef=CanController_0
        CanHardwareObject_CAN1_BASIC_Tx: index=4, CanHandleType=BASIC, CanHwObjectCount=1, CanObjectId=4, CanObjectType=TRANSMIT, CanControllerRef=CanController_1
    CanGeneral:
      CanDevErrorDetect = 0
      CanEnableDualClockMode = 0
      CanEnableSecurityEventReporting = 0
      CanEnableUserModeSupport = 0
      CanGlobalTimeSupport = 0
      CanIndex = 0
      CanMBCountExtensionSupport = 1
      CanMainFunctionModePeriod = 0.001
      CanMulticoreSupport = 0
      CanMultiplexedTransmission = 1
      CanTimeoutDuration = 1.0
      CanTimeoutMethod = OSIF_COUNTER_DUMMY
      CanVersionInfoApi = 0
      LPduHrhExtendSupport = 0
      CanSupportTTCANRef = (unset)
    CommonPublishedInformation:
      ArReleaseMajorVersion = 4
      ArReleaseMinorVersion = 7
      ArReleaseRevisionVersion = 0
      ModuleId = 80
      SwMajorVersion = 4
      SwMinorVersion = 0
      SwPatchVersion = 0
      VendorApiInfix = FLEXCAN
      VendorId = 43
package /Resource
  module config Resource
    CommonPublishedInformation:
      ArReleaseMajorVersion = 4
      ArReleaseMinorVersion = 7
      ArReleaseRevisionVersion = 0
      ModuleId = 0
      SwMajorVersion = 4
      SwMinorVersion = 0
      SwPatchVersion = 0
      VendorId = 43
    ResourceGeneral: ARM_CoreArchitecture=ARM_M_ARCH, ResourceSubderivative=s32k312_hdqfp100
package /CanIf
  module config CanIf: post-build-variant-used=true
package /Gpt
  module config Gpt: implementation-config-variant=VARIANT-POST-BUILD
    CommonPublishedInformation:
      ArReleaseMajorVersion = 4
      ArReleaseMinorVersion = 7
      ArReleaseRevisionVersion = 0
      ModuleId = 100
      SwMajorVersion = 4
      SwMinorVersion = 0
      SwPatchVersion = 0
      VendorId = 43
    GptAutosarExt: ChainModeApi=0, GptChangeNextTimeoutValueApi=0, GptEnableDualClockMode=0, GptEnableUserModeSupport=0, GptStandbyWakeupSupport=0
    GptChannelConfigSet
      GptChannelConfiguration_0 (GptChannelConfiguration):
        index = 0
        GptChannelId = 0
        GptChannelMode = GPT_CH_MODE_CONTINUOUS
        GptChannelTickFrequency = 3.0E7
        GptChannelTickValueMax = 4294967295
        GptEnableWakeup = 0
        GptHwIp = PIT
        GptNotification = GptNotification_Pit0Ch0
        GptChannelClkSrcRef = GptClockReferencePoint_0
        GptModuleRef = GptPitChannels_0
      GptPit_0 (GptPit): GptPitModule=PIT_0, PitFreezeEnable=1
        GptPitChannels_0 (GptPitChannels): index=0, ChainMode=0, GptPitChannel=CH_0
    GptConfigurationOfOptApiServices:
      GptDeinitApi = 1
      GptEnableDisableNotificationApi = 1
      GptPredefTimerFunctionalityApi = 1
      GptTimeElapsedApi = 1
      GptTimeRemainingApi = 1
      GptVersionInfoApi = 0
      GptWakeupFunctionalityApi = 0
    GptDriverConfiguration:
      GptDevErrorDetect = 0
      GptMulticoreSupport = 0
      GptPredefTimer100us32bitEnable = 0
      GptPredefTimer1usEnablingGrade = GPT_PREDEF_TIMER_1US_DISABLED
      GptReportWakeupSource = 0
      GptTimeoutDuration = 800
      GptTimeoutMethod = OSIF_COUNTER_DUMMY
      GptClockReferencePoint_0 (GptClockReferencePoint): GptClockReference=McuClockReferencePoint_AIPS_SLOW
    32 x GptHwConfiguration:
      GptHwConfiguration_{0..3}: index={0..3}, GptChannelIsUsed=0, GptIsrEnable=0, GptIsrHwId=STM_0_CH_{0..3}
      GptHwConfiguration_4: index=4, GptChannelIsUsed=0, GptIsrEnable=0, GptIsrHwId=PIT_0_CH_RTI
      GptHwConfiguration_5: index=5, GptChannelIsUsed=1, GptIsrEnable=1, GptIsrHwId=PIT_0_CH_0
      GptHwConfiguration_6: index=6, GptChannelIsUsed=1, GptIsrEnable=1, GptIsrHwId=PIT_0_CH_1
      GptHwConfiguration_7: index=7, GptChannelIsUsed=0, GptIsrEnable=0, GptIsrHwId=PIT_0_CH_2
      GptHwConfiguration_8: index=8, GptChannelIsUsed=0, GptIsrEnable=0, GptIsrHwId=PIT_0_CH_3
      GptHwConfiguration_9: index=9, GptChannelIsUsed=0, GptIsrEnable=0, GptIsrHwId=PIT_1_CH_0
      GptHwConfiguration_10: index=10, GptChannelIsUsed=0, GptIsrEnable=0, GptIsrHwId=PIT_1_CH_1
      GptHwConfiguration_11: index=11, GptChannelIsUsed=0, GptIsrEnable=0, GptIsrHwId=PIT_1_CH_2
      GptHwConfiguration_12: index=12, GptChannelIsUsed=0, GptIsrEnable=0, GptIsrHwId=PIT_1_CH_3
      GptHwConfiguration_13: index=13, GptChannelIsUsed=0, GptIsrEnable=0, GptIsrHwId=EMIOS_0_CH_0
      GptHwConfiguration_14: index=14, GptChannelIsUsed=0, GptIsrEnable=0, GptIsrHwId=EMIOS_0_CH_1
      GptHwConfiguration_15: index=15, GptChannelIsUsed=0, GptIsrEnable=0, GptIsrHwId=EMIOS_0_CH_2
      GptHwConfiguration_16: index=16, GptChannelIsUsed=0, GptIsrEnable=0, GptIsrHwId=EMIOS_0_CH_3
      GptHwConfiguration_17: index=17, GptChannelIsUsed=0, GptIsrEnable=0, GptIsrHwId=EMIOS_0_CH_4
      GptHwConfiguration_18: index=18, GptChannelIsUsed=0, GptIsrEnable=0, GptIsrHwId=EMIOS_0_CH_5
      GptHwConfiguration_19: index=19, GptChannelIsUsed=0, GptIsrEnable=0, GptIsrHwId=EMIOS_0_CH_6
      GptHwConfiguration_20: index=20, GptChannelIsUsed=0, GptIsrEnable=0, GptIsrHwId=EMIOS_0_CH_7
      GptHwConfiguration_21: index=21, GptChannelIsUsed=0, GptIsrEnable=0, GptIsrHwId=EMIOS_0_CH_8
      GptHwConfiguration_22: index=22, GptChannelIsUsed=0, GptIsrEnable=0, GptIsrHwId=EMIOS_0_CH_16
      GptHwConfiguration_23: index=23, GptChannelIsUsed=0, GptIsrEnable=0, GptIsrHwId=EMIOS_0_CH_22
      GptHwConfiguration_24: index=24, GptChannelIsUsed=0, GptIsrEnable=0, GptIsrHwId=EMIOS_0_CH_23
      GptHwConfiguration_25: index=25, GptChannelIsUsed=0, GptIsrEnable=0, GptIsrHwId=EMIOS_1_CH_0
      GptHwConfiguration_26: index=26, GptChannelIsUsed=0, GptIsrEnable=0, GptIsrHwId=EMIOS_1_CH_8
      GptHwConfiguration_27: index=27, GptChannelIsUsed=0, GptIsrEnable=0, GptIsrHwId=EMIOS_1_CH_16
      GptHwConfiguration_28: index=28, GptChannelIsUsed=0, GptIsrEnable=0, GptIsrHwId=EMIOS_1_CH_22
      GptHwConfiguration_29: index=29, GptChannelIsUsed=0, GptIsrEnable=0, GptIsrHwId=EMIOS_1_CH_23
      GptHwConfiguration_30: index=30, GptChannelIsUsed=0, GptIsrEnable=0, GptIsrHwId=RTC_0_CH_0
      GptHwConfiguration_31: index=31, GptChannelIsUsed=0, GptIsrEnable=0, GptIsrHwId=STM_0_PREDEF
    GptPredefTimerConfiguration
package /Platform
  module config Platform: implementation-config-variant=VARIANT-PRE-COMPILE
    CommonPublishedInformation:
      ArReleaseMajorVersion = 4
      ArReleaseMinorVersion = 7
      ArReleaseRevisionVersion = 0
      ModuleId = 255
      SwMajorVersion = 4
      SwMinorVersion = 0
      SwPatchVersion = 0
      VendorId = 43
    GeneralConfiguration:
      PlatformDevErrorDetect = 0
      PlatformEnableUserModeSupport = 0
      PlatformEnableVtorConfiguration = 0
      PlatformIntmConfigurable = 0
      PlatformIpAPIsAvailable = 0
      PlatformMcmConfigurable = 0
      PlatformMpuM7Configurable = 0
      PlatformMulticoreSupport = 0
    IntCtrlConfig_0 (IntCtrlConfig): PlatformVtorAddressConfig=0
      7 x PlatformIsrConfig, all with IsrEnabled=1, IsrPriority=0:
        PlatformIsrConfig_0: index=0, IsrHandler=PIT_0_ISR, IsrName=PIT0_IRQn
        PlatformIsrConfig_1: index=1, IsrHandler=CAN0_ORED_IRQHandler, IsrName=FlexCAN0_0_IRQn
        PlatformIsrConfig_2: index=2, IsrHandler=CAN0_ORED_0_31_MB_IRQHandler, IsrName=FlexCAN0_1_IRQn
        PlatformIsrConfig_3: index=3, IsrHandler=CAN0_ORED_32_63_MB_IRQHandler, IsrName=FlexCAN0_2_IRQn
        PlatformIsrConfig_4: index=4, IsrHandler=CAN1_ORED_IRQHandler, IsrName=FlexCAN1_0_IRQn
        PlatformIsrConfig_5: index=5, IsrHandler=CAN1_ORED_0_31_MB_IRQHandler, IsrName=FlexCAN1_1_IRQn
        PlatformIsrConfig_6: index=6, IsrHandler=CAN1_ORED_32_63_MB_IRQHandler, IsrName=FlexCAN1_2_IRQn
    IntmConfig
    MPU_M7_Configuration
package /Dio
  module config Dio: implementation-config-variant=VARIANT-PRE-COMPILE
    CommonPublishedInformation:
      ArReleaseMajorVersion = 4
      ArReleaseMinorVersion = 7
      ArReleaseRevisionVersion = 0
      ModuleId = 120
      SwMajorVersion = 4
      SwMinorVersion = 0
      SwPatchVersion = 0
      VendorId = 43
    DioConfig
      10 x DioPort:
        DioPort_PTA_L: index=0, DioPortId=0
          DioChannel_0 (DioChannel): index=0, DioChannelId=0, PDACSlot=VIRTUAL_WRAPPER_PDAC0
        DioPort_PTA_H: index=1, DioPortId=1
        DioPort_PTB_L: index=2, DioPortId=2
          DioChannel_PB10 (DioChannel): index=0, DioChannelId=10, PDACSlot=VIRTUAL_WRAPPER_PDAC0
        DioPort_PTB_H: index=3, DioPortId=3
        DioPort_PTC_L: index=4, DioPortId=4
        DioPort_PTC_H: index=5, DioPortId=5
        DioPort_PTD_L: index=6, DioPortId=6
        DioPort_PTD_H: index=7, DioPortId=7
        DioPort_PTE_L: index=8, DioPortId=8
        DioPort_PTE_H: index=9, DioPortId=9
    DioGeneral:
      DioDevErrorDetect = 0
      DioEnableUserModeSupport = 0
      DioFlipChannelApi = 1
      DioMaskedWritePortApi = 0
      DioMulticoreSupport = 0
      DioReadZeroForUndefinedPortPins = 0
      DioReversePortBits = 0
      DioVersionInfoApi = 0
      DioVirtWrapperSupport = 0
      SIUL2DioIPDevErrorDetect = 0
package /BaseNXP
  module config BaseNXP: implementation-config-variant=VARIANT-PRE-COMPILE
    CommonPublishedInformation:
      ArReleaseMajorVersion = 4
      ArReleaseMinorVersion = 7
      ArReleaseRevisionVersion = 0
      ModuleId = 0
      SwMajorVersion = 4
      SwMinorVersion = 0
      SwPatchVersion = 0
      VendorId = 43
    OsIfGeneral: OsIfDevErrorDetect=0, OsIfEnableUserModeSupport=0, OsIfInstanceId=0, OsIfMulticoreSupport=0, OsIfUseCustomTimer=0, OsIfUseSystemTimer=0
      OsIfOperatingSystemType
        OsIfOperatingSystemType (OsIfAutosarOsType)
package /Os
  module config Os: implementation-config-variant=VARIANT-PRE-COMPILE
package /Mcu
  module config Mcu: implementation-config-variant=VARIANT-POST-BUILD
    CommonPublishedInformation:
      ArReleaseMajorVersion = 4
      ArReleaseMinorVersion = 7
      ArReleaseRevisionVersion = 0
      ModuleId = 101
      SwMajorVersion = 4
      SwMinorVersion = 0
      SwPatchVersion = 0
      VendorApiInfix = 
      VendorId = 43
    McuCoreControlConfiguration: McuCoreBootAddressControl=0
    McuDebugConfiguration:
      McuAecResetConfigApi = 0
      McuDisableCmuApi = 1
      McuDisableDemReportErrorStatus = 1
      McuEmiosConfigureGprenApi = 0
      McuGetClockFrequencyApi = 0
      McuGetMidrStructureApi = 0
      McuGetPowerDomainApi = 0
      McuGetPowerModeStateApi = 0
      McuGetSystemStateApi = 0
      McuPmcAeConfigApi = 0
      McuSscmGetMemConfigApi = 0
      McuSscmGetStatusApi = 0
      McuSscmGetUoptApi = 0
    McuGeneralConfiguration:
      McuAlternateResetIsrUsed = 0
      McuCalloutBeforePerformReset = 0
      McuCmuErrorIsrUsed = 0
      McuDevErrorDetect = 0
      McuDisableFlashWaitStatesConfig = 1
      McuDisablePmcInit = 0
      McuDisableRamWaitStatesConfig = 1
      McuDisableRgmInit = 0
      McuEnableUserModeSupport = 0
      McuEnterLowPowerMode = 1
      McuGetRamStateApi = 0
      McuInitClock = 1
      McuNoPll = 0
      McuPerformResetApi = 0
      McuPerformResetCallout = NULL_PTR
      McuRegisterValuesOptimization = DISABLED
      McuTimeout = 50000
      McuTimeoutMethod = OSIF_COUNTER_DUMMY
      McuVersionInfoApi = 0
      McuVoltageErrorIsrUsed = 0
      McuControlledClocksConfiguration:
        McuFircUnderMcuControl = 1
        McuFxoscUnderMcuControl = 1
        McuPll0UnderMcuControl = 1
        McuPll1UnderMcuControl = 1
        McuSircUnderMcuControl = 1
        McuSxoscUnderMcuControl = 1
    McuModuleConfiguration:
      McuClockSrcFailureNotification = DISABLED
      McuCrystalFrequencyHz = 1.6E7
      McuEMAC_MII_RMII_TX_CLKFrequencyHz = 5.0E7
      McuEMAC_MII_RX_CLKFrequencyHz = 5.0E7
      McuGMAC0_MII_RGMII_RX_CLKFrequencyHz = 5.0E7
      McuGMAC0_MII_RMII_RGMII_TX_CLKFrequencyHz = 5.0E7
      McuGMAC1_MII_RGMII_RX_CLKFrequencyHz = 5.0E7
      McuGMAC1_MII_RMII_RGMII_TX_CLKFrequencyHz = 5.0E7
      McuGMAC_MII_RGMII_RX_CLKFrequencyHz = 5.0E7
      McuGMAC_MII_RMII_RGMII_TX_CLKFrequencyHz = 5.0E7
      McuLFAST_REF_EXT_CLKFrequencyHz = 2.6E7
      McuNumberOfMcuModes = 1
      McuRamSectors = 0
      McuSWG_PAD_CLKFrequencyHz = 1.6E8
      McuSlowCrystalFrequencyHz = 32768.0
      McuClockSettingConfig_0 (McuClockSettingConfig): index=0, McuClockSettingId=0
        McuCgm0SettingConfig: McuPCFSStepDuration=48, McuPCFSTimePerStep=1
          McuCgm0ClockMux0:
            McuClkMux0Div0Trigger = COMMON_TRIGGER_DIVIDER_UPDATE
            McuClkMux0Div0_Divisor = 0
            McuClkMux0Div0_En = 1
            McuClkMux0Div1Trigger = COMMON_TRIGGER_DIVIDER_UPDATE
            McuClkMux0Div1_Divisor = 1
            McuClkMux0Div1_En = 1
            McuClkMux0Div2Trigger = COMMON_TRIGGER_DIVIDER_UPDATE
            McuClkMux0Div2_Divisor = 3
            McuClkMux0Div2_En = 1
            McuClkMux0Div3Trigger = COMMON_TRIGGER_DIVIDER_UPDATE
            McuClkMux0Div3_Divisor = 1
            McuClkMux0Div3_En = 1
            McuClkMux0Div4Trigger = COMMON_TRIGGER_DIVIDER_UPDATE
            McuClkMux0Div4_Divisor = 3
            McuClkMux0Div4_En = 1
            McuClkMux0Div5Trigger = COMMON_TRIGGER_DIVIDER_UPDATE
            McuClkMux0Div5_Divisor = 3
            McuClkMux0Div5_En = 0
            McuClkMux0Div6Trigger = COMMON_TRIGGER_DIVIDER_UPDATE
            McuClkMux0Div6_Divisor = 0
            McuClkMux0Div6_En = 0
            McuClkMux0Div7Trigger = COMMON_TRIGGER_DIVIDER_UPDATE
            McuClkMux0Div7_Divisor = 0
            McuClkMux0Div7_En = 0
            McuClkMux0_Source = PLL_PHI0_CLK
            McuClockMux0Divider0_Frequency = 1.2E8
            McuClockMux0Divider1_Frequency = 6.0E7
            McuClockMux0Divider2_Frequency = 3.0E7
            McuClockMux0Divider3_Frequency = 6.0E7
            McuClockMux0Divider4_Frequency = 3.0E7
            McuClockMux0Divider{5..7}_Frequency = 0.0
            McuClockMuxUnderMcuControl = 1
          McuCgm0ClockMux1: McuClkMux1Div0_Divisor=0, McuClkMux1Div0_En=1, McuClkMux1_Source=AIPS_PLAT_CLK, McuClockMux1Divider0_Frequency=6.0E7, McuClockMuxUnderMcuControl=1
          McuCgm0ClockMux10: McuClkMux10Div0_Divisor=0, McuClkMux10Div0_En=0, McuClkMux10_Source=FIRC_CLK, McuClockMux10Divider0_Frequency=0.0, McuClockMuxUnderMcuControl=1
          McuCgm0ClockMux{11..13}: McuClkMux{11..13}Div0_Divisor=0, McuClkMux{11..13}Div0_En=1, McuClkMux{11..13}_Source=FIRC_CLK, McuClockMux{11..13}Divider0_Frequency=4.8E7, McuClockMuxUnderMcuControl=1
          McuCgm0ClockMux14: McuClkMux14Div0_Divisor=0, McuClkMux14Div0_En=0, McuClkMux14_Source=FIRC_CLK, McuClockMux14Divider0_Frequency=0.0, McuClockMuxUnderMcuControl=1
          McuCgm0ClockMux15: McuClkMux15Div0_Divisor=2, McuClkMux15Div0_En=1, McuClkMux15_Source=FIRC_CLK, McuClockMux15Divider0_Frequency=1.6E7, McuClockMuxUnderMcuControl=1
          McuCgm0ClockMux16: McuClkMux16Div0_Divisor=2, McuClkMux16Div0_En=0, McuClkMux16_Source=FIRC_CLK, McuClockMux16Divider0_Frequency=0.0, McuClockMuxUnderMcuControl=1
          McuCgm0ClockMux17: McuClkMux17Div0_Divisor=2, McuClkMux17Div0_En=0, McuClkMux17_Source=FIRC_CLK, McuClockMux17Divider0_Frequency=0.0, McuClockMuxUnderMcuControl=1
          McuCgm0ClockMux18: McuClkMux18Div0_Divisor=1, McuClkMux18Div0_En=0, McuClkMux18_Source=FIRC_CLK, McuClockMux18Divider0_Frequency=0.0, McuClockMuxUnderMcuControl=1
          McuCgm0ClockMux19: McuClkMux19Div0_Divisor=2, McuClkMux19Div0_En=0, McuClkMux19_Source=FIRC_CLK, McuClockMux19Divider0_Frequency=0.0, McuClockMuxUnderMcuControl=1
          McuCgm0ClockMux2: McuClkMux2Div0_Divisor=0, McuClkMux2Div0_En=0, McuClkMux2_Source=FIRC_CLK, McuClockMux2Divider0_Frequency=0.0, McuClockMuxUnderMcuControl=1
          McuCgm0ClockMux3: McuClkMux3Div0_Divisor=0, McuClkMux3Div0_En=1, McuClkMux3_Source=AIPS_PLAT_CLK, McuClockMux3Divider0_Frequency=6.0E7, McuClockMuxUnderMcuControl=1
          McuCgm0ClockMux4: McuClkMux4Div0_Divisor=0, McuClkMux4Div0_En=0, McuClkMux4_Source=FIRC_CLK, McuClockMux4Divider0_Frequency=0.0, McuClockMuxUnderMcuControl=1
          McuCgm0ClockMux5: McuClkMux5Div0_Divisor=1, McuClkMux5Div0_En=1, McuClkMux5_Source=FIRC_CLK, McuClockMux5Divider0_Frequency=2.4E7, McuClockMuxUnderMcuControl=1
          McuCgm0ClockMux6: McuClkMux6Div0_Divisor=1, McuClkMux6Div0_En=1, McuClkMux6_Source=FIRC_CLK, McuClockMux6Divider0_Frequency=2.4E7, McuClockMuxUnderMcuControl=1
          McuCgm0ClockMux{7..9}: McuClkMux{7..9}Div0_Divisor=0, McuClkMux{7..9}Div0_En=0, McuClkMux{7..9}_Source=FIRC_CLK, McuClockMux{7..9}Divider0_Frequency=0.0, McuClockMuxUnderMcuControl=1
          McuCgm0PcfsConfig_0 (McuCgm0PcfsConfig): index=0, McuClockPcfsUnderMcuControl=0, McuPCFS_MaxAllowableDynamicIDD=0.0, McuPCFS_Name=PCFS_8, McuPCFS_SourceFrequency=1.2E8
        3 x McuClkMonitor, all with McuClkMonitorEn=0, McuClockMonitorUnderMcuControl=1, McuFHHAsyncEventEn=0, McuFHHInterruptEn=0, McuFLLAsyncEventEn=0, McuFLLInterruptEn=0:
          McuClkMonitor_0: index=0, McuCmuName=CMU_FC_0_FXOSC_CLK
          McuClkMonitor_1: index=1, McuCmuName=CMU_FC_3_CORE_CLK
          McuClkMonitor_2: index=2, McuCmuName=CMU_FC_4_AIPS_PLAT_CLK
        7 x McuClockReferencePoint:
          McuClockReferencePoint_CORE_CLK: index=0, McuClockFrequencySelect=CORE_CLK, McuClockReferencePointFrequency=1.2E8
          McuClockReferencePoint_FIRC_CLK: index=1, McuClockFrequencySelect=FIRC_CLK, McuClockReferencePointFrequency=4.8E7
          McuClockReferencePoint_SIRC_CLK: index=2, McuClockFrequencySelect=SIRC_CLK, McuClockReferencePointFrequency=32000.0
          McuClockReferencePoint_AIPS_SLOW: index=3, McuClockFrequencySelect=AIPS_SLOW_CLK, McuClockReferencePointFrequency=3.0E7
          McuClockReferencePoint_AIPS_PLAT_CLK: index=4, McuClockFrequencySelect=AIPS_PLAT_CLK, McuClockReferencePointFrequency=6.0E7
          McuClockReferencePoint_STM0_CLK: index=5, McuClockFrequencySelect=STM0_CLK, McuClockReferencePointFrequency=6.0E7
          McuClockReferencePoint_CAN_02_CLK: index=6, McuClockFrequencySelect=FLEXCAN_PE_CLK0_2, McuClockReferencePointFrequency=6.0E7
        McuFIRC: McuFIRC_Frequency=4.8E7, McuFircDivSel=Div_by_1, McuFircStandbyEnable=0, McuFircUnderMcuControl=1
        McuFXOSC:
          McuFXOSC_Frequency = 1.6E7
          McuFxoscBypass = 0
          McuFxoscCounter = 49
          McuFxoscMainComparator = 1
          McuFxoscOverdriveProtection = 12
          McuFxoscPowerDownCtr = 1
          McuFxoscUnderMcuControl = 1
        McuPll_0: McuPLLEnabled=1, McuPLLUnderMcuControl=1, McuPllClockSelection=FXOSC_CLK
          McuPll_Configuration:
            McuPllDvMfi = 120
            McuPllDvOdiv2 = 4
            McuPllDvRdiv = 2
            McuPllFdFmod = 0.0
            McuPllFdMdp = 0.0
            McuPllFdMfn = 0
            McuPllFdSdm2 = 0
            McuPllFdSdm3 = 0
            McuPllFdSdmen = 0
            McuPllFmSpreadctl = Center_Spread
            McuPllFmSscgbyp = 1
            McuPllFmStepNo = 1
            McuPllFmStepSize = 0
            McuPllOdiv0_Div = 1
            McuPllOdiv0_En = 1
            McuPllOdiv1_Div = 4
            McuPllOdiv1_En = 1
          McuPll_Parameter: PLL_PHI0_Frequency=1.2E8, PLL_PHI1_Frequency=4.8E7, PLL_VCO_Frequency=9.6E8
        McuPll_1: McuPLLEnabled=0, McuPLLUnderMcuControl=1
          McuPll_Configuration:
            McuPllDvMfi = 120
            McuPllDvOdiv2 = 1
            McuPllDvRdiv = 2
            McuPllOdiv0_Div = 3
            McuPllOdiv0_En = 0
            McuPllOdiv1_Div = 3
            McuPllOdiv1_En = 0
            McuPllOdiv2_Div = 3
            McuPllOdiv2_En = 0
          McuPll_Parameter: PLL_PHI0_Frequency=0.0, PLL_PHI1_Frequency=0.0, PLL_PHI2_Frequency=0.0, PLL_VCO_Frequency=0.0
        McuRtcClockSelect: McuClockMuxUnderMcuControl=1, McuRtc_Frequency=4.8E7, McuRtc_Source=FIRC_CLK
        McuSIRC: McuSIRC_Frequency=32000.0, McuSircStandbyEnable=0, McuSircUnderMcuControl=1
        McuSXOSC: McuSXOSC_Frequency=0.0, McuSxoscCounter=125, McuSxoscPowerDownCtr=0, McuSxoscUnderMcuControl=0
      McuModeSettingConf_0 (McuModeSettingConf): index=0, McuCoreLockStepEnable=0, McuEnableSleepOnExit=0, McuMainCoreSelect=CM7_0, McuMode=0, McuPowerMode=RUN
        McuDcmGprConfiguration:
          McuBootBaseAddress = 0
          McuDCM_SCAN_BYP_STDBY_EXTControl = 0
          McuDcmGprUnderMcuControl = 0
          McuFIRC_TRIM_BYP_STDBY_EXTControl = 0
          McuGlobalPadkeepingEnable = 0
          McuPMC_TRIM_RGM_DCF_BYP_STDBY_EXTControl = 0
          McuSIRC_TRIM_BYP_STDBY_EXTControl = 0
        McuPartitionConfiguration
          McuPartition0Config:
            McuPartitionClockEnable = 1
            McuPartitionPowerUnderMcuControl = 1
            McuPartitionUnderMcuControl = 1
            McuPrtnCofb0UnderMcuControl = 1
            McuPrtnCofb1UnderMcuControl = 1
            McuCore0Configuration: McuCoreBootAddress=0, McuCoreBootAddressLinkerSym=, McuCoreClockEnable=0, McuCoreUnderMcuControl=1
            McuCore1Configuration: McuCoreBootAddress=0, McuCoreBootAddressLinkerSym=, McuCoreClockEnable=0, McuCoreUnderMcuControl=1
            McuCore3Configuration: McuCoreBootAddress=0, McuCoreBootAddressLinkerSym=, McuCoreClockEnable=0, McuCoreUnderMcuControl=1
            McuCore4Configuration: McuCoreBootAddress=0, McuCoreBootAddressLinkerSym=, McuCoreClockEnable=0, McuCoreUnderMcuControl=1
          McuPartition1Config:
            McuPartitionClockEnable = 1
            McuPartitionPowerUnderMcuControl = 1
            McuPartitionUnderMcuControl = 1
            McuPrtnCofb{0..3}UnderMcuControl = 1
          McuPartition2Config:
            McuPartitionClockEnable = 1
            McuPartitionPowerUnderMcuControl = 1
            McuPartitionUnderMcuControl = 1
            McuPrtnCofb{0..2}UnderMcuControl = 1
          McuPartition3Config:
            McuPartitionClockEnable = 1
            McuPartitionPowerUnderMcuControl = 1
            McuPartitionUnderMcuControl = 1
            McuPrtnCofb{0..2}UnderMcuControl = 1
          65 x McuPeripheral:
            McuPeripheral_0: index=0, McuModeEntrySlot=PRTN0_COFB1_REQ32, McuPeripheralClockEnable=0, McuPeripheralName=TRGMUX
            McuPeripheral_1: index=1, McuModeEntrySlot=PRTN0_COFB1_REQ33, McuPeripheralClockEnable=0, McuPeripheralName=BCTU
            McuPeripheral_2: index=2, McuModeEntrySlot=PRTN0_COFB1_REQ34, McuPeripheralClockEnable=0, McuPeripheralName=EMIOS_0
            McuPeripheral_3: index=3, McuModeEntrySlot=PRTN0_COFB1_REQ35, McuPeripheralClockEnable=0, McuPeripheralName=EMIOS_1
            McuPeripheral_4: index=4, McuModeEntrySlot=PRTN0_COFB1_REQ38, McuPeripheralClockEnable=0, McuPeripheralName=LCU_0
            McuPeripheral_5: index=5, McuModeEntrySlot=PRTN0_COFB1_REQ39, McuPeripheralClockEnable=0, McuPeripheralName=LCU_1
            McuPeripheral_6: index=6, McuModeEntrySlot=PRTN0_COFB1_REQ40, McuPeripheralClockEnable=0, McuPeripheralName=ADC_0
            McuPeripheral_7: index=7, McuModeEntrySlot=PRTN0_COFB1_REQ41, McuPeripheralClockEnable=0, McuPeripheralName=ADC_1
            McuPeripheral_8: index=8, McuModeEntrySlot=PRTN0_COFB1_REQ44, McuPeripheralClockEnable=1, McuPeripheralName=PIT_0
            McuPeripheral_9: index=9, McuModeEntrySlot=PRTN0_COFB1_REQ45, McuPeripheralClockEnable=0, McuPeripheralName=PIT_1
            McuPeripheral_10: index=10, McuModeEntrySlot=PRTN1_COFB0_REQ3, McuPeripheralClockEnable=0, McuPeripheralName=EDMA
            McuPeripheral_11: index=11, McuModeEntrySlot=PRTN1_COFB0_REQ4, McuPeripheralClockEnable=0, McuPeripheralName=EDMA_TCD_0
            McuPeripheral_12: index=12, McuModeEntrySlot=PRTN1_COFB0_REQ5, McuPeripheralClockEnable=0, McuPeripheralName=EDMA_TCD_1
            McuPeripheral_13: index=13, McuModeEntrySlot=PRTN1_COFB0_REQ6, McuPeripheralClockEnable=0, McuPeripheralName=EDMA_TCD_2
            McuPeripheral_14: index=14, McuModeEntrySlot=PRTN1_COFB0_REQ7, McuPeripheralClockEnable=0, McuPeripheralName=EDMA_TCD_3
            McuPeripheral_15: index=15, McuModeEntrySlot=PRTN1_COFB0_REQ8, McuPeripheralClockEnable=0, McuPeripheralName=EDMA_TCD_4
            McuPeripheral_16: index=16, McuModeEntrySlot=PRTN1_COFB0_REQ9, McuPeripheralClockEnable=0, McuPeripheralName=EDMA_TCD_5
            McuPeripheral_17: index=17, McuModeEntrySlot=PRTN1_COFB0_REQ10, McuPeripheralClockEnable=0, McuPeripheralName=EDMA_TCD_6
            McuPeripheral_18: index=18, McuModeEntrySlot=PRTN1_COFB0_REQ11, McuPeripheralClockEnable=0, McuPeripheralName=EDMA_TCD_7
            McuPeripheral_19: index=19, McuModeEntrySlot=PRTN1_COFB0_REQ12, McuPeripheralClockEnable=0, McuPeripheralName=EDMA_TCD_8
            McuPeripheral_20: index=20, McuModeEntrySlot=PRTN1_COFB0_REQ13, McuPeripheralClockEnable=0, McuPeripheralName=EDMA_TCD_9
            McuPeripheral_21: index=21, McuModeEntrySlot=PRTN1_COFB0_REQ14, McuPeripheralClockEnable=0, McuPeripheralName=EDMA_TCD_10
            McuPeripheral_22: index=22, McuModeEntrySlot=PRTN1_COFB0_REQ15, McuPeripheralClockEnable=0, McuPeripheralName=EDMA_TCD_11
            McuPeripheral_23: index=23, McuModeEntrySlot=PRTN1_COFB0_REQ21, McuPeripheralClockEnable=1, McuPeripheralName=SDA_AP
            McuPeripheral_24: index=24, McuModeEntrySlot=PRTN1_COFB0_REQ22, McuPeripheralClockEnable=0, McuPeripheralName=EIM_0
            McuPeripheral_25: index=25, McuModeEntrySlot=PRTN1_COFB0_REQ23, McuPeripheralClockEnable=0, McuPeripheralName=ERM_0
            McuPeripheral_26: index=26, McuModeEntrySlot=PRTN1_COFB0_REQ24, McuPeripheralClockEnable=1, McuPeripheralName=MSCM
            McuPeripheral_27: index=27, McuModeEntrySlot=PRTN1_COFB0_REQ28, McuPeripheralClockEnable=1, McuPeripheralName=SWT_0
            McuPeripheral_28: index=28, McuModeEntrySlot=PRTN1_COFB0_REQ29, McuPeripheralClockEnable=0, McuPeripheralName=STM_0
            McuPeripheral_29: index=29, McuModeEntrySlot=PRTN1_COFB0_REQ31, McuPeripheralClockEnable=0, McuPeripheralName=INTM
            McuPeripheral_30: index=30, McuModeEntrySlot=PRTN1_COFB1_REQ32, McuPeripheralClockEnable=0, McuPeripheralName=DMAMUX_0
            McuPeripheral_31: index=31, McuModeEntrySlot=PRTN1_COFB1_REQ33, McuPeripheralClockEnable=0, McuPeripheralName=DMAMUX_1
            McuPeripheral_32: index=32, McuModeEntrySlot=PRTN1_COFB1_REQ34, McuPeripheralClockEnable=1, McuPeripheralName=RTC
            McuPeripheral_33: index=33, McuModeEntrySlot=PRTN1_COFB1_REQ42, McuPeripheralClockEnable=1, McuPeripheralName=SIUL2_VIRTWRAPPER_PDAC3
            McuPeripheral_34: index=34, McuModeEntrySlot=PRTN1_COFB1_REQ45, McuPeripheralClockEnable=1, McuPeripheralName=WKPU
            McuPeripheral_35: index=35, McuModeEntrySlot=PRTN1_COFB1_REQ47, McuPeripheralClockEnable=0, McuPeripheralName=CMUs
            McuPeripheral_36: index=36, McuModeEntrySlot=PRTN1_COFB1_REQ49, McuPeripheralClockEnable=1, McuPeripheralName=TSPC
            McuPeripheral_37: index=37, McuModeEntrySlot=PRTN1_COFB1_REQ53, McuPeripheralClockEnable=1, McuPeripheralName=FXOSC
            McuPeripheral_38: index=38, McuModeEntrySlot=PRTN1_COFB1_REQ56, McuPeripheralClockEnable=0, McuPeripheralName=PLL
            McuPeripheral_39: index=39, McuModeEntrySlot=PRTN1_COFB2_REQ65, McuPeripheralClockEnable=1, McuPeripheralName=FlexCAN_0
            McuPeripheral_40: index=40, McuModeEntrySlot=PRTN1_COFB2_REQ66, McuPeripheralClockEnable=1, McuPeripheralName=FlexCAN_1
            McuPeripheral_41: index=41, McuModeEntrySlot=PRTN1_COFB2_REQ67, McuPeripheralClockEnable=0, McuPeripheralName=FlexCAN_2
            McuPeripheral_42: index=42, McuModeEntrySlot=PRTN1_COFB2_REQ68, McuPeripheralClockEnable=0, McuPeripheralName=FlexCAN_3
            McuPeripheral_43: index=43, McuModeEntrySlot=PRTN1_COFB2_REQ69, McuPeripheralClockEnable=0, McuPeripheralName=FlexCAN_4
            McuPeripheral_44: index=44, McuModeEntrySlot=PRTN1_COFB2_REQ70, McuPeripheralClockEnable=0, McuPeripheralName=FlexCAN_5
            McuPeripheral_45: index=45, McuModeEntrySlot=PRTN1_COFB2_REQ73, McuPeripheralClockEnable=0, McuPeripheralName=FlexIO
            McuPeripheral_46: index=46, McuModeEntrySlot=PRTN1_COFB2_REQ74, McuPeripheralClockEnable=0, McuPeripheralName=LPUART_0
            McuPeripheral_47: index=47, McuModeEntrySlot=PRTN1_COFB2_REQ75, McuPeripheralClockEnable=0, McuPeripheralName=LPUART_1
            McuPeripheral_48: index=48, McuModeEntrySlot=PRTN1_COFB2_REQ76, McuPeripheralClockEnable=0, McuPeripheralName=LPUART_2
            McuPeripheral_49: index=49, McuModeEntrySlot=PRTN1_COFB2_REQ77, McuPeripheralClockEnable=0, McuPeripheralName=LPUART_3
            McuPeripheral_50: index=50, McuModeEntrySlot=PRTN1_COFB2_REQ78, McuPeripheralClockEnable=0, McuPeripheralName=LPUART_4
            McuPeripheral_51: index=51, McuModeEntrySlot=PRTN1_COFB2_REQ79, McuPeripheralClockEnable=0, McuPeripheralName=LPUART_5
            McuPeripheral_52: index=52, McuModeEntrySlot=PRTN1_COFB2_REQ80, McuPeripheralClockEnable=0, McuPeripheralName=LPUART_6
            McuPeripheral_53: index=53, McuModeEntrySlot=PRTN1_COFB2_REQ81, McuPeripheralClockEnable=0, McuPeripheralName=LPUART_7
            McuPeripheral_54: index=54, McuModeEntrySlot=PRTN1_COFB2_REQ84, McuPeripheralClockEnable=0, McuPeripheralName=LPI2C_0
            McuPeripheral_55: index=55, McuModeEntrySlot=PRTN1_COFB2_REQ85, McuPeripheralClockEnable=0, McuPeripheralName=LPI2C_1
            McuPeripheral_56: index=56, McuModeEntrySlot=PRTN1_COFB2_REQ86, McuPeripheralClockEnable=0, McuPeripheralName=LPSPI_0
            McuPeripheral_57: index=57, McuModeEntrySlot=PRTN1_COFB2_REQ87, McuPeripheralClockEnable=0, McuPeripheralName=LPSPI_1
            McuPeripheral_58: index=58, McuModeEntrySlot=PRTN1_COFB2_REQ88, McuPeripheralClockEnable=0, McuPeripheralName=LPSPI_2
            McuPeripheral_59: index=59, McuModeEntrySlot=PRTN1_COFB2_REQ89, McuPeripheralClockEnable=0, McuPeripheralName=LPSPI_3
            McuPeripheral_60: index=60, McuModeEntrySlot=PRTN1_COFB2_REQ92, McuPeripheralClockEnable=1, McuPeripheralName=LPCMP_0
            McuPeripheral_61: index=61, McuModeEntrySlot=PRTN1_COFB2_REQ93, McuPeripheralClockEnable=1, McuPeripheralName=LPCMP_1
            McuPeripheral_62: index=62, McuModeEntrySlot=PRTN1_COFB2_REQ95, McuPeripheralClockEnable=0, McuPeripheralName=TEMPSENSE
            McuPeripheral_63: index=63, McuModeEntrySlot=PRTN1_COFB3_REQ96, McuPeripheralClockEnable=0, McuPeripheralName=CRC
            McuPeripheral_64: index=64, McuModeEntrySlot=PRTN1_COFB3_REQ104, McuPeripheralClockEnable=1, McuPeripheralName=STCU_2
      McuPowerControl
        McuDCM_GPR_Config: McuPMICPGOODBypasses=0
        McuPMC_AE_Config:
          McuHighVoltageDetectInterruptOnVDDEnable = 0
          McuHighVoltageDetectInterruptOnVDDINTAndVDD15Enable = 0
          McuLinphySupplyEnable = 1
          McuLinphySupplySelect = VSUP_PIN
          McuLowVoltageDetectInterruptsOnVDDCEnable = 0
          McuLowVoltageDetectInterruptsOnVLSEnable = 0
          McuLvdVlsSelect = LVD_6_5V
          McuVDDCEnable = 0
          McuVddVoltageLevelSelect = VDD_3_3V
        McuPMC_Config:
          McuFASTRECEnable = 0
          McuHVDIEEnable = 0
          McuLMAUTOENEnable = 0
          McuLMBCTLENEnable = 1
          McuLMENEnable = 1
          McuLMSMPSENEnable = 1
          McuLPM25ENEnable = 0
          McuLVDIEEnable = 0
          McuLVRBLPENEnable = 0
          McuSMPSConfSelect = 15
          McuSMPSDitherConf = 0
          McuSMPSDitherEn = 0
          McuSMPSLPM15EN = 0
          McuSMPSOnTime3V = 0
          McuSMPSOnTime5V = 0
          McuSMPSPeriod = 0
      McuResetConfig: McuDestResetEscThreshold=0, McuEnableResetEntryTimer=0, McuFuncResetEscThreshold=15, McuResetEntryTimerValue=0, McuResetType=FunctionalReset
        McuResetGeneratorConfiguration:
          McuCanPhyReset = 0
          McuCxpiReset = 0
          McuDpgaReset = 0
          McuGduReset = 0
          McuHviReset = 0
          McuLinPhyHpReset = 0
          McuLinPhyLpReset = 0
          McuRegsOtpReset = 1
          McuTempsensorReset = 0
        McuResetSourcesConfig
          McuDEBUG_FUNC_ResetSource: McuDisableReset=0
          McuFCCU_RST_ResetSource: McuDisableReset=0
          McuJTAG_RST_ResetSource: McuDisableReset=0
          McuSWT{0..3}_RST_ResetSource: McuDisableReset=0
    McuPublishedInformation
      32 x McuResetReasonConf:
        MCU_POWER_ON_RESET: index=0, McuResetReason=0
        MCU_FCCU_FTR_RESET: index=1, McuResetReason=1
        MCU_STCU_URF_RESET: index=2, McuResetReason=2
        MCU_MC_RGM_FRE_RESET: index=3, McuResetReason=3
        MCU_FXOSC_FAIL_RESET: index=4, McuResetReason=4
        MCU_PLL_LOL_RESET: index=5, McuResetReason=5
        MCU_CORE_CLK_FAIL_RESET: index=6, McuResetReason=6
        MCU_AIPS_PLAT_CLK_FAIL_RESET: index=7, McuResetReason=7
        MCU_HSE_CLK_FAIL_RESET: index=8, McuResetReason=8
        MCU_SYS_DIV_FAIL_RESET: index=9, McuResetReason=9
        MCU_CM7_CORE_CLK_FAIL_RESET: index=10, McuResetReason=10
        MCU_HSE_TMPR_RST_RESET: index=11, McuResetReason=11
        MCU_HSE_SNVS_RST_RESET: index=12, McuResetReason=12
        MCU_SW_DEST_RESET: index=13, McuResetReason=13
        MCU_DEBUG_DEST_RESET: index=14, McuResetReason=14
        MCU_F_EXR_RESET: index=15, McuResetReason=15
        MCU_FCCU_RST_RESET: index=16, McuResetReason=16
        MCU_ST_DONE_RESET: index=17, McuResetReason=17
        MCU_SWT0_RST_RESET: index=18, McuResetReason=18
        MCU_SWT1_RST_RESET: index=19, McuResetReason=19
        MCU_SWT2_RST_RESET: index=20, McuResetReason=20
        MCU_JTAG_RST_RESET: index=21, McuResetReason=21
        MCU_SWT3_RST_RESET: index=22, McuResetReason=22
        MCU_PLL_AUX_RESET: index=23, McuResetReason=23
        MCU_HSE_SWT_RST_RESET: index=24, McuResetReason=24
        MCU_HSE_BOOT_RST_RESET: index=25, McuResetReason=25
        MCU_SW_FUNC_RESET: index=26, McuResetReason=26
        MCU_DEBUG_FUNC_RESET: index=27, McuResetReason=27
        MCU_WAKEUP_REASON: index=28, McuResetReason=28
        MCU_NO_RESET_REASON: index=29, McuResetReason=29
        MCU_MULTIPLE_RESET_REASON: index=30, McuResetReason=30
        MCU_RESET_UNDEFINED: index=31, McuResetReason=31
package /Port
  module config Port: implementation-config-variant=VARIANT-POST-BUILD
    CommonPublishedInformation:
      ArReleaseMajorVersion = 4
      ArReleaseMinorVersion = 7
      ArReleaseRevisionVersion = 0
      ModuleId = 124
      SwMajorVersion = 4
      SwMinorVersion = 0
      SwPatchVersion = 0
      VendorId = 43
    PortConfigSet
      NotUsedPortPin: PortPinDirection=PORT_PIN_IN, PortPinLevelValue=PORT_PIN_LEVEL_LOW, PortPinPue=0, PortPinPus=0
      PortContainer_0 (PortContainer): PortNumberOfPortPins=5
        5 x PortPin, all with ImcrPdacSlot=VIRTUAL_WRAPPER_PDAC0, MscrPdacSlot=VIRTUAL_WRAPPER_PDAC0, OBEGroupSelect=NO_OBE_GROUP, PortPinDirectionChangeable=1, PortPinDse=0, PortPinIfe=0, PortPinInitialMode=PORT_GPIO_MODE, PortPinInvertControl=0, PortPinLevelValue=PORT_PIN_LEVEL_LOW, PortPinModeChangeable=1, PortPinPke=0, PortPinPue=0, PortPinPus=0, PortPinSafeMode=0, PortPinSiul2Instance=SIUL2_0, PortPinSlewRate=SLEW_RATE_NOT_AVAILABLE, PortPinWithReadBack=0:
          PortPin_B10: index=0, PortPinDirection=PORT_PIN_OUT, PortPinId=1, PortPinMode=GPIO, PortPinPcr=42
          PortPin_A7_CANTX: index=1, PortPinDirection=PORT_PIN_OUT, PortPinId=2, PortPinMode=CAN0_CAN0_TX_OUT, PortPinPcr=7
          PortPin_A6_CANRX: index=2, PortPinDirection=PORT_PIN_IN, PortPinId=3, PortPinMode=CAN0_CAN0_RX_IN, PortPinPcr=6
          PortPin_C8_CANTX: index=3, PortPinDirection=PORT_PIN_OUT, PortPinId=4, PortPinMode=CAN1_CAN1_TX_OUT, PortPinPcr=72
          PortPin_C9_CANRX: index=4, PortPinDirection=PORT_PIN_IN, PortPinId=5, PortPinMode=CAN1_CAN1_RX_IN, PortPinPcr=73
      4 x UnTouchedPortPin, all with PortPinSiul2Instance=SIUL2_0:
        JTAGC_TCK: PortPinPcr=68
        JTAGC_TDI: PortPinPcr=4
        JTAGC_TDO: PortPinPcr=10
        JTAGC_TMS: PortPinPcr=69
    PortGeneral:
      PortCodeSizeOptimization = 0
      PortDevErrorDetect = 0
      PortEnableUserModeSupport = 0
      PortMulticoreSupport = 0
      PortResetPinModeApi = 0
      PortSetAsUnusedPinApi = 0
      PortSetPinDirectionApi = 1
      PortSetPinModeApi = 1
      PortSetPinModeDoesNotTouchGpioLevel = 0
      PortTspcSupport = 0
      PortVersionInfoApi = 1
      SIUL2PortIPDevErrorDetect = 0
      SignalInversionConfigEnable = 0
      VirtWrapperSupport = 0
