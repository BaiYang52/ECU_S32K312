AUTOSAR XML (schema 00048)
package /S32K3XX
  module config BswM
    BswMConfig
      BswMArbitration
      BswMModeControl
    BswMGeneral:
      BswMCloneVariableSupport = false
      BswMCanSMEnabled = false
      BswMComMEnabled = false
      BswMDcmEnabled = false
      BswMDevErrorDetect = false
      BswMEcuMEnabled = false
      BswMEthIfEnabled = false
      BswMEthSMEnabled = false
      BswMFrSMEnabled = false
      BswMGenericRequestEnabled = false
      BswMJ1939DcmEnabled = false
      BswMJ1939NmEnabled = false
      BswMLinSMEnabled = false
      BswMLinTPEnabled = false
      BswMNmEnabled = false
      BswMNvMEnabled = false
      BswMSdControlEnabled = false
      BswMSdEnabled = false
      BswMVersionInfoApi = false
