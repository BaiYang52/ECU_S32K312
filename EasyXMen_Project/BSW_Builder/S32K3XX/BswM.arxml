AUTOSAR XML (schema 00048)
package /S32K3XX
  module config BswM
    BswMConfig
      BswMArbitration
        BswMEventRequestPort_0 (BswMEventRequestPort): BswMEventRequestProcessing=BSWM_IMMEDIATE
          BswMEventRequestSource
            BswMComMInitiateReset
        BswMLogicalExpression_0 (BswMLogicalExpression): BswMArgumentRef=BswMModeCondition_0
        BswMModeRequestPort_0 (BswMModeRequestPort): BswMRequestProcessing=BSWM_IMMEDIATE
          BswMModeRequestSource
            BswMEcuMIndication
        BswMModeRequestPort_1 (BswMModeRequestPort): BswMRequestProcessing=BSWM_IMMEDIATE
          BswMModeRequestSource
            BswMGenericRequest: BswMModeRequesterId=0
        BswMModeCondition_0 (BswMModeCondition): BswMConditionType=BSWM_EQUALS, BswMConditionMode=BswMModeRequestPort_0
          BswMConditionValue
            BswMBswMode: BswModeCompareValue=ECUM_STATE_STARTUP
        BswMModeCondition_1 (BswMModeCondition): BswMConditionType=BSWM_EQUALS, BswMConditionMode=BswMModeRequestPort_1
          BswMConditionValue
            BswMBswMode: BswMBswRequestedMode=1
        BswMLogicalExpression_1 (BswMLogicalExpression): BswMArgumentRef=BswMModeCondition_1
        BswMRule_0 (BswMRule):
          BswMNestedExecutionOnly = false
          BswMRuleInitState = BSWM_UNDEFINED
          BswMRuleExpressionRef = BswMLogicalExpression_0
          BswMRuleTrueActionList = BswMActionList_0
        BswMRule_1 (BswMRule):
          BswMNestedExecutionOnly = false
          BswMRuleInitState = BSWM_UNDEFINED
          BswMRuleExpressionRef = BswMLogicalExpression_1
          BswMRuleTrueActionList = BswMActionList_1
      BswMModeControl
        BswMAction_0 (BswMAction)
          BswMAvailableActions
            BswMEcuMDriverInitListBswM: BswMEcuMDriverInitListBswMRef=EcuMDriverInitListBswM_0
        BswMAction_1 (BswMAction)
          BswMAvailableActions
            BswMUserCallout: BswMUserCalloutFunction=BswMUserCalloutFunc
        BswMActionList_0 (BswMActionList): BswMActionListExecution=BSWM_CONDITION
          BswMActionListItem_0 (BswMActionListItem): BswMAbortOnFail=false, BswMActionListItemIndex=0, BswMActionListItemRef=BswMAction_0
        BswMActionList_1 (BswMActionList): BswMActionListExecution=BSWM_CONDITION
          BswMActionListItem_0 (BswMActionListItem): BswMAbortOnFail=false, BswMActionListItemIndex=0, BswMActionListItemRef=BswMAction_1
    BswMGeneral:
      BswMCloneVariableSupport = false
      BswMCanSMEnabled = true
      BswMComMEnabled = true
      BswMDcmEnabled = false
      BswMDevErrorDetect = false
      BswMEcuMEnabled = true
      BswMEthIfEnabled = false
      BswMEthSMEnabled = false
      BswMFrSMEnabled = false
      BswMGenericRequestEnabled = true
      BswMJ1939DcmEnabled = false
      BswMJ1939NmEnabled = false
      BswMLinSMEnabled = false
      BswMLinTPEnabled = false
      BswMNmEnabled = false
      BswMNvMEnabled = false
      BswMSdControlEnabled = false
      BswMSdEnabled = false
      BswMVersionInfoApi = false
      BswMMainFunctionPeriod = 0.01
