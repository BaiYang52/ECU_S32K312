AUTOSAR XML (schema 00048)
package /S32K3XX
  module config Can: implementation-config-variant=VARIANT-POST-BUILD
    CanConfigSet
      CanController_0 (CanController):
        index = 0
        CanAutoBusOffRecovery = 0
        CanBusoffProcessing = INTERRUPT
        CanClockFromBus = 1
        CanControllerActivation = 1
        CanControllerBaseAddress = 0
        CanControllerEdgeFilter = 0
        CanControllerFdISO = 1
        CanControllerId = 0
        CanControllerPrExcEn = 0
        CanHwChannel = FLEXCAN_0
        CanLoopBackMode = 0
        CanRxProcessing = INTERRUPT
        CanTrippleSamplingEnable = 0
        CanTxProcessing = INTERRUPT
        CanWakeupFunctionalityAPI = 0
        CanWakeupProcessing = POLLING
        CanWakeupSupport = 0
        CanControllerDefaultBaudrate = CanController_0/CanControllerBaudrateConfig_0
        CanCpuClockRef = McuClockReferencePoint_CAN_02_CLK
        CanCpuClockRefAlternate = (unset)
        CanControllerBaudrateConfig_0 (CanControllerBaudrateConfig):
          CanAdvancedSetting = 0
          CanBaudrateTypeSuport = NORMAL_CBT
          CanBusLength = 40
          CanControllerBaudRate = 500.0
          CanControllerBaudRateConfigID = 0
          CanControllerPrescaller = 12
          CanControllerPrescallerAlternate = 10
          CanControllerPropSeg = 4
          CanControllerSeg1 = 3
          CanControllerSeg2 = 2
          CanControllerSyncJumpWidth = 2
          CanControllerSyncSeg = 1
          CanPropDelayTranceiver = 150.0
          CanTxArbitrationStartDelay = 12
        CanRxFiFo
          CanRxFiFo (CanEnhanceFiFo):
            CanEnhanceFiFoDmaEnable = 0
            CanEnhancedSchemeType = MASK_FILTER_SCHEME
            CanFiFoDmaErrorNotif = NULL_PTR
            CanFiFoOverflowNotif = NULL_PTR
            NumberMBTransferDMA = 1
      CanController_1 (CanController):
        index = 1
        CanAutoBusOffRecovery = 0
        CanBusoffProcessing = INTERRUPT
        CanClockFromBus = 1
        CanControllerActivation = 1
        CanControllerBaseAddress = 0
        CanControllerEdgeFilter = 0
        CanControllerFdISO = 1
        CanControllerId = 1
        CanControllerPrExcEn = 0
        CanHwChannel = FLEXCAN_1
        CanLoopBackMode = 0
        CanRxProcessing = INTERRUPT
        CanTrippleSamplingEnable = 0
        CanTxProcessing = INTERRUPT
        CanWakeupFunctionalityAPI = 0
        CanWakeupProcessing = POLLING
        CanWakeupSupport = 0
        CanControllerDefaultBaudrate = CanController_1/CanControllerBaudrateConfig_0
        CanCpuClockRef = McuClockReferencePoint_CAN_02_CLK
        CanCpuClockRefAlternate = (unset)
        CanControllerBaudrateConfig_0 (CanControllerBaudrateConfig):
          CanAdvancedSetting = 0
          CanBaudrateTypeSuport = NORMAL_CBT
          CanBusLength = 40
          CanControllerBaudRate = 500.0
          CanControllerBaudRateConfigID = 0
          CanControllerPrescaller = 12
          CanControllerPrescallerAlternate = 10
          CanControllerPropSeg = 4
          CanControllerSeg1 = 3
          CanControllerSeg2 = 2
          CanControllerSyncJumpWidth = 2
          CanControllerSyncSeg = 1
          CanPropDelayTranceiver = 150.0
          CanTxArbitrationStartDelay = 12
      5 x CanHardwareObject, all with CanIdType=STANDARD:
        CanHardwareObject_CAN0_FULL_Rx_0x119: index=0, CanHandleType=FULL, CanHwObjectCount=1, CanObjectId=1, CanObjectType=RECEIVE, CanControllerRef=CanController_0
          CanHwFilter_0 (CanHwFilter): index=0, CanHwFilterCode=281, CanHwFilterMask=2047
        CanHardwareObject_CAN0_BASIC_Rx: index=1, CanHandleType=BASIC, CanHwObjectCount=8, CanObjectId=0, CanObjectType=RECEIVE, CanControllerRef=CanController_0
          8 x CanHwFilter:
            CanHwFilter_0: index=0, CanHwFilterCode=298, CanHwFilterMask=2047
            CanHwFilter_1: index=1, CanHwFilterCode=512, CanHwFilterMask=2047
            CanHwFilter_2: index=2, CanHwFilterCode=513, CanHwFilterMask=2047
            CanHwFilter_3: index=3, CanHwFilterCode=514, CanHwFilterMask=2047
            CanHwFilter_4: index=4, CanHwFilterCode=515, CanHwFilterMask=2047
            CanHwFilter_5: index=5, CanHwFilterCode=528, CanHwFilterMask=2047
            CanHwFilter_6: index=6, CanHwFilterCode=592, CanHwFilterMask=2047
            CanHwFilter_7: index=7, CanHwFilterCode=1280, CanHwFilterMask=1792
        CanHardwareObject_CAN1_BASIC_Rx: index=2, CanHandleType=BASIC, CanHwObjectCount=1, CanObjectId=2, CanObjectType=RECEIVE, CanControllerRef=CanController_1
          CanHwFilter_0 (CanHwFilter): index=0, CanHwFilterCode=291, CanHwFilterMask=2047
        CanHardwareObject_CAN0_BASIC_Tx: index=3, CanHandleType=BASIC, CanHwObjectCount=1, CanObjectId=3, CanObjectType=TRANSMIT, CanControllerRef=CanController_0
        CanHardwareObject_CAN1_BASIC_Tx: index=4, CanHandleType=BASIC, CanHwObjectCount=1, CanObjectId=4, CanObjectType=TRANSMIT, CanControllerRef=CanController_1
      CAN_CONTROLLER_0_S32K312 (CanController):
        CanBusoffProcessing = 
        CanControllerActivation = true
        CanControllerBaseAddress = 
        CanControllerId = 2
        CanHwPnSupport = false
        CanRxProcessing = 
        CanTxProcessing = 
        CanWakeupProcessing = 
        CanWakeupSupport = false
        CanControllerDefaultBaudrate = CAN_CONTROLLER_0_S32K312/CanControllerBaudrateConfig_0
        CanCpuClockRef = (unset)
        CanControllerBaudrateConfig_0 (CanControllerBaudrateConfig): CanControllerBaudRate=, CanControllerBaudRateConfigID=0, CanControllerPropSeg=, CanControllerSeg1=, CanControllerSeg2=, CanControllerSyncJumpWidth=
      CAN_CONTROLLER_0_BASIC_HRH (CanHardwareObject): CanHandleType=BASIC, CanHwObjectCount=16, CanIdType=, CanObjectId=5, CanObjectType=RECEIVE, CanControllerRef=CAN_CONTROLLER_0_S32K312
        CanHwFilter: CanHwFilterCode=0, CanHwFilterMask=0
      CAN_CONTROLLER_0_BASIC_HTH (CanHardwareObject): CanHandleType=BASIC, CanHwObjectCount=16, CanIdType=, CanObjectId=6, CanObjectType=TRANSMIT, CanControllerRef=CAN_CONTROLLER_0_S32K312
    CanGeneral:
      CanDevErrorDetect = true
      CanEnableDualClockMode = 0
      CanEnableSecurityEventReporting = 0
      CanEnableUserModeSupport = 0
      CanGlobalTimeSupport = 0
      CanIndex = 0
      CanMBCountExtensionSupport = 1
      CanMainFunctionModePeriod = 0.001
      CanMulticoreSupport = 0
      CanMultiplexedTransmission = 1
      CanTimeoutDuration = 1.0
      CanTimeoutMethod = OSIF_COUNTER_DUMMY
      CanVersionInfoApi = 0
      LPduHrhExtendSupport = 0
      CanSupportTTCANRef = (unset)
    CommonPublishedInformation:
      ArReleaseMajorVersion = 4
      ArReleaseMinorVersion = 7
      ArReleaseRevisionVersion = 0
      ModuleId = 80
      SwMajorVersion = 4
      SwMinorVersion = 0
      SwPatchVersion = 0
      VendorApiInfix = FLEXCAN
      VendorId = 43
