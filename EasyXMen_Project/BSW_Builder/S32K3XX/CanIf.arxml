AUTOSAR XML (schema 00048)
package /S32K3XX
  module config CanIf
    CanIfCtrlDrvCfg_0 (CanIfCtrlDrvCfg): CanIfCtrlDrvInitHohConfigRef=CanIfInitHohCfg_0, CanIfCtrlDrvNameRef=CanGeneral
      CanIfCtrlCfg_0 (CanIfCtrlCfg): CanIfCtrlId=CANIF_CANDRV_0_CanIfCtrlCfg_0, CanIfCtrlWakeupSupport=false, CanIfCtrlCanCtrlRef=CanController_0
      CanIfCtrlCfg_1 (CanIfCtrlCfg): CanIfCtrlId=CANIF_CANDRV_1_CanIfCtrlCfg_1, CanIfCtrlWakeupSupport=false, CanIfCtrlCanCtrlRef=CanController_1
    CanIfDispatchCfg:
      CanIfDispatchUserCheckTrcvWakeFlagIndicationName = User_CheckTransceiverWakeFlagIndication
      CanIfDispatchUserClearTrcvWufFlagIndicationName = User_ClearTrcvWufFlagIndication
      CanIfDispatchUserConfirmPnAvailabilityName = User_ConfirmPnAvailability
      CanIfDispatchUserCtrlBusOffName = CanSM_ControllerBusOff
      CanIfDispatchUserCtrlBusOffUL = CAN_SM
      CanIfDispatchUserCtrlModeIndicationName = CanSM_ControllerModeIndication
      CanIfDispatchUserCtrlModeIndicationUL = CAN_SM
      CanIfDispatchUserTrcvModeIndicationName = User_TrcvModeIndication
      CanIfDispatchUserValidateWakeupEventName = User_ValidateWakeupEvent
    CanIfInitCfg: CanIfInitCfgSet=CanIfInitCfgSet
      CanIfInitHohCfg_0 (CanIfInitHohCfg)
        CanIfHrhCfg_0x12a (CanIfHrhCfg): CanIfHrhSoftwareFilter=false, CanIfHrhCanCtrlIdRef=CanIfCtrlCfg_0, CanIfHrhIdSymRef=CanHardwareObject_CAN0_BASIC_Rx
        CanIfHthCfg_0x110 (CanIfHthCfg): CanIfHthCanCtrlIdRef=CanIfCtrlCfg_0, CanIfHthIdSymRef=CanHardwareObject_CAN0_BASIC_Tx
        CanIfHthCfg_Controller1_0x119_Tx (CanIfHthCfg): CanIfHthCanCtrlIdRef=CanIfCtrlCfg_1, CanIfHthIdSymRef=CanHardwareObject_CAN1_BASIC_Tx
        CanIfHrhCfg_0x119 (CanIfHrhCfg): CanIfHrhSoftwareFilter=false, CanIfHrhCanCtrlIdRef=CanIfCtrlCfg_0, CanIfHrhIdSymRef=CanHardwareObject_CAN0_FULL_Rx_0x119
      CanIfRxPduCfg_0x12a (CanIfRxPduCfg):
        CanIfRxPduCanIdType = STANDARD_CAN
        CanIfRxPduDataLength = 8
        CanIfRxPduDataLengthCheck = true
        CanIfRxPduId = CanIfConf_CanIfRxPduCfg_CanIfRxPduCfg_0x12a
        CanIfRxPduReadData = false
        CanIfRxPduReadNotifyStatus = false
        CanIfRxPduUserRxIndicationName = PduR_CanIfRxIndication
        CanIfRxPduCanId = 298
        CanIfRxPduCanIdMask = 2047
        CanIfRxPduUserRxIndicationUL = PDUR
        CanIfRxPduHrhIdRef = CanIfHrhCfg_0x12a
        CanIfRxPduRef = CanIf_0x12a_Rx
      CanIfTxPduCfg_0x110 (CanIfTxPduCfg):
        CanIfTxPduCanId = 272
        CanIfTxPduCanIdType = STANDARD_CAN
        CanIfTxPduId = CanIfConf_CanIfTxPduCfg_CanIfTxPduCfg_0x110
        CanIfTxPduPnFilterPdu = false
        CanIfTxPduReadNotifyStatus = false
        CanIfTxPduTriggerTransmit = false
        CanIfTxPduTruncation = true
        CanIfTxPduType = STATIC
        CanIfTxPduUserTriggerTransmitName = PduR_CanIfTriggerTransmit
        CanIfTxPduUserTxConfirmationName = PduR_CanIfTxConfirmation
        CanIfTxPduUserTxConfirmationUL = PDUR
        CanIfTxPduBufferRef = CanIfBufferCfg_0x110
        CanIfTxPduRef = CanIf_0x110_Tx
      CanIfBufferCfg_0x110 (CanIfBufferCfg): CanIfBufferSize=4, CanIfBufferHthRef=CanIfHthCfg_0x110
      CanIfBufferCfg_Routing_Buffer (CanIfBufferCfg): CanIfBufferSize=4, CanIfBufferHthRef=CanIfHthCfg_Controller1_0x119_Tx
      CanIfTxPduCfg_Controller1_0x119_Tx (CanIfTxPduCfg):
        CanIfTxPduCanId = 281
        CanIfTxPduCanIdType = STANDARD_CAN
        CanIfTxPduId = CanIfConf_CanIfTxPduCfg_CanIfTxPduCfg_Controller1_0x119_Tx
        CanIfTxPduPnFilterPdu = false
        CanIfTxPduReadNotifyStatus = false
        CanIfTxPduTriggerTransmit = false
        CanIfTxPduTruncation = true
        CanIfTxPduType = STATIC
        CanIfTxPduUserTriggerTransmitName = PduR_CanIfTriggerTransmit
        CanIfTxPduUserTxConfirmationName = PduR_CanIfTxConfirmation
        CanIfTxPduUserTxConfirmationUL = PDUR
        CanIfTxPduBufferRef = CanIfBufferCfg_Routing_Buffer
        CanIfTxPduRef = CanIf_0x119_Routing_Tx
      CanIfRxPduCfg_0x119_Routing_Rx (CanIfRxPduCfg):
        CanIfRxPduCanIdType = STANDARD_CAN
        CanIfRxPduDataLength = 8
        CanIfRxPduDataLengthCheck = true
        CanIfRxPduId = CanIfConf_CanIfRxPduCfg_CanIfRxPduCfg_0x119_Routing_Rx
        CanIfRxPduReadData = false
        CanIfRxPduReadNotifyStatus = false
        CanIfRxPduUserRxIndicationName = PduR_CanIfRxIndication
        CanIfRxPduCanId = 281
        CanIfRxPduCanIdMask = 2047
        CanIfRxPduUserRxIndicationUL = PDUR
        CanIfRxPduHrhIdRef = CanIfHrhCfg_0x119
        CanIfRxPduRef = CanIf_0x119_Routing_Rx
    CanIfPrivateCfg: CanIfPrivateDataLengthCheck=true, CanIfPrivateSoftwareFilterType=LINEAR, CanIfSupportTTCAN=false
    CanIfPublicCfg:
      CanIfConfigType = PC_CONFIG
      CanIfPublicCtrlDrvVersion = AUTOSAR440
      CanIfBusMirroringSupport = false
      CanIfDevErrorDetect = false
      CanIfMetaDataSupport = false
      CanIfPublicCancelTransmitSupport = false
      CanIfPublicHandleTypeEnum = UINT16
      CanIfPublicCanIdTypeEnum = UINT32
      CanIfPublicIcomSupport = false
      CanIfPublicMultipleDrvSupport = true
      CanIfPublicPnSupport = false
      CanIfPublicReadRxPduDataApi = false
      CanIfPublicReadRxPduNotifyStatusApi = false
      CanIfPublicReadTxPduNotifyStatusApi = false
      CanIfPublicSetDynamicTxIdApi = false
      CanIfPublicTxBuffering = true
      CanIfPublicTxConfirmPollingSupport = true
      CanIfPublicWakeupCheckValidByNM = false
      CanIfPublicWakeupCheckValidSupport = false
      CanIfSetBaudrateApi = false
      CanIfTriggerTransmitSupport = false
      CanIfTxOfflineActiveSupport = false
      CanIfVersionInfoApi = false
      CanIfWakeupSupport = true
