AUTOSAR XML (schema 00048)
package /S32K3XX
  module config CanIf
    CanIfCtrlDrvCfg_0 (CanIfCtrlDrvCfg): CanIfCtrlDrvInitHohConfigRef=CanIfInitHohCfg_0, CanIfCtrlDrvNameRef=CanGeneral
      CanIfCtrlCfg_0 (CanIfCtrlCfg): CanIfCtrlId=CANIF_CANDRV_0_CanIfCtrlCfg_0, CanIfCtrlWakeupSupport=false, CanIfCtrlCanCtrlRef=CanController_0
      CanIfCtrlCfg_1 (CanIfCtrlCfg): CanIfCtrlId=CANIF_CANDRV_1_CanIfCtrlCfg_1, CanIfCtrlWakeupSupport=false, CanIfCtrlCanCtrlRef=CanController_1
    CanIfDispatchCfg:
      CanIfDispatchUserCheckTrcvWakeFlagIndicationName = User_CheckTransceiverWakeFlagIndication
      CanIfDispatchUserClearTrcvWufFlagIndicationName = User_ClearTrcvWufFlagIndication
      CanIfDispatchUserConfirmPnAvailabilityName = User_ConfirmPnAvailability
      CanIfDispatchUserCtrlBusOffName = CanSM_ControllerBusOff
      CanIfDispatchUserCtrlBusOffUL = CAN_SM
      CanIfDispatchUserCtrlModeIndicationName = CanSM_ControllerModeIndication
      CanIfDispatchUserCtrlModeIndicationUL = CAN_SM
      CanIfDispatchUserTrcvModeIndicationName = User_TrcvModeIndication
      CanIfDispatchUserValidateWakeupEventName = User_ValidateWakeupEvent
    CanIfInitCfg: CanIfInitCfgSet=CanIfInitCfgSet
      CanIfInitHohCfg_0 (CanIfInitHohCfg)
        CanIfHrhCfg_CAN0_BASIC (CanIfHrhCfg): CanIfHrhSoftwareFilter=false, CanIfHrhCanCtrlIdRef=CanIfCtrlCfg_0, CanIfHrhIdSymRef=CanHardwareObject_CAN0_BASIC_Rx
        CanIfHthCfg_CAN0_BASIC (CanIfHthCfg): CanIfHthCanCtrlIdRef=CanIfCtrlCfg_0, CanIfHthIdSymRef=CanHardwareObject_CAN0_BASIC_Tx
        CanIfHthCfg_CAN1_BASIC (CanIfHthCfg): CanIfHthCanCtrlIdRef=CanIfCtrlCfg_1, CanIfHthIdSymRef=CanHardwareObject_CAN1_BASIC_Tx
        CanIfHrhCfg_CAN0_FULL_0x119 (CanIfHrhCfg): CanIfHrhSoftwareFilter=false, CanIfHrhCanCtrlIdRef=CanIfCtrlCfg_0, CanIfHrhIdSymRef=CanHardwareObject_CAN0_FULL_Rx_0x119
      CanIfRxPduCfg_CAN0_0x12a (CanIfRxPduCfg):
        CanIfRxPduCanIdType = STANDARD_CAN
        CanIfRxPduDataLength = 8
        CanIfRxPduDataLengthCheck = true
        CanIfRxPduId = CanIfConf_CanIfRxPduCfg_CanIfRxPduCfg_CAN0_0x12a
        CanIfRxPduReadData = false
        CanIfRxPduReadNotifyStatus = false
        CanIfRxPduUserRxIndicationName = PduR_CanIfRxIndication
        CanIfRxPduCanId = 298
        CanIfRxPduCanIdMask = 2047
        CanIfRxPduUserRxIndicationUL = PDUR
        CanIfRxPduHrhIdRef = CanIfHrhCfg_CAN0_BASIC
        CanIfRxPduRef = CanIf_0x12a_Rx
      CanIfTxPduCfg_CAN0_0x110 (CanIfTxPduCfg):
        CanIfTxPduCanId = 272
        CanIfTxPduCanIdType = STANDARD_CAN
        CanIfTxPduId = CanIfConf_CanIfTxPduCfg_CanIfTxPduCfg_CAN0_0x110
        CanIfTxPduPnFilterPdu = false
        CanIfTxPduReadNotifyStatus = false
        CanIfTxPduTriggerTransmit = false
        CanIfTxPduTruncation = true
        CanIfTxPduType = STATIC
        CanIfTxPduUserTriggerTransmitName = PduR_CanIfTriggerTransmit
        CanIfTxPduUserTxConfirmationName = PduR_CanIfTxConfirmation
        CanIfTxPduUserTxConfirmationUL = PDUR
        CanIfTxPduBufferRef = CanIfBufferCfg_CAN0
        CanIfTxPduRef = CanIf_0x110_Tx
      CanIfBufferCfg_CAN0 (CanIfBufferCfg): CanIfBufferSize=4, CanIfBufferHthRef=CanIfHthCfg_CAN0_BASIC
      CanIfBufferCfg_CAN1 (CanIfBufferCfg): CanIfBufferSize=4, CanIfBufferHthRef=CanIfHthCfg_CAN1_BASIC
      CanIfTxPduCfg_CAN1_0x119_Routing (CanIfTxPduCfg):
        CanIfTxPduCanId = 281
        CanIfTxPduCanIdType = STANDARD_CAN
        CanIfTxPduId = CanIfConf_CanIfTxPduCfg_CanIfTxPduCfg_CAN1_0x119_Routing
        CanIfTxPduPnFilterPdu = false
        CanIfTxPduReadNotifyStatus = false
        CanIfTxPduTriggerTransmit = false
        CanIfTxPduTruncation = true
        CanIfTxPduType = STATIC
        CanIfTxPduUserTriggerTransmitName = PduR_CanIfTriggerTransmit
        CanIfTxPduUserTxConfirmationName = PduR_CanIfTxConfirmation
        CanIfTxPduUserTxConfirmationUL = PDUR
        CanIfTxPduBufferRef = CanIfBufferCfg_CAN1
        CanIfTxPduRef = CanIf_0x119_Routing_Tx
      CanIfRxPduCfg_CAN0_0x119_Routing (CanIfRxPduCfg):
        CanIfRxPduCanIdType = STANDARD_CAN
        CanIfRxPduDataLength = 8
        CanIfRxPduDataLengthCheck = true
        CanIfRxPduId = CanIfConf_CanIfRxPduCfg_CanIfRxPduCfg_CAN0_0x119_Routing
        CanIfRxPduReadData = false
        CanIfRxPduReadNotifyStatus = false
        CanIfRxPduUserRxIndicationName = PduR_CanIfRxIndication
        CanIfRxPduCanId = 281
        CanIfRxPduCanIdMask = 2047
        CanIfRxPduUserRxIndicationUL = PDUR
        CanIfRxPduHrhIdRef = CanIfHrhCfg_CAN0_FULL_0x119
        CanIfRxPduRef = CanIf_0x119_Routing_Rx
      CanIfRxPduCfg_CAN0_0x114_SignalRouting (CanIfRxPduCfg):
        CanIfRxPduCanIdType = STANDARD_CAN
        CanIfRxPduDataLength = 8
        CanIfRxPduDataLengthCheck = true
        CanIfRxPduId = CanIfConf_CanIfRxPduCfg_CanIfRxPduCfg_CAN0_0x114_SignalRouting
        CanIfRxPduReadData = false
        CanIfRxPduReadNotifyStatus = false
        CanIfRxPduUserRxIndicationName = PduR_CanIfRxIndication
        CanIfRxPduCanId = 276
        CanIfRxPduCanIdMask = 2047
        CanIfRxPduUserRxIndicationUL = PDUR
        CanIfRxPduHrhIdRef = CanIfHrhCfg_CAN0_BASIC
        CanIfRxPduRef = CanIf_0x114_Signal_Routing_Rx
      CanIfTxPduCfg_CAN1_0x114_SignalRouting (CanIfTxPduCfg):
        CanIfTxPduCanId = 276
        CanIfTxPduCanIdType = STANDARD_CAN
        CanIfTxPduId = CanIfConf_CanIfTxPduCfg_CanIfTxPduCfg_CAN1_0x114_SignalRouting
        CanIfTxPduPnFilterPdu = false
        CanIfTxPduReadNotifyStatus = false
        CanIfTxPduTriggerTransmit = false
        CanIfTxPduTruncation = true
        CanIfTxPduType = STATIC
        CanIfTxPduUserTriggerTransmitName = PduR_CanIfTriggerTransmit
        CanIfTxPduUserTxConfirmationName = PduR_CanIfTxConfirmation
        CanIfTxPduUserTxConfirmationUL = PDUR
        CanIfTxPduBufferRef = CanIfBufferCfg_CAN1
        CanIfTxPduRef = CanIf_0x114_Signal_Routing_Tx
      CanIfTxPduCfg_CAN1_0x115_SignalRouting (CanIfTxPduCfg):
        CanIfTxPduCanId = 277
        CanIfTxPduCanIdType = STANDARD_CAN
        CanIfTxPduId = CanIfConf_CanIfTxPduCfg_CanIfTxPduCfg_CAN1_0x115_SignalRouting
        CanIfTxPduPnFilterPdu = false
        CanIfTxPduReadNotifyStatus = false
        CanIfTxPduTriggerTransmit = false
        CanIfTxPduTruncation = true
        CanIfTxPduType = STATIC
        CanIfTxPduUserTriggerTransmitName = PduR_CanIfTriggerTransmit
        CanIfTxPduUserTxConfirmationName = PduR_CanIfTxConfirmation
        CanIfTxPduUserTxConfirmationUL = PDUR
        CanIfTxPduBufferRef = CanIfBufferCfg_CAN1
        CanIfTxPduRef = CanIf_0x115_Signal_Routing_Tx
    CanIfPrivateCfg: CanIfPrivateDataLengthCheck=true, CanIfPrivateSoftwareFilterType=LINEAR, CanIfSupportTTCAN=false
    CanIfPublicCfg:
      CanIfConfigType = PC_CONFIG
      CanIfPublicCtrlDrvVersion = AUTOSAR440
      CanIfBusMirroringSupport = false
      CanIfDevErrorDetect = false
      CanIfMetaDataSupport = false
      CanIfPublicCancelTransmitSupport = false
      CanIfPublicHandleTypeEnum = UINT16
      CanIfPublicCanIdTypeEnum = UINT32
      CanIfPublicIcomSupport = false
      CanIfPublicMultipleDrvSupport = true
      CanIfPublicPnSupport = false
      CanIfPublicReadRxPduDataApi = false
      CanIfPublicReadRxPduNotifyStatusApi = false
      CanIfPublicReadTxPduNotifyStatusApi = false
      CanIfPublicSetDynamicTxIdApi = false
      CanIfPublicTxBuffering = true
      CanIfPublicTxConfirmPollingSupport = true
      CanIfPublicWakeupCheckValidByNM = false
      CanIfPublicWakeupCheckValidSupport = false
      CanIfSetBaudrateApi = false
      CanIfTriggerTransmitSupport = false
      CanIfTxOfflineActiveSupport = false
      CanIfVersionInfoApi = false
      CanIfWakeupSupport = true
