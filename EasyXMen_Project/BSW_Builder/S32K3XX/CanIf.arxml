AUTOSAR XML (schema 00048)
package /S32K3XX
  module config CanIf
    CanIfCtrlDrvCfg_0 (CanIfCtrlDrvCfg): CanIfCtrlDrvInitHohConfigRef=CanIfInitHohCfg_0, CanIfCtrlDrvNameRef=CanGeneral
      CanIfCtrlCfg_0 (CanIfCtrlCfg): CanIfCtrlId=CANIF_CANDRV_0_CanIfCtrlCfg_0, CanIfCtrlWakeupSupport=false, CanIfCtrlCanCtrlRef=CanController_0
    CanIfDispatchCfg:
      CanIfDispatchUserCheckTrcvWakeFlagIndicationName = User_CheckTransceiverWakeFlagIndication
      CanIfDispatchUserClearTrcvWufFlagIndicationName = User_ClearTrcvWufFlagIndication
      CanIfDispatchUserConfirmPnAvailabilityName = User_ConfirmPnAvailability
      CanIfDispatchUserCtrlBusOffName = CanSM_ControllerBusOff
      CanIfDispatchUserCtrlBusOffUL = CAN_SM
      CanIfDispatchUserCtrlModeIndicationName = CanSM_ControllerModeIndication
      CanIfDispatchUserCtrlModeIndicationUL = CAN_SM
      CanIfDispatchUserTrcvModeIndicationName = User_TrcvModeIndication
      CanIfDispatchUserValidateWakeupEventName = User_ValidateWakeupEvent
    CanIfInitCfg: CanIfInitCfgSet=CanIfInitCfgSet
      CanIfInitHohCfg_0 (CanIfInitHohCfg)
        CanIfHthCfg__0x110 (CanIfHthCfg): CanIfHthCanCtrlIdRef=CanIfCtrlCfg_0, CanIfHthIdSymRef=CanHardwareObject_2_Tx
        CanIfHrhCfg_0x12a (CanIfHrhCfg): CanIfHrhSoftwareFilter=true, CanIfHrhCanCtrlIdRef=CanIfCtrlCfg_0, CanIfHrhIdSymRef=CanHardwareObject_0_Rx
      CanIfRxPduCfg__0x12a (CanIfRxPduCfg):
        CanIfRxPduCanIdType = STANDARD_CAN
        CanIfRxPduDataLength = 8
        CanIfRxPduDataLengthCheck = true
        CanIfRxPduId = CanIfConf_CanIfRxPduCfg_CanIfRxPduCfg__0x12a
        CanIfRxPduReadData = false
        CanIfRxPduReadNotifyStatus = false
        CanIfRxPduUserRxIndicationName = PduR_CanIfRxIndication
        CanIfRxPduCanId = 298
        CanIfRxPduCanIdMask = 2047
        CanIfRxPduUserRxIndicationUL = PDUR
        CanIfRxPduHrhIdRef = CanIfHrhCfg_0x12a
        CanIfRxPduRef = Canif_0x12a_Rx
      CanIfTxPduCfg__0x110 (CanIfTxPduCfg):
        CanIfTxPduCanId = 272
        CanIfTxPduCanIdType = STANDARD_CAN
        CanIfTxPduId = CanIfConf_CanIfTxPduCfg_CanIfTxPduCfg__0x110
        CanIfTxPduPnFilterPdu = false
        CanIfTxPduReadNotifyStatus = false
        CanIfTxPduTriggerTransmit = false
        CanIfTxPduTruncation = true
        CanIfTxPduType = STATIC
        CanIfTxPduUserTriggerTransmitName = PduR_CanIfTriggerTransmit
        CanIfTxPduUserTxConfirmationName = PduR_CanIfTxConfirmation
        CanIfTxPduUserTxConfirmationUL = PDUR
        CanIfTxPduBufferRef = CanIfBufferCfg_0x110
        CanIfTxPduRef = Canif_0x110_Tx
      CanIfBufferCfg_0x110 (CanIfBufferCfg): CanIfBufferSize=4, CanIfBufferHthRef=CanIfHthCfg__0x110
    CanIfPrivateCfg: CanIfPrivateDataLengthCheck=true, CanIfPrivateSoftwareFilterType=LINEAR, CanIfSupportTTCAN=false
    CanIfPublicCfg:
      CanIfConfigType = PC_CONFIG
      CanIfPublicCtrlDrvVersion = AUTOSAR440
      CanIfBusMirroringSupport = false
      CanIfDevErrorDetect = false
      CanIfMetaDataSupport = false
      CanIfPublicCancelTransmitSupport = false
      CanIfPublicHandleTypeEnum = UINT16
      CanIfPublicCanIdTypeEnum = UINT32
      CanIfPublicIcomSupport = false
      CanIfPublicMultipleDrvSupport = true
      CanIfPublicPnSupport = false
      CanIfPublicReadRxPduDataApi = false
      CanIfPublicReadRxPduNotifyStatusApi = false
      CanIfPublicReadTxPduNotifyStatusApi = false
      CanIfPublicSetDynamicTxIdApi = false
      CanIfPublicTxBuffering = true
      CanIfPublicTxConfirmPollingSupport = true
      CanIfPublicWakeupCheckValidByNM = false
      CanIfPublicWakeupCheckValidSupport = false
      CanIfSetBaudrateApi = false
      CanIfTriggerTransmitSupport = false
      CanIfTxOfflineActiveSupport = false
      CanIfVersionInfoApi = false
      CanIfWakeupSupport = true
