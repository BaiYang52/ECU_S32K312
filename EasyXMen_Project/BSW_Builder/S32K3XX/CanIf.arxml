AUTOSAR XML (schema 00048)
package /S32K3XX
  module config CanIf
    CanIfCtrlDrvCfg: CanIfCtrlDrvInitHohConfigRef=CanIfInitHohCfg_0, CanIfCtrlDrvNameRef=CanGeneral
      CanIfCtrlCfg_0 (CanIfCtrlCfg): CanIfCtrlId=CANIF_CANDRV_0_CanIfCtrlCfg_0, CanIfCtrlWakeupSupport=false, CanIfCtrlCanCtrlRef=CanController_0
      CanIfCtrlCfg_1 (CanIfCtrlCfg): CanIfCtrlId=CANIF_CANDRV_1_CanIfCtrlCfg_1, CanIfCtrlWakeupSupport=false, CanIfCtrlCanCtrlRef=CanController_1
    CanIfDispatchCfg:
      CanIfDispatchUserCheckTrcvWakeFlagIndicationName = User_CheckTransceiverWakeFlagIndication
      CanIfDispatchUserClearTrcvWufFlagIndicationName = User_ClearTrcvWufFlagIndication
      CanIfDispatchUserConfirmPnAvailabilityName = User_ConfirmPnAvailability
      CanIfDispatchUserCtrlBusOffName = CanSM_ControllerBusOff
      CanIfDispatchUserCtrlBusOffUL = CAN_SM
      CanIfDispatchUserCtrlModeIndicationName = CanSM_ControllerModeIndication
      CanIfDispatchUserCtrlModeIndicationUL = CAN_SM
      CanIfDispatchUserTrcvModeIndicationName = User_TrcvModeIndication
      CanIfDispatchUserValidateWakeupEventName = User_ValidateWakeupEvent
    CanIfInitCfg: CanIfInitCfgSet=CanIfInitCfgSet
      CanIfInitHohCfg_0 (CanIfInitHohCfg)
        CanIfHrhCfg_CAN0_BASIC (CanIfHrhCfg): CanIfHrhSoftwareFilter=false, CanIfHrhCanCtrlIdRef=CanIfCtrlCfg_0, CanIfHrhIdSymRef=CanHardwareObject_CAN0_BASIC_Rx
        CanIfHthCfg_CAN0_BASIC (CanIfHthCfg): CanIfHthCanCtrlIdRef=CanIfCtrlCfg_0, CanIfHthIdSymRef=CanHardwareObject_CAN0_BASIC_Tx
        CanIfHthCfg_CAN1_BASIC (CanIfHthCfg): CanIfHthCanCtrlIdRef=CanIfCtrlCfg_1, CanIfHthIdSymRef=CanHardwareObject_CAN1_BASIC_Tx
        CanIfHrhCfg_CAN0_FULL_0x119 (CanIfHrhCfg): CanIfHrhSoftwareFilter=false, CanIfHrhCanCtrlIdRef=CanIfCtrlCfg_0, CanIfHrhIdSymRef=CanHardwareObject_CAN0_FULL_Rx_0x119
      CanIfRxPduCfg_CAN0_0x12a (CanIfRxPduCfg):
        CanIfRxPduCanIdType = STANDARD_CAN
        CanIfRxPduDataLength = 8
        CanIfRxPduDataLengthCheck = true
        CanIfRxPduId = CanIfConf_CanIfRxPduCfg_CanIfRxPduCfg_CAN0_0x12a
        CanIfRxPduReadData = false
        CanIfRxPduReadNotifyStatus = false
        CanIfRxPduUserRxIndicationName = PduR_CanIfRxIndication
        CanIfRxPduCanId = 298
        CanIfRxPduCanIdMask = 2047
        CanIfRxPduUserRxIndicationUL = PDUR
        CanIfRxPduHrhIdRef = CanIfHrhCfg_CAN0_BASIC
        CanIfRxPduRef = CanIf_0x12a_Rx
      CanIfTxPduCfg_CAN0_0x110 (CanIfTxPduCfg):
        CanIfTxPduCanId = 272
        CanIfTxPduCanIdType = STANDARD_CAN
        CanIfTxPduId = CanIfConf_CanIfTxPduCfg_CanIfTxPduCfg_CAN0_0x110
        CanIfTxPduPnFilterPdu = false
        CanIfTxPduReadNotifyStatus = false
        CanIfTxPduTriggerTransmit = false
        CanIfTxPduTruncation = true
        CanIfTxPduType = STATIC
        CanIfTxPduUserTriggerTransmitName = PduR_CanIfTriggerTransmit
        CanIfTxPduUserTxConfirmationName = PduR_CanIfTxConfirmation
        CanIfTxPduUserTxConfirmationUL = PDUR
        CanIfTxPduBufferRef = CanIfBufferCfg_CAN0
        CanIfTxPduRef = CanIf_0x110_Tx
      CanIfBufferCfg_CAN0 (CanIfBufferCfg): CanIfBufferSize=4, CanIfBufferHthRef=CanIfHthCfg_CAN0_BASIC
      CanIfBufferCfg_CAN1 (CanIfBufferCfg): CanIfBufferSize=4, CanIfBufferHthRef=CanIfHthCfg_CAN1_BASIC
      CanIfTxPduCfg_CAN1_0x119_Routing (CanIfTxPduCfg):
        CanIfTxPduCanId = 281
        CanIfTxPduCanIdType = STANDARD_CAN
        CanIfTxPduId = CanIfConf_CanIfTxPduCfg_CanIfTxPduCfg_CAN1_0x119_Routing
        CanIfTxPduPnFilterPdu = false
        CanIfTxPduReadNotifyStatus = false
        CanIfTxPduTriggerTransmit = false
        CanIfTxPduTruncation = true
        CanIfTxPduType = STATIC
        CanIfTxPduUserTriggerTransmitName = PduR_CanIfTriggerTransmit
        CanIfTxPduUserTxConfirmationName = PduR_CanIfTxConfirmation
        CanIfTxPduUserTxConfirmationUL = PDUR
        CanIfTxPduBufferRef = CanIfBufferCfg_CAN1
        CanIfTxPduRef = CanIf_0x119_Routing_Tx
      CanIfRxPduCfg_CAN0_0x119_Routing (CanIfRxPduCfg):
        CanIfRxPduCanIdType = STANDARD_CAN
        CanIfRxPduDataLength = 8
        CanIfRxPduDataLengthCheck = true
        CanIfRxPduId = CanIfConf_CanIfRxPduCfg_CanIfRxPduCfg_CAN0_0x119_Routing
        CanIfRxPduReadData = false
        CanIfRxPduReadNotifyStatus = false
        CanIfRxPduUserRxIndicationName = PduR_CanIfRxIndication
        CanIfRxPduCanId = 281
        CanIfRxPduCanIdMask = 2047
        CanIfRxPduUserRxIndicationUL = PDUR
        CanIfRxPduHrhIdRef = CanIfHrhCfg_CAN0_FULL_0x119
        CanIfRxPduRef = CanIf_0x119_Routing_Rx
      CanIfRxPduCfg_CAN0_0x114_SignalRouting (CanIfRxPduCfg):
        CanIfRxPduCanIdType = STANDARD_CAN
        CanIfRxPduDataLength = 8
        CanIfRxPduDataLengthCheck = true
        CanIfRxPduId = CanIfConf_CanIfRxPduCfg_CanIfRxPduCfg_CAN0_0x114_SignalRouting
        CanIfRxPduReadData = false
        CanIfRxPduReadNotifyStatus = false
        CanIfRxPduUserRxIndicationName = PduR_CanIfRxIndication
        CanIfRxPduCanId = 276
        CanIfRxPduCanIdMask = 2047
        CanIfRxPduUserRxIndicationUL = PDUR
        CanIfRxPduHrhIdRef = CanIfHrhCfg_CAN0_BASIC
        CanIfRxPduRef = CanIf_0x114_Signal_Routing_Rx
      9 x CanIfTxPduCfg, all with CanIfTxPduCanIdType=STANDARD_CAN, CanIfTxPduPnFilterPdu=false, CanIfTxPduReadNotifyStatus=false, CanIfTxPduTriggerTransmit=false, CanIfTxPduTruncation=true, CanIfTxPduUserTriggerTransmitName=PduR_CanIfTriggerTransmit, CanIfTxPduUserTxConfirmationName=PduR_CanIfTxConfirmation, CanIfTxPduUserTxConfirmationUL=PDUR:
        CanIfTxPduCfg_CAN1_0x114_SignalRouting: CanIfTxPduCanId=276, CanIfTxPduId=CanIfConf_CanIfTxPduCfg_CanIfTxPduCfg_CAN1_0x114_SignalRouting, CanIfTxPduType=STATIC, CanIfTxPduBufferRef=CanIfBufferCfg_CAN1, CanIfTxPduRef=CanIf_0x114_Signal_Routing_Tx
        CanIfTxPduCfg_CAN1_0x115_SignalRouting: CanIfTxPduCanId=277, CanIfTxPduId=CanIfConf_CanIfTxPduCfg_CanIfTxPduCfg_CAN1_0x115_SignalRouting, CanIfTxPduType=STATIC, CanIfTxPduBufferRef=CanIfBufferCfg_CAN1, CanIfTxPduRef=CanIf_0x115_Signal_Routing_Tx
        TX_PDU_CAN0_Tx_0x300_Cyclic_CONTROLLER_0_S32K312: CanIfTxPduCanId=768, CanIfTxPduId=CanIfConf_CanIfTxPduCfg_TX_PDU_CAN0_Tx_0x300_Cyclic_CONTROLLER_0_S32K312, CanIfTxPduType=DYNAMIC, CanIfTxPduBufferRef=CanIfBufferCfg_CAN0, CanIfTxPduRef=CANIF_CAN0_Tx_0x300_Cyclic_CONTROLLER_0_S32K312_Tx
        TX_PDU_CAN0_Tx_0x301_Event_CONTROLLER_0_S32K312: CanIfTxPduCanId=769, CanIfTxPduId=CanIfConf_CanIfTxPduCfg_TX_PDU_CAN0_Tx_0x301_Event_CONTROLLER_0_S32K312, CanIfTxPduType=DYNAMIC, CanIfTxPduBufferRef=CanIfBufferCfg_CAN0, CanIfTxPduRef=CANIF_CAN0_Tx_0x301_Event_CONTROLLER_0_S32K312_Tx
        TX_PDU_CAN0_Tx_0x302_Mixed_CONTROLLER_0_S32K312: CanIfTxPduCanId=770, CanIfTxPduId=CanIfConf_CanIfTxPduCfg_TX_PDU_CAN0_Tx_0x302_Mixed_CONTROLLER_0_S32K312, CanIfTxPduType=DYNAMIC, CanIfTxPduBufferRef=CanIfBufferCfg_CAN0, CanIfTxPduRef=CANIF_CAN0_Tx_0x302_Mixed_CONTROLLER_0_S32K312_Tx
        TX_PDU_CAN0_Tx_0x303_Cyclic_Counter_CONTROLLER_0_S32K312: CanIfTxPduCanId=771, CanIfTxPduId=CanIfConf_CanIfTxPduCfg_TX_PDU_CAN0_Tx_0x303_Cyclic_Counter_CONTROLLER_0_S32K312, CanIfTxPduType=DYNAMIC, CanIfTxPduBufferRef=CanIfBufferCfg_CAN0, CanIfTxPduRef=CANIF_CAN0_Tx_0x303_Cyclic_Counter_CONTROLLER_0_S32K312_Tx
        TX_PDU_CAN0_Tx_0x350_Cyclic_PN17_CONTROLLER_0_S32K312: CanIfTxPduCanId=848, CanIfTxPduId=CanIfConf_CanIfTxPduCfg_TX_PDU_CAN0_Tx_0x350_Cyclic_PN17_CONTROLLER_0_S32K312, CanIfTxPduType=DYNAMIC, CanIfTxPduBufferRef=CanIfBufferCfg_CAN0, CanIfTxPduRef=CANIF_CAN0_Tx_0x350_Cyclic_PN17_CONTROLLER_0_S32K312_Tx
        TX_PDU_CAN0_Tx_0x351_Cyclic_PN29_CONTROLLER_0_S32K312: CanIfTxPduCanId=849, CanIfTxPduId=CanIfConf_CanIfTxPduCfg_TX_PDU_CAN0_Tx_0x351_Cyclic_PN29_CONTROLLER_0_S32K312, CanIfTxPduType=DYNAMIC, CanIfTxPduBufferRef=CanIfBufferCfg_CAN0, CanIfTxPduRef=CANIF_CAN0_Tx_0x351_Cyclic_PN29_CONTROLLER_0_S32K312_Tx
        TX_PDU_CAN0_Tx_0x360_E2E_P01_CONTROLLER_0_S32K312: CanIfTxPduCanId=864, CanIfTxPduId=CanIfConf_CanIfTxPduCfg_TX_PDU_CAN0_Tx_0x360_E2E_P01_CONTROLLER_0_S32K312, CanIfTxPduType=DYNAMIC, CanIfTxPduBufferRef=CanIfBufferCfg_CAN0, CanIfTxPduRef=CANIF_CAN0_Tx_0x360_E2E_P01_CONTROLLER_0_S32K312_Tx
      5 x CanIfRxPduCfg, all with CanIfRxPduCanIdType=STANDARD_NO_FD_CAN, CanIfRxPduDataLength=8, CanIfRxPduDataLengthCheck=true, CanIfRxPduReadData=false, CanIfRxPduReadNotifyStatus=false, CanIfRxPduUserRxIndicationName=PduR_CanIfRxIndication, CanIfRxPduUserRxIndicationUL=PDUR, CanIfRxPduHrhIdRef=CanIfHrhCfg_CAN0_BASIC:
        RX_PDU_CAN0_Rx_0x200_Cyclic_CONTROLLER_0_S32K312: CanIfRxPduId=CanIfConf_CanIfRxPduCfg_RX_PDU_CAN0_Rx_0x200_Cyclic_CONTROLLER_0_S32K312, CanIfRxPduCanId=512, CanIfRxPduRef=CANIF_CAN0_Rx_0x200_Cyclic_CONTROLLER_0_S32K312_Rx
        RX_PDU_CAN0_Rx_0x203_Cyclic_Counter_CONTROLLER_0_S32K312: CanIfRxPduId=CanIfConf_CanIfRxPduCfg_RX_PDU_CAN0_Rx_0x203_Cyclic_Counter_CONTROLLER_0_S32K312, CanIfRxPduCanId=515, CanIfRxPduRef=CANIF_CAN0_Rx_0x203_Cyclic_Counter_CONTROLLER_0_S32K312_Rx
        RX_PDU_CAN0_Rx_0x201_Event_CONTROLLER_0_S32K312: CanIfRxPduId=CanIfConf_CanIfRxPduCfg_RX_PDU_CAN0_Rx_0x201_Event_CONTROLLER_0_S32K312, CanIfRxPduCanId=513, CanIfRxPduRef=CANIF_CAN0_Rx_0x201_Event_CONTROLLER_0_S32K312_Rx
        RX_PDU_CAN0_Rx_0x250_Cyclic_PN17_CONTROLLER_0_S32K312: CanIfRxPduId=CanIfConf_CanIfRxPduCfg_RX_PDU_CAN0_Rx_0x250_Cyclic_PN17_CONTROLLER_0_S32K312, CanIfRxPduCanId=592, CanIfRxPduRef=CANIF_CAN0_Rx_0x250_Cyclic_PN17_CONTROLLER_0_S32K312_Rx
        RX_PDU_CAN0_Rx_0x202_Mixed_CONTROLLER_0_S32K312: CanIfRxPduId=CanIfConf_CanIfRxPduCfg_RX_PDU_CAN0_Rx_0x202_Mixed_CONTROLLER_0_S32K312, CanIfRxPduCanId=514, CanIfRxPduRef=CANIF_CAN0_Rx_0x202_Mixed_CONTROLLER_0_S32K312_Rx
    CanIfPrivateCfg: CanIfPrivateDataLengthCheck=true, CanIfPrivateSoftwareFilterType=LINEAR, CanIfSupportTTCAN=false
    CanIfPublicCfg:
      CanIfConfigType = PC_CONFIG
      CanIfPublicCtrlDrvVersion = AUTOSAR440
      CanIfBusMirroringSupport = false
      CanIfDevErrorDetect = false
      CanIfMetaDataSupport = false
      CanIfPublicCancelTransmitSupport = false
      CanIfPublicHandleTypeEnum = UINT16
      CanIfPublicCanIdTypeEnum = UINT32
      CanIfPublicIcomSupport = false
      CanIfPublicMultipleDrvSupport = true
      CanIfPublicPnSupport = false
      CanIfPublicReadRxPduDataApi = false
      CanIfPublicReadRxPduNotifyStatusApi = false
      CanIfPublicReadTxPduNotifyStatusApi = false
      CanIfPublicSetDynamicTxIdApi = false
      CanIfPublicTxBuffering = true
      CanIfPublicTxConfirmPollingSupport = true
      CanIfPublicWakeupCheckValidByNM = false
      CanIfPublicWakeupCheckValidSupport = false
      CanIfSetBaudrateApi = false
      CanIfTriggerTransmitSupport = false
      CanIfTxOfflineActiveSupport = false
      CanIfVersionInfoApi = false
      CanIfWakeupSupport = true
