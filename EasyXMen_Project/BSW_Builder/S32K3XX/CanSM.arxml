AUTOSAR XML (schema 00048)
package /S32K3XX
  module config CanSM
    CanSMGeneral:
      CanSMDevErrorDetect = true
      CanSMMainFunctionTimePeriod = 0.001
      CanSMPncSupport = false
      CanSMSetBaudrateApi = false
      CanSMTxOfflineActiveSupport = false
      CanSMVersionInfoApi = false
      CanSMMultipleControllerSupport = true
    CanSMConfiguration: CanSMModeRequestRepetitionMax=10, CanSMModeRequestRepetitionTime=0.01
      CanSMManagerNetwork_0 (CanSMManagerNetwork):
        CanSMBorCounterL1ToL2 = 10
        CanSMBorTimeL1 = 0.1
        CanSMBorTimeL2 = 1.0
        CanSMBorTimeTxEnsured = 0.01
        CanSMBorTxConfirmationPolling = false
        CanSMEnableBusOffDelay = false
        CanSMComMNetworkHandleRef = ComMChannel_0
        CanSMController_0 (CanSMController): CanSMControllerId=CanIfCtrlCfg_0
        CanSMController_1 (CanSMController): CanSMControllerId=CanIfCtrlCfg_1
