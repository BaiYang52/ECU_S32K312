AUTOSAR XML (schema 00048)
package /S32K3XX
  module config Com
    ComGeneral:
      ComCancellationSupport = true
      ComConfigurationUseDet = false
      ComVersionInfoApi = false
      ComEnableMDTForCyclicTransmission = true
      ComEnableSignalGroupArrayApi = false
      ComMetaDataSupport = false
      ComRetryFailedTransmitRequests = false
      ComSupportedIPduGroups = 4
      ComConfigType = PC_CONFIG
    ComConfig
      ComIPdu_0x110_Tx (ComIPdu):
        ComIPduCancellationSupport = false
        ComIPduDirection = SEND
        ComIPduHandleId = COM_TXPDU_Com_0x110_Tx
        ComIPduSignalProcessing = DEFERRED
        ComIPduType = NORMAL
        ComIPduCallout = ComIPdu_0x110_Tx_Callout
        ComPduIdRef = Com_0x110_Tx
        ComIPduGroupRef = ComIPduGroup_Tx
        ComIPduSignalRef = ComSignal_0_Tx
        ComTxIPdu: ComMinimumDelayTime=0.0, ComTxIPduUnusedAreasDefault=0
          ComTxModeTrue
            ComTxMode: ComTxModeMode=PERIODIC, ComTxModeNumberOfRepetitions=0, ComTxModeRepetitionPeriod=0.0, ComTxModeTimeOffset=0.0, ComTxModeTimePeriod=0.1
      ComIPdu_0x12a_Rx (ComIPdu):
        ComIPduCancellationSupport = false
        ComIPduDirection = RECEIVE
        ComIPduHandleId = COM_RXPDU_Com_0x12a_Rx
        ComIPduSignalProcessing = DEFERRED
        ComIPduType = NORMAL
        ComIPduCallout = ComIPdu_0x12a_Rx_Callout
        ComPduIdRef = Com_0x12a_Rx
        ComIPduGroupRef = ComIPduGroup_Rx
        ComIPduSignalRef = ComSignal_1_Rx
      ComIPduGroup_Tx (ComIPduGroup): ComIPduGroupHandleId=ComIPduGroup_Tx
      ComIPduGroup_Rx (ComIPduGroup): ComIPduGroupHandleId=ComIPduGroup_Rx
      ComMainFunctionRx_0 (ComMainFunctionRx): ComMainRxTimeBase=0.005
      ComMainFunctionTx_0 (ComMainFunctionTx): ComMainTxTimeBase=0.005
      ComSignal_0_Tx (ComSignal):
        ComBitPosition = 0
        ComBitSize = 8
        ComHandleId = ComConf_ComSignal_ComSignal_0_Tx
        ComInvalidNotification = NULL_PTR
        ComRxDataTimeoutAction = NONE
        ComSignalEndianness = BIG_ENDIAN
        ComSignalInitValue = 0x00
        ComSignalLength = 0
        ComSignalType = UINT8
        ComTransferProperty = PENDING
      ComSignal_1_Rx (ComSignal):
        ComBitPosition = 0
        ComBitSize = 8
        ComHandleId = ComConf_ComSignal_ComSignal_1_Rx
        ComInvalidNotification = NULL_PTR
        ComRxDataTimeoutAction = NONE
        ComSignalEndianness = BIG_ENDIAN
        ComSignalInitValue = 0x00
        ComSignalLength = 0
        ComSignalType = UINT8
        ComTransferProperty = PENDING
      3 x ComIPdu, all with ComIPduCancellationSupport=false, ComIPduType=NORMAL:
        ComIPdu_0x114_Rx: ComIPduDirection=RECEIVE, ComIPduHandleId=COM_RXPDU_Com_0x114_Signal_Routing_Rx, ComIPduSignalProcessing=IMMEDIATE, ComPduIdRef=Com_0x114_Signal_Routing_Rx, ComIPduGroupRef=ComIPduGroup_Rx, ComIPduSignalRef=ComSignal_Signal_1_Led_Sts_Rx, ComIPduSignalRef=ComSignal_Signal_2_Led_LiangDu_Rx, ComIPduSignalRef=ComSignal_Signal_3_Led_Red_Rx, ComIPduSignalRef=ComSignal_Signal_4_Led_Sts_Rx, ComIPduSignalRef=ComSignal_Signal_5_Led_LiangDu_Rx, ComIPduSignalRef=ComSignal_Signal_6_Led_Red_Rx
        ComIPdu_0x114_Tx: ComIPduDirection=SEND, ComIPduHandleId=COM_TXPDU_Com_0x114_Signal_Routing_Tx, ComIPduSignalProcessing=DEFERRED, ComPduIdRef=Com_0x114_Signal_Routing_Tx, ComIPduGroupRef=ComIPduGroup_Tx, ComIPduSignalRef=ComSignal_Signal_1_Led_Sts_Tx, ComIPduSignalRef=ComSignal_Signal_2_Led_LiangDu_Tx, ComIPduSignalRef=ComSignal_Signal_3_Led_Red_Tx
          ComTxIPdu: ComMinimumDelayTime=0.0, ComTxIPduUnusedAreasDefault=0
            ComTxModeTrue
              ComTxMode: ComTxModeMode=PERIODIC, ComTxModeNumberOfRepetitions=0, ComTxModeRepetitionPeriod=0.0, ComTxModeTimeOffset=0.0, ComTxModeTimePeriod=0.1
        ComIPdu_0x115_Tx: ComIPduDirection=SEND, ComIPduHandleId=COM_TXPDU_Com_0x115_Signal_Routing_Tx, ComIPduSignalProcessing=DEFERRED, ComPduIdRef=Com_0x115_Signal_Routing_Tx, ComIPduGroupRef=ComIPduGroup_Tx, ComIPduSignalRef=ComSignal_Signal_4_Led_Sts_Tx, ComIPduSignalRef=ComSignal_Signal_5_Led_LiangDu_Tx, ComIPduSignalRef=ComSignal_Signal_6_Led_Red_Tx
          ComTxIPdu: ComMinimumDelayTime=0.0, ComTxIPduUnusedAreasDefault=0
            ComTxModeTrue
              ComTxMode: ComTxModeMode=PERIODIC, ComTxModeNumberOfRepetitions=0, ComTxModeRepetitionPeriod=0.0, ComTxModeTimeOffset=0.0, ComTxModeTimePeriod=0.1
      12 x ComSignal, all with ComBitSize=8, ComInvalidNotification=NULL_PTR, ComRxDataTimeoutAction=NONE, ComSignalEndianness=BIG_ENDIAN, ComSignalInitValue=0x00, ComSignalLength=0, ComSignalType=UINT8, ComTransferProperty=PENDING:
        ComSignal_Signal_1_Led_Sts_Rx: ComBitPosition=0, ComHandleId=ComConf_ComSignal_ComSignal_Signal_1_Led_Sts_Rx
        ComSignal_Signal_2_Led_LiangDu_Rx: ComBitPosition=8, ComHandleId=ComConf_ComSignal_ComSignal_Signal_2_Led_LiangDu_Rx
        ComSignal_Signal_3_Led_Red_Rx: ComBitPosition=16, ComHandleId=ComConf_ComSignal_ComSignal_Signal_3_Led_Red_Rx
        ComSignal_Signal_4_Led_Sts_Rx: ComBitPosition=24, ComHandleId=ComConf_ComSignal_ComSignal_Signal_4_Led_Sts_Rx
        ComSignal_Signal_5_Led_LiangDu_Rx: ComBitPosition=32, ComHandleId=ComConf_ComSignal_ComSignal_Signal_5_Led_LiangDu_Rx
        ComSignal_Signal_6_Led_Red_Rx: ComBitPosition=40, ComHandleId=ComConf_ComSignal_ComSignal_Signal_6_Led_Red_Rx
        ComSignal_Signal_1_Led_Sts_Tx: ComBitPosition=0, ComHandleId=ComConf_ComSignal_ComSignal_Signal_1_Led_Sts_Tx
        ComSignal_Signal_2_Led_LiangDu_Tx: ComBitPosition=8, ComHandleId=ComConf_ComSignal_ComSignal_Signal_2_Led_LiangDu_Tx
        ComSignal_Signal_3_Led_Red_Tx: ComBitPosition=16, ComHandleId=ComConf_ComSignal_ComSignal_Signal_3_Led_Red_Tx
        ComSignal_Signal_4_Led_Sts_Tx: ComBitPosition=0, ComHandleId=ComConf_ComSignal_ComSignal_Signal_4_Led_Sts_Tx
        ComSignal_Signal_5_Led_LiangDu_Tx: ComBitPosition=8, ComHandleId=ComConf_ComSignal_ComSignal_Signal_5_Led_LiangDu_Tx
        ComSignal_Signal_6_Led_Red_Tx: ComBitPosition=16, ComHandleId=ComConf_ComSignal_ComSignal_Signal_6_Led_Red_Tx
      6 x ComGwMapping:
        ComGwMapping_Signal_1_Led_Sts
          ComGwDestination_0 (ComGwDestination)
            ComGwSignal: ComGwSignalRef=ComSignal_Signal_1_Led_Sts_Tx
          ComGwSource
            ComGwSignal: ComGwSignalRef=ComSignal_Signal_1_Led_Sts_Rx
        ComGwMapping_Signal_2_Led_LiangDu
          ComGwDestination_0 (ComGwDestination)
            ComGwSignal: ComGwSignalRef=ComSignal_Signal_2_Led_LiangDu_Tx
          ComGwSource
            ComGwSignal: ComGwSignalRef=ComSignal_Signal_2_Led_LiangDu_Rx
        ComGwMapping_Signal_3_Led_Red
          ComGwDestination_0 (ComGwDestination)
            ComGwSignal: ComGwSignalRef=ComSignal_Signal_3_Led_Red_Tx
          ComGwSource
            ComGwSignal: ComGwSignalRef=ComSignal_Signal_3_Led_Red_Rx
        ComGwMapping_Signal_4_Led_Sts
          ComGwDestination_0 (ComGwDestination)
            ComGwSignal: ComGwSignalRef=ComSignal_Signal_4_Led_Sts_Tx
          ComGwSource
            ComGwSignal: ComGwSignalRef=ComSignal_Signal_4_Led_Sts_Rx
        ComGwMapping_Signal_5_Led_LiangDu
          ComGwDestination_0 (ComGwDestination)
            ComGwSignal: ComGwSignalRef=ComSignal_Signal_5_Led_LiangDu_Tx
          ComGwSource
            ComGwSignal: ComGwSignalRef=ComSignal_Signal_5_Led_LiangDu_Rx
        ComGwMapping_Signal_6_Led_Red
          ComGwDestination_0 (ComGwDestination)
            ComGwSignal: ComGwSignalRef=ComSignal_Signal_6_Led_Red_Tx
          ComGwSource
            ComGwSignal: ComGwSignalRef=ComSignal_Signal_6_Led_Red_Rx
      ComMainFunctionRouteSignals_0 (ComMainFunctionRouteSignals): ComMainRouteSignalsTimeBase=0.05
      CAN0_Tx_0x300_Cyclic_CONTROLLER_0_S32K312_Tx (ComIPdu):
        ComIPduCancellationSupport = false
        ComIPduDirection = SEND
        ComIPduHandleId = COM_TXPDU_COM_CAN0_Tx_0x300_Cyclic_CONTROLLER_0_S32K312_Tx
        ComIPduSignalProcessing = DEFERRED
        ComIPduType = NORMAL
        ComPduIdRef = COM_CAN0_Tx_0x300_Cyclic_CONTROLLER_0_S32K312_Tx
        ComIPduSignalRef = Sig_Tx_UB_CAN0_Tx_0x300_Cyclic_CONTROLLER_0_S32K312_Tx
        ComIPduSignalRef = Sig_Tx_Data_CAN0_Tx_0x300_Cyclic_CONTROLLER_0_S32K312_Tx
        ComIPduGroupRef = ComIPduGroup_Tx
        ComTxIPdu: ComMinimumDelayTime=0.0, ComTxIPduUnusedAreasDefault=0
          ComTxModeTrue
            ComTxMode: ComTxModeMode=PERIODIC, ComTxModeNumberOfRepetitions=0, ComTxModeRepetitionPeriod=0.0, ComTxModeTimeOffset=0.0, ComTxModeTimePeriod=0.5
      Sig_Tx_UB_CAN0_Tx_0x300_Cyclic_CONTROLLER_0_S32K312_Tx (ComSignal):
        ComBitPosition = 7
        ComBitSize = 1
        ComHandleId = ComConf_ComSignal_Sig_Tx_UB_CAN0_Tx_0x300_Cyclic_CONTROLLER_0_S32K312_Tx
        ComInvalidNotification = NULL_PTR
        ComRxDataTimeoutAction = NONE
        ComSignalEndianness = BIG_ENDIAN
        ComSignalInitValue = 0x0
        ComSignalLength = 0
        ComSignalType = BOOLEAN
        ComTransferProperty = PENDING
        ComSignalDataInvalidValue = 0x0
        ComDataInvalidAction = NOTIFY
      Sig_Tx_Data_CAN0_Tx_0x300_Cyclic_CONTROLLER_0_S32K312_Tx (ComSignal):
        ComBitPosition = 16
        ComBitSize = 16
        ComHandleId = ComConf_ComSignal_Sig_Tx_Data_CAN0_Tx_0x300_Cyclic_CONTROLLER_0_S32K312_Tx
        ComInvalidNotification = NULL_PTR
        ComRxDataTimeoutAction = NONE
        ComSignalEndianness = BIG_ENDIAN
        ComSignalInitValue = 0x0
        ComSignalLength = 0
        ComSignalType = UINT16
        ComTransferProperty = PENDING
        ComSignalDataInvalidValue = 0x0
        ComDataInvalidAction = NOTIFY
      CAN0_Tx_0x301_Event_CONTROLLER_0_S32K312_Tx (ComIPdu):
        ComIPduCancellationSupport = false
        ComIPduDirection = SEND
        ComIPduHandleId = COM_TXPDU_COM_CAN0_Tx_0x301_Event_CONTROLLER_0_S32K312_Tx
        ComIPduSignalProcessing = IMMEDIATE
        ComIPduType = NORMAL
        ComPduIdRef = COM_CAN0_Tx_0x301_Event_CONTROLLER_0_S32K312_Tx
        ComIPduSignalRef = Sig_Tx_EventStatus_CAN0_Tx_0x301_Event_CONTROLLER_0_S32K312_Tx
        ComIPduGroupRef = ComIPduGroup_Tx
        ComTxIPdu: ComMinimumDelayTime=0.0, ComTxIPduUnusedAreasDefault=0
          ComTxModeTrue
            ComTxMode: ComTxModeMode=DIRECT, ComTxModeNumberOfRepetitions=0, ComTxModeRepetitionPeriod=0.0, ComTxModeTimeOffset=0.0, ComTxModeTimePeriod=0.0
      Sig_Tx_EventStatus_CAN0_Tx_0x301_Event_CONTROLLER_0_S32K312_Tx (ComSignal):
        ComBitPosition = 0
        ComBitSize = 8
        ComHandleId = ComConf_ComSignal_Sig_Tx_EventStatus_CAN0_Tx_0x301_Event_CONTROLLER_0_S32K312_Tx
        ComInvalidNotification = NULL_PTR
        ComRxDataTimeoutAction = NONE
        ComSignalEndianness = BIG_ENDIAN
        ComSignalInitValue = 0x0
        ComSignalLength = 0
        ComSignalType = UINT8
        ComTransferProperty = TRIGGERED_ON_CHANGE_WITHOUT_REPETITION
        ComSignalDataInvalidValue = 0x0
        ComDataInvalidAction = NOTIFY
      CAN0_Tx_0x302_Mixed_CONTROLLER_0_S32K312_Tx (ComIPdu):
        ComIPduCancellationSupport = false
        ComIPduDirection = SEND
        ComIPduHandleId = COM_TXPDU_COM_CAN0_Tx_0x302_Mixed_CONTROLLER_0_S32K312_Tx
        ComIPduSignalProcessing = IMMEDIATE
        ComIPduType = NORMAL
        ComPduIdRef = COM_CAN0_Tx_0x302_Mixed_CONTROLLER_0_S32K312_Tx
        ComIPduSignalRef = Sig_Tx_MixedData_CAN0_Tx_0x302_Mixed_CONTROLLER_0_S32K312_Tx
        ComIPduGroupRef = ComIPduGroup_Tx
        ComTxIPdu: ComMinimumDelayTime=0.0, ComTxIPduUnusedAreasDefault=0
          ComTxModeTrue
            ComTxMode: ComTxModeMode=MIXED, ComTxModeNumberOfRepetitions=2, ComTxModeRepetitionPeriod=0.05, ComTxModeTimeOffset=0.01, ComTxModeTimePeriod=0.5
      Sig_Tx_MixedData_CAN0_Tx_0x302_Mixed_CONTROLLER_0_S32K312_Tx (ComSignal):
        ComBitPosition = 8
        ComBitSize = 16
        ComHandleId = ComConf_ComSignal_Sig_Tx_MixedData_CAN0_Tx_0x302_Mixed_CONTROLLER_0_S32K312_Tx
        ComInvalidNotification = NULL_PTR
        ComRxDataTimeoutAction = NONE
        ComSignalEndianness = BIG_ENDIAN
        ComSignalInitValue = 0x0
        ComSignalLength = 0
        ComSignalType = UINT16
        ComTransferProperty = TRIGGERED
        ComSignalDataInvalidValue = 0x0
        ComDataInvalidAction = NOTIFY
      CAN0_Tx_0x303_Cyclic_Counter_CONTROLLER_0_S32K312_Tx (ComIPdu):
        ComIPduCancellationSupport = false
        ComIPduDirection = SEND
        ComIPduHandleId = COM_TXPDU_COM_CAN0_Tx_0x303_Cyclic_Counter_CONTROLLER_0_S32K312_Tx
        ComIPduSignalProcessing = DEFERRED
        ComIPduType = NORMAL
        ComPduIdRef = COM_CAN0_Tx_0x303_Cyclic_Counter_CONTROLLER_0_S32K312_Tx
        ComIPduSignalRef = Sig_Tx_RollingCounter_CAN0_Tx_0x303_Cyclic_Counter_CONTROLLER_0_S32K312_Tx
        ComIPduSignalRef = Sig_Tx_CounterData_CAN0_Tx_0x303_Cyclic_Counter_CONTROLLER_0_S32K312_Tx
        ComIPduGroupRef = ComIPduGroup_Tx
        ComTxIPdu: ComMinimumDelayTime=0.0, ComTxIPduUnusedAreasDefault=0
          ComTxModeTrue
            ComTxMode: ComTxModeMode=PERIODIC, ComTxModeNumberOfRepetitions=0, ComTxModeRepetitionPeriod=0.0, ComTxModeTimeOffset=0.0, ComTxModeTimePeriod=0.5
      Sig_Tx_RollingCounter_CAN0_Tx_0x303_Cyclic_Counter_CONTROLLER_0_S32K312_Tx (ComSignal):
        ComBitPosition = 4
        ComBitSize = 4
        ComHandleId = ComConf_ComSignal_Sig_Tx_RollingCounter_CAN0_Tx_0x303_Cyclic_Counter_CONTROLLER_0_S32K312_Tx
        ComInvalidNotification = NULL_PTR
        ComRxDataTimeoutAction = NONE
        ComSignalEndianness = BIG_ENDIAN
        ComSignalInitValue = 0x0
        ComSignalLength = 0
        ComSignalType = UINT8
        ComTransferProperty = PENDING
        ComSignalDataInvalidValue = 0x0
        ComDataInvalidAction = NOTIFY
      Sig_Tx_CounterData_CAN0_Tx_0x303_Cyclic_Counter_CONTROLLER_0_S32K312_Tx (ComSignal):
        ComBitPosition = 16
        ComBitSize = 16
        ComHandleId = ComConf_ComSignal_Sig_Tx_CounterData_CAN0_Tx_0x303_Cyclic_Counter_CONTROLLER_0_S32K312_Tx
        ComInvalidNotification = NULL_PTR
        ComRxDataTimeoutAction = NONE
        ComSignalEndianness = BIG_ENDIAN
        ComSignalInitValue = 0x0
        ComSignalLength = 0
        ComSignalType = UINT16
        ComTransferProperty = PENDING
        ComSignalDataInvalidValue = 0x0
        ComDataInvalidAction = NOTIFY
      CAN0_Tx_0x350_Cyclic_PN17_CONTROLLER_0_S32K312_Tx (ComIPdu):
        ComIPduCancellationSupport = false
        ComIPduDirection = SEND
        ComIPduHandleId = COM_TXPDU_COM_CAN0_Tx_0x350_Cyclic_PN17_CONTROLLER_0_S32K312_Tx
        ComIPduSignalProcessing = DEFERRED
        ComIPduType = NORMAL
        ComPduIdRef = COM_CAN0_Tx_0x350_Cyclic_PN17_CONTROLLER_0_S32K312_Tx
        ComIPduSignalRef = Sig_Tx_PN17_Data_CAN0_Tx_0x350_Cyclic_PN17_CONTROLLER_0_S32K312_Tx
        ComIPduGroupRef = ComIPduGroup_Tx
        ComTxIPdu: ComMinimumDelayTime=0.0, ComTxIPduUnusedAreasDefault=0
          ComTxModeTrue
            ComTxMode: ComTxModeMode=PERIODIC, ComTxModeNumberOfRepetitions=0, ComTxModeRepetitionPeriod=0.0, ComTxModeTimeOffset=0.0, ComTxModeTimePeriod=0.1
      Sig_Tx_PN17_Data_CAN0_Tx_0x350_Cyclic_PN17_CONTROLLER_0_S32K312_Tx (ComSignal):
        ComBitPosition = 8
        ComBitSize = 16
        ComHandleId = ComConf_ComSignal_Sig_Tx_PN17_Data_CAN0_Tx_0x350_Cyclic_PN17_CONTROLLER_0_S32K312_Tx
        ComInvalidNotification = NULL_PTR
        ComRxDataTimeoutAction = NONE
        ComSignalEndianness = BIG_ENDIAN
        ComSignalInitValue = 0x0
        ComSignalLength = 0
        ComSignalType = UINT16
        ComTransferProperty = PENDING
        ComSignalDataInvalidValue = 0x0
        ComDataInvalidAction = NOTIFY
      CAN0_Tx_0x351_Cyclic_PN29_CONTROLLER_0_S32K312_Tx (ComIPdu):
        ComIPduCancellationSupport = false
        ComIPduDirection = SEND
        ComIPduHandleId = COM_TXPDU_COM_CAN0_Tx_0x351_Cyclic_PN29_CONTROLLER_0_S32K312_Tx
        ComIPduSignalProcessing = DEFERRED
        ComIPduType = NORMAL
        ComPduIdRef = COM_CAN0_Tx_0x351_Cyclic_PN29_CONTROLLER_0_S32K312_Tx
        ComIPduSignalRef = Sig_Tx_PN29_Data_CAN0_Tx_0x351_Cyclic_PN29_CONTROLLER_0_S32K312_Tx
        ComIPduGroupRef = ComIPduGroup_Tx
        ComTxIPdu: ComMinimumDelayTime=0.0, ComTxIPduUnusedAreasDefault=0
          ComTxModeTrue
            ComTxMode: ComTxModeMode=PERIODIC, ComTxModeNumberOfRepetitions=0, ComTxModeRepetitionPeriod=0.0, ComTxModeTimeOffset=0.0, ComTxModeTimePeriod=0.1
      Sig_Tx_PN29_Data_CAN0_Tx_0x351_Cyclic_PN29_CONTROLLER_0_S32K312_Tx (ComSignal):
        ComBitPosition = 8
        ComBitSize = 16
        ComHandleId = ComConf_ComSignal_Sig_Tx_PN29_Data_CAN0_Tx_0x351_Cyclic_PN29_CONTROLLER_0_S32K312_Tx
        ComInvalidNotification = NULL_PTR
        ComRxDataTimeoutAction = NONE
        ComSignalEndianness = BIG_ENDIAN
        ComSignalInitValue = 0x0
        ComSignalLength = 0
        ComSignalType = UINT16
        ComTransferProperty = PENDING
        ComSignalDataInvalidValue = 0x0
        ComDataInvalidAction = NOTIFY
      CAN0_Tx_0x360_E2E_P01_CONTROLLER_0_S32K312_Tx (ComIPdu):
        ComIPduCancellationSupport = false
        ComIPduDirection = SEND
        ComIPduHandleId = COM_TXPDU_COM_CAN0_Tx_0x360_E2E_P01_CONTROLLER_0_S32K312_Tx
        ComIPduSignalProcessing = DEFERRED
        ComIPduType = NORMAL
        ComPduIdRef = COM_CAN0_Tx_0x360_E2E_P01_CONTROLLER_0_S32K312_Tx
        ComIPduSignalRef = Sig_Tx_E2E_CRC_CAN0_Tx_0x360_E2E_P01_CONTROLLER_0_S32K312_Tx
        ComIPduSignalRef = Sig_Tx_E2E_Counter_CAN0_Tx_0x360_E2E_P01_CONTROLLER_0_S32K312_Tx
        ComIPduSignalRef = Sig_Tx_E2E_Data_CAN0_Tx_0x360_E2E_P01_CONTROLLER_0_S32K312_Tx
        ComIPduGroupRef = ComIPduGroup_Tx
        ComTxIPdu: ComMinimumDelayTime=0.0, ComTxIPduUnusedAreasDefault=0
          ComTxModeTrue
            ComTxMode: ComTxModeMode=PERIODIC, ComTxModeNumberOfRepetitions=0, ComTxModeRepetitionPeriod=0.0, ComTxModeTimeOffset=0.0, ComTxModeTimePeriod=0.1
      3 x ComSignal, all with ComInvalidNotification=NULL_PTR, ComRxDataTimeoutAction=NONE, ComSignalEndianness=BIG_ENDIAN, ComSignalInitValue=0x0, ComSignalLength=0, ComTransferProperty=PENDING, ComSignalDataInvalidValue=0x0, ComDataInvalidAction=NOTIFY:
        Sig_Tx_E2E_CRC_CAN0_Tx_0x360_E2E_P01_CONTROLLER_0_S32K312_Tx: ComBitPosition=0, ComBitSize=8, ComHandleId=ComConf_ComSignal_Sig_Tx_E2E_CRC_CAN0_Tx_0x360_E2E_P01_CONTROLLER_0_S32K312_Tx, ComSignalType=UINT8
        Sig_Tx_E2E_Counter_CAN0_Tx_0x360_E2E_P01_CONTROLLER_0_S32K312_Tx: ComBitPosition=12, ComBitSize=4, ComHandleId=ComConf_ComSignal_Sig_Tx_E2E_Counter_CAN0_Tx_0x360_E2E_P01_CONTROLLER_0_S32K312_Tx, ComSignalType=UINT8
        Sig_Tx_E2E_Data_CAN0_Tx_0x360_E2E_P01_CONTROLLER_0_S32K312_Tx: ComBitPosition=40, ComBitSize=32, ComHandleId=ComConf_ComSignal_Sig_Tx_E2E_Data_CAN0_Tx_0x360_E2E_P01_CONTROLLER_0_S32K312_Tx, ComSignalType=UINT32
      CAN0_Rx_0x200_Cyclic_CONTROLLER_0_S32K312_Rx (ComIPdu):
        ComIPduCancellationSupport = false
        ComIPduDirection = RECEIVE
        ComIPduHandleId = COM_RXPDU_COM_CAN0_Rx_0x200_Cyclic_CONTROLLER_0_S32K312_Rx
        ComIPduSignalProcessing = DEFERRED
        ComIPduType = NORMAL
        ComPduIdRef = COM_CAN0_Rx_0x200_Cyclic_CONTROLLER_0_S32K312_Rx
        ComIPduSignalRef = Sig_Rx_UB_CAN0_Rx_0x200_Cyclic_CONTROLLER_0_S32K312_Rx
        ComIPduSignalRef = Sig_Rx_Data_CAN0_Rx_0x200_Cyclic_CONTROLLER_0_S32K312_Rx
        ComIPduGroupRef = ComIPduGroup_Rx
      Sig_Rx_UB_CAN0_Rx_0x200_Cyclic_CONTROLLER_0_S32K312_Rx (ComSignal):
        ComBitPosition = 7
        ComBitSize = 1
        ComHandleId = ComConf_ComSignal_Sig_Rx_UB_CAN0_Rx_0x200_Cyclic_CONTROLLER_0_S32K312_Rx
        ComInvalidNotification = NULL_PTR
        ComRxDataTimeoutAction = NONE
        ComSignalEndianness = BIG_ENDIAN
        ComSignalInitValue = 0x0
        ComSignalLength = 0
        ComSignalType = BOOLEAN
        ComTransferProperty = PENDING
        ComSignalDataInvalidValue = 0x0
        ComDataInvalidAction = NOTIFY
      Sig_Rx_Data_CAN0_Rx_0x200_Cyclic_CONTROLLER_0_S32K312_Rx (ComSignal):
        ComBitPosition = 16
        ComBitSize = 16
        ComHandleId = ComConf_ComSignal_Sig_Rx_Data_CAN0_Rx_0x200_Cyclic_CONTROLLER_0_S32K312_Rx
        ComInvalidNotification = NULL_PTR
        ComRxDataTimeoutAction = NONE
        ComSignalEndianness = BIG_ENDIAN
        ComSignalInitValue = 0x0
        ComSignalLength = 0
        ComSignalType = UINT16
        ComTransferProperty = PENDING
        ComSignalDataInvalidValue = 0x0
        ComDataInvalidAction = NOTIFY
      CAN0_Rx_0x203_Cyclic_Counter_CONTROLLER_0_S32K312_Rx (ComIPdu):
        ComIPduCancellationSupport = false
        ComIPduDirection = RECEIVE
        ComIPduHandleId = COM_RXPDU_COM_CAN0_Rx_0x203_Cyclic_Counter_CONTROLLER_0_S32K312_Rx
        ComIPduSignalProcessing = DEFERRED
        ComIPduType = NORMAL
        ComPduIdRef = COM_CAN0_Rx_0x203_Cyclic_Counter_CONTROLLER_0_S32K312_Rx
        ComIPduSignalRef = Sig_Rx_RollingCounter_CAN0_Rx_0x203_Cyclic_Counter_CONTROLLER_0_S32K312_Rx
        ComIPduSignalRef = Sig_Rx_CounterData_CAN0_Rx_0x203_Cyclic_Counter_CONTROLLER_0_S32K312_Rx
        ComIPduGroupRef = ComIPduGroup_Rx
      Sig_Rx_RollingCounter_CAN0_Rx_0x203_Cyclic_Counter_CONTROLLER_0_S32K312_Rx (ComSignal):
        ComBitPosition = 4
        ComBitSize = 4
        ComHandleId = ComConf_ComSignal_Sig_Rx_RollingCounter_CAN0_Rx_0x203_Cyclic_Counter_CONTROLLER_0_S32K312_Rx
        ComInvalidNotification = NULL_PTR
        ComRxDataTimeoutAction = NONE
        ComSignalEndianness = BIG_ENDIAN
        ComSignalInitValue = 0x0
        ComSignalLength = 0
        ComSignalType = UINT8
        ComTransferProperty = PENDING
        ComSignalDataInvalidValue = 0x0
        ComDataInvalidAction = NOTIFY
      Sig_Rx_CounterData_CAN0_Rx_0x203_Cyclic_Counter_CONTROLLER_0_S32K312_Rx (ComSignal):
        ComBitPosition = 16
        ComBitSize = 16
        ComHandleId = ComConf_ComSignal_Sig_Rx_CounterData_CAN0_Rx_0x203_Cyclic_Counter_CONTROLLER_0_S32K312_Rx
        ComInvalidNotification = NULL_PTR
        ComRxDataTimeoutAction = NONE
        ComSignalEndianness = BIG_ENDIAN
        ComSignalInitValue = 0x0
        ComSignalLength = 0
        ComSignalType = UINT16
        ComTransferProperty = PENDING
        ComSignalDataInvalidValue = 0x0
        ComDataInvalidAction = NOTIFY
      CAN0_Rx_0x201_Event_CONTROLLER_0_S32K312_Rx (ComIPdu):
        ComIPduCancellationSupport = false
        ComIPduDirection = RECEIVE
        ComIPduHandleId = COM_RXPDU_COM_CAN0_Rx_0x201_Event_CONTROLLER_0_S32K312_Rx
        ComIPduSignalProcessing = DEFERRED
        ComIPduType = NORMAL
        ComPduIdRef = COM_CAN0_Rx_0x201_Event_CONTROLLER_0_S32K312_Rx
        ComIPduSignalRef = Sig_Rx_EventStatus_CAN0_Rx_0x201_Event_CONTROLLER_0_S32K312_Rx
        ComIPduGroupRef = ComIPduGroup_Rx
      Sig_Rx_EventStatus_CAN0_Rx_0x201_Event_CONTROLLER_0_S32K312_Rx (ComSignal):
        ComBitPosition = 0
        ComBitSize = 8
        ComHandleId = ComConf_ComSignal_Sig_Rx_EventStatus_CAN0_Rx_0x201_Event_CONTROLLER_0_S32K312_Rx
        ComInvalidNotification = NULL_PTR
        ComRxDataTimeoutAction = NONE
        ComSignalEndianness = BIG_ENDIAN
        ComSignalInitValue = 0x0
        ComSignalLength = 0
        ComSignalType = UINT8
        ComTransferProperty = PENDING
        ComSignalDataInvalidValue = 0x0
        ComDataInvalidAction = NOTIFY
      CAN0_Rx_0x250_Cyclic_PN17_CONTROLLER_0_S32K312_Rx (ComIPdu):
        ComIPduCancellationSupport = false
        ComIPduDirection = RECEIVE
        ComIPduHandleId = COM_RXPDU_COM_CAN0_Rx_0x250_Cyclic_PN17_CONTROLLER_0_S32K312_Rx
        ComIPduSignalProcessing = DEFERRED
        ComIPduType = NORMAL
        ComPduIdRef = COM_CAN0_Rx_0x250_Cyclic_PN17_CONTROLLER_0_S32K312_Rx
        ComIPduSignalRef = Sig_Rx_PN17_Data_CAN0_Rx_0x250_Cyclic_PN17_CONTROLLER_0_S32K312_Rx
        ComIPduGroupRef = ComIPduGroup_Rx
      Sig_Rx_PN17_Data_CAN0_Rx_0x250_Cyclic_PN17_CONTROLLER_0_S32K312_Rx (ComSignal):
        ComBitPosition = 8
        ComBitSize = 16
        ComHandleId = ComConf_ComSignal_Sig_Rx_PN17_Data_CAN0_Rx_0x250_Cyclic_PN17_CONTROLLER_0_S32K312_Rx
        ComInvalidNotification = NULL_PTR
        ComRxDataTimeoutAction = NONE
        ComSignalEndianness = BIG_ENDIAN
        ComSignalInitValue = 0x0
        ComSignalLength = 0
        ComSignalType = UINT16
        ComTransferProperty = PENDING
        ComSignalDataInvalidValue = 0x0
        ComDataInvalidAction = NOTIFY
      CAN0_Rx_0x202_Mixed_CONTROLLER_0_S32K312_Rx (ComIPdu):
        ComIPduCancellationSupport = false
        ComIPduDirection = RECEIVE
        ComIPduHandleId = COM_RXPDU_COM_CAN0_Rx_0x202_Mixed_CONTROLLER_0_S32K312_Rx
        ComIPduSignalProcessing = DEFERRED
        ComIPduType = NORMAL
        ComPduIdRef = COM_CAN0_Rx_0x202_Mixed_CONTROLLER_0_S32K312_Rx
        ComIPduSignalRef = Sig_Rx_MixedData_CAN0_Rx_0x202_Mixed_CONTROLLER_0_S32K312_Rx
        ComIPduGroupRef = ComIPduGroup_Rx
      Sig_Rx_MixedData_CAN0_Rx_0x202_Mixed_CONTROLLER_0_S32K312_Rx (ComSignal):
        ComBitPosition = 8
        ComBitSize = 16
        ComHandleId = ComConf_ComSignal_Sig_Rx_MixedData_CAN0_Rx_0x202_Mixed_CONTROLLER_0_S32K312_Rx
        ComInvalidNotification = NULL_PTR
        ComRxDataTimeoutAction = NONE
        ComSignalEndianness = BIG_ENDIAN
        ComSignalInitValue = 0x0
        ComSignalLength = 0
        ComSignalType = UINT16
        ComTransferProperty = PENDING
        ComSignalDataInvalidValue = 0x0
        ComDataInvalidAction = NOTIFY
