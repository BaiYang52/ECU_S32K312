AUTOSAR XML (schema 00048)
package /S32K3XX
  module config Com
    ComGeneral:
      ComCancellationSupport = true
      ComConfigurationUseDet = false
      ComVersionInfoApi = false
      ComEnableMDTForCyclicTransmission = true
      ComEnableSignalGroupArrayApi = false
      ComMetaDataSupport = false
      ComRetryFailedTransmitRequests = false
      ComSupportedIPduGroups = 2
      ComConfigType = PC_CONFIG
    ComConfig
      ComIPdu_0x110 (ComIPdu):
        ComIPduCancellationSupport = false
        ComIPduDirection = SEND
        ComIPduHandleId = COM_TXPDU_Com_0x110_Tx
        ComIPduSignalProcessing = DEFERRED
        ComIPduType = NORMAL
        ComIPduCallout = ComIPdu_0x110_Tx
        ComPduIdRef = Com_0x110_Tx
        ComIPduGroupRef = ComIPduGroup_Tx
        ComTxIPdu: ComMinimumDelayTime=0.0, ComTxIPduUnusedAreasDefault=0
          ComTxModeTrue
            ComTxMode: ComTxModeMode=PERIODIC, ComTxModeNumberOfRepetitions=0, ComTxModeRepetitionPeriod=0.0, ComTxModeTimeOffset=0.0, ComTxModeTimePeriod=0.1
      ComIPdu_0x12a (ComIPdu):
        ComIPduCancellationSupport = false
        ComIPduDirection = RECEIVE
        ComIPduHandleId = COM_RXPDU_Com_0x12a_Rx
        ComIPduSignalProcessing = DEFERRED
        ComIPduType = NORMAL
        ComIPduCallout = ComIPdu_0x12a_Rx
        ComPduIdRef = Com_0x12a_Rx
        ComIPduGroupRef = ComIPduGroup_Rx
      ComIPduGroup_Tx (ComIPduGroup): ComIPduGroupHandleId=ComIPduGroup_Tx
      ComIPduGroup_Rx (ComIPduGroup): ComIPduGroupHandleId=ComIPduGroup_Rx
      ComMainFunctionRx_0 (ComMainFunctionRx): ComMainRxTimeBase=0.05
      ComMainFunctionTx_0 (ComMainFunctionTx): ComMainTxTimeBase=0.05
