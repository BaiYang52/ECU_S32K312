AUTOSAR XML (schema 00048)
package /S32K3XX
  module config Com
    ComGeneral:
      ComCancellationSupport = true
      ComConfigurationUseDet = false
      ComVersionInfoApi = false
      ComEnableMDTForCyclicTransmission = true
      ComEnableSignalGroupArrayApi = false
      ComMetaDataSupport = false
      ComRetryFailedTransmitRequests = false
      ComSupportedIPduGroups = 2
      ComConfigType = PC_CONFIG
    ComConfig
      ComIPdu_0x110_Tx (ComIPdu):
        ComIPduCancellationSupport = false
        ComIPduDirection = SEND
        ComIPduHandleId = COM_TXPDU_Com_0x110_Tx
        ComIPduSignalProcessing = DEFERRED
        ComIPduType = NORMAL
        ComIPduCallout = ComIPdu_0x110_Tx_Callout
        ComPduIdRef = Com_0x110_Tx
        ComIPduGroupRef = ComIPduGroup_Tx
        ComIPduSignalRef = ComSignal_0_Tx
        ComTxIPdu: ComMinimumDelayTime=0.0, ComTxIPduUnusedAreasDefault=0
          ComTxModeTrue
            ComTxMode: ComTxModeMode=PERIODIC, ComTxModeNumberOfRepetitions=0, ComTxModeRepetitionPeriod=0.0, ComTxModeTimeOffset=0.0, ComTxModeTimePeriod=0.1
      ComIPdu_0x12a_Rx (ComIPdu):
        ComIPduCancellationSupport = false
        ComIPduDirection = RECEIVE
        ComIPduHandleId = COM_RXPDU_Com_0x12a_Rx
        ComIPduSignalProcessing = DEFERRED
        ComIPduType = NORMAL
        ComIPduCallout = ComIPdu_0x12a_Rx_Callout
        ComPduIdRef = Com_0x12a_Rx
        ComIPduGroupRef = ComIPduGroup_Rx
        ComIPduSignalRef = ComSignal_1_Rx
      ComIPduGroup_Tx (ComIPduGroup): ComIPduGroupHandleId=ComIPduGroup_Tx
      ComIPduGroup_Rx (ComIPduGroup): ComIPduGroupHandleId=ComIPduGroup_Rx
      ComMainFunctionRx_0 (ComMainFunctionRx): ComMainRxTimeBase=0.05
      ComMainFunctionTx_0 (ComMainFunctionTx): ComMainTxTimeBase=0.05
      ComSignal_0_Tx (ComSignal):
        ComBitPosition = 0
        ComBitSize = 8
        ComHandleId = ComConf_ComSignal_ComSignal_0_Tx
        ComInvalidNotification = NULL_PTR
        ComRxDataTimeoutAction = NONE
        ComSignalEndianness = BIG_ENDIAN
        ComSignalInitValue = 0x00
        ComSignalLength = 0
        ComSignalType = UINT8
        ComTransferProperty = PENDING
      ComSignal_1_Rx (ComSignal):
        ComBitPosition = 0
        ComBitSize = 8
        ComHandleId = ComConf_ComSignal_ComSignal_1_Rx
        ComInvalidNotification = NULL_PTR
        ComRxDataTimeoutAction = NONE
        ComSignalEndianness = BIG_ENDIAN
        ComSignalInitValue = 0x00
        ComSignalLength = 0
        ComSignalType = UINT8
        ComTransferProperty = PENDING
      3 x ComIPdu, all with ComIPduCancellationSupport=false, ComIPduSignalProcessing=DEFERRED, ComIPduType=NORMAL:
        ComIPdu_0x114_Rx: ComIPduDirection=RECEIVE, ComIPduHandleId=COM_RXPDU_Com_0x114_Signal_Routing_Rx, ComPduIdRef=Com_0x114_Signal_Routing_Rx
        ComIPdu_0x114_Tx: ComIPduDirection=SEND, ComIPduHandleId=COM_TXPDU_Com_0x114_Signal_Routing_Tx, ComPduIdRef=Com_0x114_Signal_Routing_Tx
          ComTxIPdu: ComMinimumDelayTime=0, ComTxIPduUnusedAreasDefault=0
            ComTxModeTrue
              ComTxMode: ComTxModeMode=PERIODIC, ComTxModeNumberOfRepetitions=0, ComTxModeRepetitionPeriod=0.0, ComTxModeTimeOffset=0.0, ComTxModeTimePeriod=0.1
        ComIPdu_0x115_Tx: ComIPduDirection=SEND, ComIPduHandleId=COM_TXPDU_Com_0x115_Signal_Routing_Tx, ComPduIdRef=Com_0x115_Signal_Routing_Tx
          ComTxIPdu: ComMinimumDelayTime=0, ComTxIPduUnusedAreasDefault=0
            ComTxModeTrue
              ComTxMode: ComTxModeMode=PERIODIC, ComTxModeNumberOfRepetitions=0, ComTxModeRepetitionPeriod=0.0, ComTxModeTimeOffset=0.0, ComTxModeTimePeriod=0.1
