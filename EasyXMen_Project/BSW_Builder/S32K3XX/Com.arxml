AUTOSAR XML (schema 00048)
package /S32K3XX
  module config Com
    ComGeneral:
      ComCancellationSupport = true
      ComConfigurationUseDet = false
      ComVersionInfoApi = false
      ComEnableMDTForCyclicTransmission = true
      ComEnableSignalGroupArrayApi = false
      ComMetaDataSupport = false
      ComRetryFailedTransmitRequests = false
      ComSupportedIPduGroups = 2
      ComConfigType = PC_CONFIG
    ComConfig
      ComIPdu_0x110_Tx (ComIPdu):
        ComIPduCancellationSupport = false
        ComIPduDirection = SEND
        ComIPduHandleId = COM_TXPDU_Com_0x110_Tx
        ComIPduSignalProcessing = DEFERRED
        ComIPduType = NORMAL
        ComIPduCallout = ComIPdu_0x110_Tx_Callout
        ComPduIdRef = Com_0x110_Tx
        ComIPduGroupRef = ComIPduGroup_Tx
        ComIPduSignalRef = ComSignal_0_Tx
        ComTxIPdu: ComMinimumDelayTime=0.0, ComTxIPduUnusedAreasDefault=0
          ComTxModeTrue
            ComTxMode: ComTxModeMode=PERIODIC, ComTxModeNumberOfRepetitions=0, ComTxModeRepetitionPeriod=0.0, ComTxModeTimeOffset=0.0, ComTxModeTimePeriod=0.1
      ComIPdu_0x12a_Rx (ComIPdu):
        ComIPduCancellationSupport = false
        ComIPduDirection = RECEIVE
        ComIPduHandleId = COM_RXPDU_Com_0x12a_Rx
        ComIPduSignalProcessing = DEFERRED
        ComIPduType = NORMAL
        ComIPduCallout = ComIPdu_0x12a_Rx_Callout
        ComPduIdRef = Com_0x12a_Rx
        ComIPduGroupRef = ComIPduGroup_Rx
        ComIPduSignalRef = ComSignal_1_Rx
      ComIPduGroup_Tx (ComIPduGroup): ComIPduGroupHandleId=ComIPduGroup_Tx
      ComIPduGroup_Rx (ComIPduGroup): ComIPduGroupHandleId=ComIPduGroup_Rx
      ComMainFunctionRx_0 (ComMainFunctionRx): ComMainRxTimeBase=0.05
      ComMainFunctionTx_0 (ComMainFunctionTx): ComMainTxTimeBase=0.05
      ComSignal_0_Tx (ComSignal):
        ComBitPosition = 0
        ComBitSize = 8
        ComHandleId = ComConf_ComSignal_ComSignal_0_Tx
        ComInvalidNotification = NULL_PTR
        ComRxDataTimeoutAction = NONE
        ComSignalEndianness = BIG_ENDIAN
        ComSignalInitValue = 0x00
        ComSignalLength = 0
        ComSignalType = UINT8
        ComTransferProperty = PENDING
      ComSignal_1_Rx (ComSignal):
        ComBitPosition = 0
        ComBitSize = 8
        ComHandleId = ComConf_ComSignal_ComSignal_1_Rx
        ComInvalidNotification = NULL_PTR
        ComRxDataTimeoutAction = NONE
        ComSignalEndianness = BIG_ENDIAN
        ComSignalInitValue = 0x00
        ComSignalLength = 0
        ComSignalType = UINT8
        ComTransferProperty = PENDING
      3 x ComIPdu, all with ComIPduCancellationSupport=false, ComIPduSignalProcessing=DEFERRED, ComIPduType=NORMAL:
        ComIPdu_0x114_Rx: ComIPduDirection=RECEIVE, ComIPduHandleId=COM_RXPDU_Com_0x114_Signal_Routing_Rx, ComPduIdRef=Com_0x114_Signal_Routing_Rx, ComIPduGroupRef=ComIPduGroup_Rx, ComIPduSignalRef=ComSignal_Signal_1_Led_Sts_Rx, ComIPduSignalRef=ComSignal_Signal_2_Led_LiangDu_Rx, ComIPduSignalRef=ComSignal_Signal_3_Led_Red_Rx, ComIPduSignalRef=ComSignal_Signal_4_Led_Sts_Rx, ComIPduSignalRef=ComSignal_Signal_5_Led_LiangDu_Rx, ComIPduSignalRef=ComSignal_Signal_6_Led_Red_Rx
        ComIPdu_0x114_Tx: ComIPduDirection=SEND, ComIPduHandleId=COM_TXPDU_Com_0x114_Signal_Routing_Tx, ComPduIdRef=Com_0x114_Signal_Routing_Tx, ComIPduGroupRef=ComIPduGroup_Tx, ComIPduSignalRef=ComSignal_Signal_1_Led_Sts_Tx, ComIPduSignalRef=ComSignal_Signal_2_Led_LiangDu_Tx, ComIPduSignalRef=ComSignal_Signal_3_Led_Red_Tx
          ComTxIPdu: ComMinimumDelayTime=0, ComTxIPduUnusedAreasDefault=0
            ComTxModeTrue
              ComTxMode: ComTxModeMode=PERIODIC, ComTxModeNumberOfRepetitions=0, ComTxModeRepetitionPeriod=0.0, ComTxModeTimeOffset=0.0, ComTxModeTimePeriod=0.1
        ComIPdu_0x115_Tx: ComIPduDirection=SEND, ComIPduHandleId=COM_TXPDU_Com_0x115_Signal_Routing_Tx, ComPduIdRef=Com_0x115_Signal_Routing_Tx, ComIPduGroupRef=ComIPduGroup_Tx, ComIPduSignalRef=ComSignal_Signal_4_Led_Sts_Tx, ComIPduSignalRef=ComSignal_Signal_5_Led_LiangDu_Tx, ComIPduSignalRef=ComSignal_Signal_6_Led_Red_Tx
          ComTxIPdu: ComMinimumDelayTime=0, ComTxIPduUnusedAreasDefault=0
            ComTxModeTrue
              ComTxMode: ComTxModeMode=PERIODIC, ComTxModeNumberOfRepetitions=0, ComTxModeRepetitionPeriod=0.0, ComTxModeTimeOffset=0.0, ComTxModeTimePeriod=0.1
      12 x ComSignal, all with ComBitSize=8, ComInvalidNotification=NULL_PTR, ComRxDataTimeoutAction=NONE, ComSignalEndianness=BIG_ENDIAN, ComSignalInitValue=0x00, ComSignalLength=0, ComSignalType=UINT8, ComTransferProperty=PENDING:
        ComSignal_Signal_1_Led_Sts_Rx: ComBitPosition=0, ComHandleId=ComConf_ComSignal_ComSignal_Signal_1_Led_Sts_Rx
        ComSignal_Signal_2_Led_LiangDu_Rx: ComBitPosition=8, ComHandleId=ComConf_ComSignal_ComSignal_Signal_2_Led_LiangDu_Rx
        ComSignal_Signal_3_Led_Red_Rx: ComBitPosition=16, ComHandleId=ComConf_ComSignal_ComSignal_Signal_3_Led_Red_Rx
        ComSignal_Signal_4_Led_Sts_Rx: ComBitPosition=24, ComHandleId=ComConf_ComSignal_ComSignal_Signal_4_Led_Sts_Rx
        ComSignal_Signal_5_Led_LiangDu_Rx: ComBitPosition=32, ComHandleId=ComConf_ComSignal_ComSignal_Signal_5_Led_LiangDu_Rx
        ComSignal_Signal_6_Led_Red_Rx: ComBitPosition=40, ComHandleId=ComConf_ComSignal_ComSignal_Signal_6_Led_Red_Rx
        ComSignal_Signal_1_Led_Sts_Tx: ComBitPosition=0, ComHandleId=ComConf_ComSignal_ComSignal_Signal_1_Led_Sts_Tx
        ComSignal_Signal_2_Led_LiangDu_Tx: ComBitPosition=8, ComHandleId=ComConf_ComSignal_ComSignal_Signal_2_Led_LiangDu_Tx
        ComSignal_Signal_3_Led_Red_Tx: ComBitPosition=16, ComHandleId=ComConf_ComSignal_ComSignal_Signal_3_Led_Red_Tx
        ComSignal_Signal_4_Led_Sts_Tx: ComBitPosition=0, ComHandleId=ComConf_ComSignal_ComSignal_Signal_4_Led_Sts_Tx
        ComSignal_Signal_5_Led_LiangDu_Tx: ComBitPosition=8, ComHandleId=ComConf_ComSignal_ComSignal_Signal_5_Led_LiangDu_Tx
        ComSignal_Signal_6_Led_Red_Tx: ComBitPosition=16, ComHandleId=ComConf_ComSignal_ComSignal_Signal_6_Led_Red_Tx
      6 x ComGwMapping:
        ComGwMapping_Signal_1_Led_Sts
          ComGwDestination_0 (ComGwDestination)
            ComGwSignal: ComGwSignalRef=ComSignal_Signal_1_Led_Sts_Tx
          ComGwSource
            ComGwSignal: ComGwSignalRef=ComSignal_Signal_1_Led_Sts_Rx
        ComGwMapping_Signal_2_Led_LiangDu
          ComGwDestination_0 (ComGwDestination)
            ComGwSignal: ComGwSignalRef=ComSignal_Signal_2_Led_LiangDu_Tx
          ComGwSource
            ComGwSignal: ComGwSignalRef=ComSignal_Signal_2_Led_LiangDu_Rx
        ComGwMapping_Signal_3_Led_Red
          ComGwDestination_0 (ComGwDestination)
            ComGwSignal: ComGwSignalRef=ComSignal_Signal_3_Led_Red_Tx
          ComGwSource
            ComGwSignal: ComGwSignalRef=ComSignal_Signal_3_Led_Red_Rx
        ComGwMapping_Signal_4_Led_Sts
          ComGwDestination_0 (ComGwDestination)
            ComGwSignal: ComGwSignalRef=ComSignal_Signal_4_Led_Sts_Tx
          ComGwSource
            ComGwSignal: ComGwSignalRef=ComSignal_Signal_4_Led_Sts_Rx
        ComGwMapping_Signal_5_Led_LiangDu
          ComGwDestination_0 (ComGwDestination)
            ComGwSignal: ComGwSignalRef=ComSignal_Signal_5_Led_LiangDu_Tx
          ComGwSource
            ComGwSignal: ComGwSignalRef=ComSignal_Signal_5_Led_LiangDu_Rx
        ComGwMapping_Signal_6_Led_Red
          ComGwDestination_0 (ComGwDestination)
            ComGwSignal: ComGwSignalRef=ComSignal_Signal_6_Led_Red_Tx
          ComGwSource
            ComGwSignal: ComGwSignalRef=ComSignal_Signal_6_Led_Red_Rx
      ComMainFunctionRouteSignals_0 (ComMainFunctionRouteSignals): ComMainRouteSignalsTimeBase=0.05
