AUTOSAR XML (schema 00048)
package /S32K3XX
  module config ComM
    ComMConfigSet
      ComMChannel_0 (ComMChannel):
        ComMBusType = COMM_BUS_TYPE_CAN
        ComMChannelId = 0
        ComMFullCommRequestNotificationEnabled = false
        ComMMainFunctionPeriod = 0.005
        ComMNoCom = false
        ComMNoWakeup = false
        ComMPncBitVectorLength = 0
        ComMNetworkManagement: ComMNmVariant=NONE, ComMPncNmRequest=false
        ComMUserPerChannel_0 (ComMUserPerChannel): ComMUserChannel=ComMUser_0
      ComMUser_0 (ComMUser): ComMUserIdentifier=0, ComMCurrentModeNotificationEnabled=false
    ComMGeneral:
      ComMDevErrorDetect = false
      ComMEcuGroupClassification = 3
      ComMModeLimitationEnabled = false
      ComMPncSupport = false
      ComMResetAfterForcingNoComm = false
      ComMSynchronousWakeUp = true
      ComMVersionInfoApi = false
      ComMWakeupInhibitionEnabled = false
      ComMDcmEnabled = false
