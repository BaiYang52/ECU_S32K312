AUTOSAR XML (schema 00048)
package /S32K3XX
  module config ComM
    ComMConfigSet
      ComMChannel_0 (ComMChannel):
        ComMBusType = 
        ComMChannelId = 0
        ComMFullCommRequestNotificationEnabled = false
        ComMMainFunctionPeriod = 0.02
        ComMNoCom = false
        ComMNoWakeup = false
        ComMPncBitVectorLength = 0
        ComMNetworkManagement: ComMNmVariant=FULL, ComMPncNmRequest=false
    ComMGeneral:
      ComMDevErrorDetect = false
      ComMEcuGroupClassification = 3
      ComMModeLimitationEnabled = false
      ComMPncSupport = false
      ComMResetAfterForcingNoComm = false
      ComMSynchronousWakeUp = true
      ComMVersionInfoApi = false
      ComMWakeupInhibitionEnabled = false
      ComMDcmEnabled = false
