AUTOSAR XML (schema 00048)
package /S32K3XX
  module config Crc
    CrcGeneral: Crc8Mode=CRC_8_TABLE
