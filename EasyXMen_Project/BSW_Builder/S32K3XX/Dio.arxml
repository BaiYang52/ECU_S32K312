AUTOSAR XML (schema 00048)
package /S32K3XX
  module config Dio: implementation-config-variant=VARIANT-PRE-COMPILE
    CommonPublishedInformation:
      ArReleaseMajorVersion = 4
      ArReleaseMinorVersion = 7
      ArReleaseRevisionVersion = 0
      ModuleId = 120
      SwMajorVersion = 4
      SwMinorVersion = 0
      SwPatchVersion = 0
      VendorId = 43
    DioConfig
      10 x DioPort:
        DioPort_PTA_L: index=0, DioPortId=0
          DioChannel_0 (DioChannel): index=0, DioChannelId=0, PDACSlot=VIRTUAL_WRAPPER_PDAC0
        DioPort_PTA_H: index=1, DioPortId=1
        DioPort_PTB_L: index=2, DioPortId=2
          DioChannel_PB10 (DioChannel): index=0, DioChannelId=10, PDACSlot=VIRTUAL_WRAPPER_PDAC0
        DioPort_PTB_H: index=3, DioPortId=3
        DioPort_PTC_L: index=4, DioPortId=4
        DioPort_PTC_H: index=5, DioPortId=5
        DioPort_PTD_L: index=6, DioPortId=6
        DioPort_PTD_H: index=7, DioPortId=7
        DioPort_PTE_L: index=8, DioPortId=8
        DioPort_PTE_H: index=9, DioPortId=9
    DioGeneral:
      DioDevErrorDetect = 0
      DioEnableUserModeSupport = 0
      DioFlipChannelApi = 1
      DioMaskedWritePortApi = 0
      DioMulticoreSupport = 0
      DioReadZeroForUndefinedPortPins = 0
      DioReversePortBits = 0
      DioVersionInfoApi = 0
      DioVirtWrapperSupport = 0
      SIUL2DioIPDevErrorDetect = 0
