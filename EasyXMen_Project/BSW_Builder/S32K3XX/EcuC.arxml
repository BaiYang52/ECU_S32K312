AUTOSAR XML (schema 00048)
package /S32K3XX
  module config EcuC
    EcuCGeneral: ByteOrder=LITTLE_ENDIAN
    EcucHardware
      EcucCoreDefinition: EcucCoreId=0
    EcucConfigSet
      EcucPduCollection: PduIdTypeEnum=UINT8, PduLengthTypeEnum=UINT16
        37 x Pdu:
          CanIf_0x110_Tx: PduLength=8
          Com_0x110_Tx: PduLength=8
          CanIf_0x12a_Rx: PduLength=8
          Com_0x12a_Rx: PduLength=8
          CanIf_0x119_Routing_Rx: PduLength=8
          Com_0x119_Routing_Rx: PduLength=8
          CanIf_0x119_Routing_Tx: PduLength=8
          CanIf_0x114_Signal_Routing_Rx: PduLength=8
          Com_0x114_Signal_Routing_Rx: PduLength=8
          CanIf_0x114_Signal_Routing_Tx: PduLength=4
          Com_0x114_Signal_Routing_Tx: PduLength=4
          CanIf_0x115_Signal_Routing_Tx: PduLength=4
          Com_0x115_Signal_Routing_Tx: PduLength=4
          COM_CAN0_Tx_0x300_Cyclic_CONTROLLER_0_S32K312_Tx: PduLength=8
          CANIF_CAN0_Tx_0x300_Cyclic_CONTROLLER_0_S32K312_Tx: PduLength=8
          COM_CAN0_Tx_0x301_Event_CONTROLLER_0_S32K312_Tx: PduLength=8
          CANIF_CAN0_Tx_0x301_Event_CONTROLLER_0_S32K312_Tx: PduLength=8
          COM_CAN0_Tx_0x302_Mixed_CONTROLLER_0_S32K312_Tx: PduLength=8
          CANIF_CAN0_Tx_0x302_Mixed_CONTROLLER_0_S32K312_Tx: PduLength=8
          COM_CAN0_Tx_0x303_Cyclic_Counter_CONTROLLER_0_S32K312_Tx: PduLength=8
          CANIF_CAN0_Tx_0x303_Cyclic_Counter_CONTROLLER_0_S32K312_Tx: PduLength=8
          COM_CAN0_Tx_0x350_Cyclic_PN17_CONTROLLER_0_S32K312_Tx: PduLength=8
          CANIF_CAN0_Tx_0x350_Cyclic_PN17_CONTROLLER_0_S32K312_Tx: PduLength=8
          COM_CAN0_Tx_0x351_Cyclic_PN29_CONTROLLER_0_S32K312_Tx: PduLength=8
          CANIF_CAN0_Tx_0x351_Cyclic_PN29_CONTROLLER_0_S32K312_Tx: PduLength=8
          COM_CAN0_Tx_0x360_E2E_P01_CONTROLLER_0_S32K312_Tx: PduLength=8
          CANIF_CAN0_Tx_0x360_E2E_P01_CONTROLLER_0_S32K312_Tx: PduLength=8
          COM_CAN0_Rx_0x200_Cyclic_CONTROLLER_0_S32K312_Rx: PduLength=8
          CANIF_CAN0_Rx_0x200_Cyclic_CONTROLLER_0_S32K312_Rx: PduLength=8
          COM_CAN0_Rx_0x203_Cyclic_Counter_CONTROLLER_0_S32K312_Rx: PduLength=8
          CANIF_CAN0_Rx_0x203_Cyclic_Counter_CONTROLLER_0_S32K312_Rx: PduLength=8
          COM_CAN0_Rx_0x201_Event_CONTROLLER_0_S32K312_Rx: PduLength=8
          CANIF_CAN0_Rx_0x201_Event_CONTROLLER_0_S32K312_Rx: PduLength=8
          COM_CAN0_Rx_0x250_Cyclic_PN17_CONTROLLER_0_S32K312_Rx: PduLength=8
          CANIF_CAN0_Rx_0x250_Cyclic_PN17_CONTROLLER_0_S32K312_Rx: PduLength=8
          COM_CAN0_Rx_0x202_Mixed_CONTROLLER_0_S32K312_Rx: PduLength=8
          CANIF_CAN0_Rx_0x202_Mixed_CONTROLLER_0_S32K312_Rx: PduLength=8
