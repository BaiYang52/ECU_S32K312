AUTOSAR XML (schema 00048)
package /S32K3XX
  module config EcuC
    EcuCGeneral: ByteOrder=LITTLE_ENDIAN
    EcucHardware
      EcucCoreDefinition: EcucCoreId=0
    EcucConfigSet
      EcucPduCollection: PduIdTypeEnum=UINT16, PduLengthTypeEnum=UINT16
        7 x Pdu, all with PduLength=8:
          CanIf_0x110_Tx
          Com_0x110_Tx
          CanIf_0x12a_Rx
          Com_0x12a_Rx
          CanIf_0x119_Routing_Rx
          Com_0x119_Routing_Rx
          CanIf_0x119_Routing_Tx
