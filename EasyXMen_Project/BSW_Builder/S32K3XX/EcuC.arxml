AUTOSAR XML (schema 00048)
package /S32K3XX
  module config EcuC
    EcuCGeneral: ByteOrder=LITTLE_ENDIAN
    EcucHardware
      EcucCoreDefinition: EcucCoreId=0
    EcucConfigSet
      EcucPduCollection: PduIdTypeEnum=UINT16, PduLengthTypeEnum=UINT16
        4 x Pdu, all with PduLength=8:
          Canif_0x110_Tx
          Canif_0x12a_Rx
          Com_0x110_Tx
          Com_0x12a_Rx
