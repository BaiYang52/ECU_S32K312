AUTOSAR XML (schema 00048)
package /S32K3XX
  module config EcuC
    EcuCGeneral: ByteOrder=LITTLE_ENDIAN
    EcucHardware
      EcucCoreDefinition: EcucCoreId=0
    EcucConfigSet
      EcucPduCollection: PduIdTypeEnum=UINT16, PduLengthTypeEnum=UINT16
        13 x Pdu:
          CanIf_0x110_Tx: PduLength=8
          Com_0x110_Tx: PduLength=8
          CanIf_0x12a_Rx: PduLength=8
          Com_0x12a_Rx: PduLength=8
          CanIf_0x119_Routing_Rx: PduLength=8
          Com_0x119_Routing_Rx: PduLength=8
          CanIf_0x119_Routing_Tx: PduLength=8
          CanIf_0x114_Signal_Routing_Rx: PduLength=8
          Com_0x114_Signal_Routing_Rx: PduLength=8
          CanIf_0x114_Signal_Routing_Tx: PduLength=4
          Com_0x114_Signal_Routing_Tx: PduLength=4
          CanIf_0x115_Signal_Routing_Tx: PduLength=4
          Com_0x115_Signal_Routing_Tx: PduLength=4
