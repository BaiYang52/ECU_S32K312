AUTOSAR XML (schema 00048)
package /S32K3XX
  module config EcuM
    EcuMConfiguration
      EcuMCommonConfiguration: EcuMConfigConsistencyHash=1234, EcuMIgnoreWakeupEvValOffPreOS=false, EcuMOSResource=RES_SCHEDULER_CORE
        EcuMDefaultShutdownTarget: EcuMDefaultShutdownTarget=EcuMShutdownTargetOff
        EcuMWakeupSource: EcuMWakeupSourceId=6, EcuMWakeupSourcePolling=false, EcuMComMChannelRef=ComMChannel_0
        EcuMDriverInitListOne
          EcuMDriverInitItem_0 (EcuMDriverInitItem):
            EcuMModuleParameter = VOID
            EcuMModuleService = Can_Init
            EditModuleService = false
            EcuMModulePbConfigName = Null
            EditPbConfigName = false
            IncludeHeaderFile = Can.h
            EditHeaderFile = false
            EcuMModuleRef = Can
      EcuMFlexConfiguration: EcuMTimerSrcSelect=GPT, EcuMNormalMcuModeRef=McuModeSettingConf_0
        EcuMFlexUserConfig_0 (EcuMFlexUserConfig): EcuMFlexUser=0
        EcuMResetMode_0 (EcuMResetMode): EcuMResetModeId=0
        EcuMShutdownCause_0 (EcuMShutdownCause): EcuMShutdownCauseId=0
        EcuMDriverInitListBswM_0 (EcuMDriverInitListBswM)
          EcuMDriverInitItem_0 (EcuMDriverInitItem):
            EcuMModuleParameter = VOID
            EcuMModuleService = CanIf_Init
            EditModuleService = false
            EcuMModulePbConfigName = Null
            EditPbConfigName = false
            IncludeHeaderFile = CanIf.h
            EditHeaderFile = false
            EcuMModuleRef = CanIf
    EcuMFlexGeneral: EcuMAlarmClockPresent=false, EcuMModeHandling=false
    EcuMGeneral: EcuMDevErrorDetect=false, EcuMMainFunctionPeriod=0.01, EcuMVersionInfoApi=false, EcuMCloneVariableSupport=false
