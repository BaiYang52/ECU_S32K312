AUTOSAR XML (schema 00048)
package /S32K3XX
  module config Gpt: implementation-config-variant=VARIANT-POST-BUILD
    CommonPublishedInformation:
      ArReleaseMajorVersion = 4
      ArReleaseMinorVersion = 7
      ArReleaseRevisionVersion = 0
      ModuleId = 100
      SwMajorVersion = 4
      SwMinorVersion = 0
      SwPatchVersion = 0
      VendorId = 43
    GptAutosarExt: ChainModeApi=0, GptChangeNextTimeoutValueApi=0, GptEnableDualClockMode=0, GptEnableUserModeSupport=0, GptStandbyWakeupSupport=0
    GptChannelConfigSet
      GptChannelConfiguration_0 (GptChannelConfiguration):
        index = 0
        GptChannelId = 0
        GptChannelMode = GPT_CH_MODE_CONTINUOUS
        GptChannelTickFrequency = 3.0E7
        GptChannelTickValueMax = 4294967295
        GptEnableWakeup = 0
        GptHwIp = PIT
        GptNotification = GptNotification_Pit0Ch0
        GptChannelClkSrcRef = GptClockReferencePoint_0
        GptModuleRef = GptPitChannels_0
      GptPit_0 (GptPit): GptPitModule=PIT_0, PitFreezeEnable=1
        GptPitChannels_0 (GptPitChannels): index=0, ChainMode=0, GptPitChannel=CH_0
    GptConfigurationOfOptApiServices:
      GptDeinitApi = 1
      GptEnableDisableNotificationApi = 1
      GptPredefTimerFunctionalityApi = 1
      GptTimeElapsedApi = 1
      GptTimeRemainingApi = 1
      GptVersionInfoApi = 0
      GptWakeupFunctionalityApi = 0
    GptDriverConfiguration:
      GptDevErrorDetect = 0
      GptMulticoreSupport = 0
      GptPredefTimer100us32bitEnable = 0
      GptPredefTimer1usEnablingGrade = GPT_PREDEF_TIMER_1US_DISABLED
      GptReportWakeupSource = 0
      GptTimeoutDuration = 800
      GptTimeoutMethod = OSIF_COUNTER_DUMMY
      GptClockReferencePoint_0 (GptClockReferencePoint): GptClockReference=McuClockReferencePoint_AIPS_SLOW
    32 x GptHwConfiguration:
      GptHwConfiguration_{0..3}: index={0..3}, GptChannelIsUsed=0, GptIsrEnable=0, GptIsrHwId=STM_0_CH_{0..3}
      GptHwConfiguration_4: index=4, GptChannelIsUsed=0, GptIsrEnable=0, GptIsrHwId=PIT_0_CH_RTI
      GptHwConfiguration_5: index=5, GptChannelIsUsed=1, GptIsrEnable=1, GptIsrHwId=PIT_0_CH_0
      GptHwConfiguration_6: index=6, GptChannelIsUsed=1, GptIsrEnable=1, GptIsrHwId=PIT_0_CH_1
      GptHwConfiguration_7: index=7, GptChannelIsUsed=0, GptIsrEnable=0, GptIsrHwId=PIT_0_CH_2
      GptHwConfiguration_8: index=8, GptChannelIsUsed=0, GptIsrEnable=0, GptIsrHwId=PIT_0_CH_3
      GptHwConfiguration_9: index=9, GptChannelIsUsed=0, GptIsrEnable=0, GptIsrHwId=PIT_1_CH_0
      GptHwConfiguration_10: index=10, GptChannelIsUsed=0, GptIsrEnable=0, GptIsrHwId=PIT_1_CH_1
      GptHwConfiguration_11: index=11, GptChannelIsUsed=0, GptIsrEnable=0, GptIsrHwId=PIT_1_CH_2
      GptHwConfiguration_12: index=12, GptChannelIsUsed=0, GptIsrEnable=0, GptIsrHwId=PIT_1_CH_3
      GptHwConfiguration_13: index=13, GptChannelIsUsed=0, GptIsrEnable=0, GptIsrHwId=EMIOS_0_CH_0
      GptHwConfiguration_14: index=14, GptChannelIsUsed=0, GptIsrEnable=0, GptIsrHwId=EMIOS_0_CH_1
      GptHwConfiguration_15: index=15, GptChannelIsUsed=0, GptIsrEnable=0, GptIsrHwId=EMIOS_0_CH_2
      GptHwConfiguration_16: index=16, GptChannelIsUsed=0, GptIsrEnable=0, GptIsrHwId=EMIOS_0_CH_3
      GptHwConfiguration_17: index=17, GptChannelIsUsed=0, GptIsrEnable=0, GptIsrHwId=EMIOS_0_CH_4
      GptHwConfiguration_18: index=18, GptChannelIsUsed=0, GptIsrEnable=0, GptIsrHwId=EMIOS_0_CH_5
      GptHwConfiguration_19: index=19, GptChannelIsUsed=0, GptIsrEnable=0, GptIsrHwId=EMIOS_0_CH_6
      GptHwConfiguration_20: index=20, GptChannelIsUsed=0, GptIsrEnable=0, GptIsrHwId=EMIOS_0_CH_7
      GptHwConfiguration_21: index=21, GptChannelIsUsed=0, GptIsrEnable=0, GptIsrHwId=EMIOS_0_CH_8
      GptHwConfiguration_22: index=22, GptChannelIsUsed=0, GptIsrEnable=0, GptIsrHwId=EMIOS_0_CH_16
      GptHwConfiguration_23: index=23, GptChannelIsUsed=0, GptIsrEnable=0, GptIsrHwId=EMIOS_0_CH_22
      GptHwConfiguration_24: index=24, GptChannelIsUsed=0, GptIsrEnable=0, GptIsrHwId=EMIOS_0_CH_23
      GptHwConfiguration_25: index=25, GptChannelIsUsed=0, GptIsrEnable=0, GptIsrHwId=EMIOS_1_CH_0
      GptHwConfiguration_26: index=26, GptChannelIsUsed=0, GptIsrEnable=0, GptIsrHwId=EMIOS_1_CH_8
      GptHwConfiguration_27: index=27, GptChannelIsUsed=0, GptIsrEnable=0, GptIsrHwId=EMIOS_1_CH_16
      GptHwConfiguration_28: index=28, GptChannelIsUsed=0, GptIsrEnable=0, GptIsrHwId=EMIOS_1_CH_22
      GptHwConfiguration_29: index=29, GptChannelIsUsed=0, GptIsrEnable=0, GptIsrHwId=EMIOS_1_CH_23
      GptHwConfiguration_30: index=30, GptChannelIsUsed=0, GptIsrEnable=0, GptIsrHwId=RTC_0_CH_0
      GptHwConfiguration_31: index=31, GptChannelIsUsed=0, GptIsrEnable=0, GptIsrHwId=STM_0_PREDEF
    GptPredefTimerConfiguration
