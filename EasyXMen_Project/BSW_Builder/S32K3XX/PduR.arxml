AUTOSAR XML (schema 00048)
package /S32K3XX
  module config PduR
    PduRGeneral: PduRConfigType=PC_CONFIG, PduRDevErrorDetect=false, PduRMetaDataSupport=false, PduRVersionInfoApi=false, PduRZeroCostOperation=false
    PduRRoutingPaths: PduRConfigurationId=0, PduRMaxRoutingPathCnt=20, PduRMaxRoutingPathGroupCnt=0, PduRMaxRoutingTableCnt=1
      PduRSrcPdu_0x110_Tx (PduRSrcPdu): PduRSourcePduHandleId=0, PduRSrcPduUpTxConf=true, PduRSrcPduRef=Com_0x110_Tx
      PduRSrcPdu_0x12a_Rx (PduRSrcPdu): PduRSourcePduHandleId=1, PduRSrcPduUpTxConf=true, PduRSrcPduRef=Canif_0x12a_Rx
      PduRDestPdu_0x110_Tx (PduRDestPdu): PduRDestPduDataProvision=PDUR_DIRECT, PduRDestPduHandleId=0, PduRTransmissionConfirmation=true, PduRDestPduRef=Canif_0x110_Tx
      PduRDestPdu_0x12a_Rx (PduRDestPdu): PduRDestPduDataProvision=PDUR_DIRECT, PduRDestPduHandleId=1, PduRTransmissionConfirmation=true, PduRDestPduRef=Com_0x12a_Rx
      PduRRoutingPath_0x110_Tx (PduRRoutingPath): PduRRouteType=IF, PduRDestPduRRef=PduRDestPdu_0x110_Tx, PduRSrcPduRRef=PduRSrcPdu_0x110_Tx
      PduRRoutingPath_0x12a_Rx (PduRRoutingPath): PduRRouteType=IF, PduRDestPduRRef=PduRDestPdu_0x12a_Rx, PduRSrcPduRRef=PduRSrcPdu_0x12a_Rx
    PduRBswModules_0 (PduRBswModules):
      PduRCancelReceive = false
      PduRCancelTransmit = false
      PduRCommunicationInterface = true
      PduRCopyRxData = false
      PduRCopyTxData = false
      PduRLowerModule = true
      PduRRetransmission = false
      PduRRxIndication = true
      PduRStartOfReception = false
      PduRTpRxIndication = false
      PduRTpTransmit = false
      PduRTpTxConfirmation = false
      PduRTransmit = true
      PduRTransportProtocol = false
      PduRTriggertransmit = true
      PduRTxConfirmation = true
      PduRUpperModule = false
      PduRBswModuleRef = CanIf
    PduRBswModules_1 (PduRBswModules):
      PduRCancelReceive = true
      PduRCancelTransmit = true
      PduRCommunicationInterface = true
      PduRCopyRxData = true
      PduRCopyTxData = true
      PduRLowerModule = false
      PduRRetransmission = false
      PduRRxIndication = true
      PduRStartOfReception = true
      PduRTpRxIndication = true
      PduRTpTransmit = false
      PduRTpTxConfirmation = true
      PduRTransmit = true
      PduRTransportProtocol = true
      PduRTriggertransmit = true
      PduRTxConfirmation = true
      PduRUpperModule = true
      PduRBswModuleRef = Com
