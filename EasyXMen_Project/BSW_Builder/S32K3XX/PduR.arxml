AUTOSAR XML (schema 00048)
package /S32K3XX
  module config PduR
    PduRGeneral: PduRConfigType=PC_CONFIG, PduRDevErrorDetect=false, PduRMetaDataSupport=false, PduRVersionInfoApi=false, PduRZeroCostOperation=false
    PduRRoutingPaths: PduRConfigurationId=0, PduRMaxRoutingPathCnt=20, PduRMaxRoutingPathGroupCnt=0, PduRMaxRoutingTableCnt=1
      PduRRoutingPath_0x110_Tx (PduRRoutingPath): PduRRouteType=IF, PduRDestPduRRef=PduRDestPdu_0x110_Tx, PduRSrcPduRRef=PduRSrcPdu_0x110_Tx
      PduRRoutingPath_0x12a_Rx (PduRRoutingPath): PduRRouteType=IF, PduRDestPduRRef=PduRDestPdu_0x12a_Rx, PduRSrcPduRRef=PduRSrcPdu_0x12a_Rx
      PduRDestPdu_0x110_Tx (PduRDestPdu): PduRDestPduDataProvision=PDUR_DIRECT, PduRDestPduHandleId=0, PduRTransmissionConfirmation=true, PduRDestPduRef=CanIf_0x110_Tx
      PduRDestPdu_0x12a_Rx (PduRDestPdu): PduRDestPduDataProvision=PDUR_DIRECT, PduRDestPduHandleId=1, PduRTransmissionConfirmation=true, PduRDestPduRef=Com_0x12a_Rx
      3 x PduRSrcPdu, all with PduRSrcPduUpTxConf=true:
        PduRSrcPdu_0x110_Tx: PduRSourcePduHandleId=0, PduRSrcPduRef=Com_0x110_Tx
        PduRSrcPdu_0x12a_Rx: PduRSourcePduHandleId=1, PduRSrcPduRef=CanIf_0x12a_Rx
        PduRSrcPdu_0x119_Routing_Rx: PduRSourcePduHandleId=2, PduRSrcPduRef=CanIf_0x119_Routing_Rx
      PduRRoutingPath_0x119_Routing_Rx_Tx (PduRRoutingPath): PduRRouteType=IF, PduRDestPduRRef=PduRDestPdu_0x119_Routing_Tx, PduRSrcPduRRef=PduRSrcPdu_0x119_Routing_Rx
      PduRDestPdu_0x119_Routing_Tx (PduRDestPdu): PduRDestPduDataProvision=PDUR_DIRECT, PduRDestPduHandleId=2, PduRTransmissionConfirmation=true, PduRDestPduRef=CanIf_0x119_Routing_Tx
      PduRSrcPdu_0x114_SignalRouting_Rx (PduRSrcPdu): PduRSourcePduHandleId=3, PduRSrcPduUpTxConf=true, PduRSrcPduRef=CanIf_0x114_Signal_Routing_Rx
      PduRSrcPdu_0x114_SignalRouting_Tx (PduRSrcPdu): PduRSourcePduHandleId=4, PduRSrcPduUpTxConf=true, PduRSrcPduRef=Com_0x114_Signal_Routing_Tx
      PduRDestPdu_0x114_SignalRouting_Rx (PduRDestPdu): PduRDestPduDataProvision=PDUR_DIRECT, PduRDestPduHandleId=3, PduRTransmissionConfirmation=true, PduRDestPduRef=Com_0x114_Signal_Routing_Rx
      PduRSrcPdu_0x115_SignalRouting_Tx (PduRSrcPdu): PduRSourcePduHandleId=5, PduRSrcPduUpTxConf=true, PduRSrcPduRef=Com_0x115_Signal_Routing_Tx
      PduRDestPdu_0x114_SignalRouting_Tx (PduRDestPdu): PduRDestPduDataProvision=PDUR_DIRECT, PduRDestPduHandleId=4, PduRTransmissionConfirmation=true, PduRDestPduRef=CanIf_0x114_Signal_Routing_Tx
      PduRDestPdu_0x115_SignalRouting_Tx (PduRDestPdu): PduRDestPduDataProvision=PDUR_DIRECT, PduRDestPduHandleId=5, PduRTransmissionConfirmation=true, PduRDestPduRef=CanIf_0x115_Signal_Routing_Tx
      4 x PduRRoutingPath, all with PduRRouteType=IF:
        PduRRoutingPath_0x114_SignalRouting_Rx: PduRDestPduRRef=PduRDestPdu_0x114_SignalRouting_Rx, PduRSrcPduRRef=PduRSrcPdu_0x114_SignalRouting_Rx
        PduRRoutingPath_0x114_SignalRouting_Tx: PduRDestPduRRef=PduRDestPdu_0x114_SignalRouting_Tx, PduRSrcPduRRef=PduRSrcPdu_0x114_SignalRouting_Tx
        PduRRoutingPath_0x115_SignalRouting_Tx: PduRDestPduRRef=PduRDestPdu_0x115_SignalRouting_Tx, PduRSrcPduRRef=PduRSrcPdu_0x115_SignalRouting_Tx
        PDUR_ROUTING_CAN0_Tx_0x300_Cyclic_CONTROLLER_0_S32K312_Tx: PduRDestPduRRef=PduRDestPdu_CAN0_Tx_0x300_Cyclic_CONTROLLER_0_S32K312_Tx, PduRSrcPduRRef=PduRSrcPdu_CAN0_Tx_0x300_Cyclic_CONTROLLER_0_S32K312_Tx
      PduRSrcPdu_CAN0_Tx_0x300_Cyclic_CONTROLLER_0_S32K312_Tx (PduRSrcPdu): PduRSourcePduHandleId=6, PduRSrcPduUpTxConf=true, PduRSrcPduRef=COM_CAN0_Tx_0x300_Cyclic_CONTROLLER_0_S32K312_Tx
      PduRDestPdu_CAN0_Tx_0x300_Cyclic_CONTROLLER_0_S32K312_Tx (PduRDestPdu):
        PduRDestPduDataProvision = PDUR_DIRECT
        PduRDestPduHandleId = 6
        PduRTransmissionConfirmation = true
        PduRDestPduRef = CANIF_CAN0_Tx_0x300_Cyclic_CONTROLLER_0_S32K312_Tx
      PDUR_ROUTING_CAN0_Tx_0x301_Event_CONTROLLER_0_S32K312_Tx (PduRRoutingPath):
        PduRRouteType = IF
        PduRDestPduRRef = PduRDestPdu_CAN0_Tx_0x301_Event_CONTROLLER_0_S32K312_Tx
        PduRSrcPduRRef = PduRSrcPdu_CAN0_Tx_0x301_Event_CONTROLLER_0_S32K312_Tx
      PduRSrcPdu_CAN0_Tx_0x301_Event_CONTROLLER_0_S32K312_Tx (PduRSrcPdu): PduRSourcePduHandleId=7, PduRSrcPduUpTxConf=true, PduRSrcPduRef=COM_CAN0_Tx_0x301_Event_CONTROLLER_0_S32K312_Tx
      PduRDestPdu_CAN0_Tx_0x301_Event_CONTROLLER_0_S32K312_Tx (PduRDestPdu):
        PduRDestPduDataProvision = PDUR_DIRECT
        PduRDestPduHandleId = 7
        PduRTransmissionConfirmation = true
        PduRDestPduRef = CANIF_CAN0_Tx_0x301_Event_CONTROLLER_0_S32K312_Tx
      PDUR_ROUTING_CAN0_Tx_0x302_Mixed_CONTROLLER_0_S32K312_Tx (PduRRoutingPath):
        PduRRouteType = IF
        PduRDestPduRRef = PduRDestPdu_CAN0_Tx_0x302_Mixed_CONTROLLER_0_S32K312_Tx
        PduRSrcPduRRef = PduRSrcPdu_CAN0_Tx_0x302_Mixed_CONTROLLER_0_S32K312_Tx
      PduRSrcPdu_CAN0_Tx_0x302_Mixed_CONTROLLER_0_S32K312_Tx (PduRSrcPdu): PduRSourcePduHandleId=8, PduRSrcPduUpTxConf=true, PduRSrcPduRef=COM_CAN0_Tx_0x302_Mixed_CONTROLLER_0_S32K312_Tx
      PduRDestPdu_CAN0_Tx_0x302_Mixed_CONTROLLER_0_S32K312_Tx (PduRDestPdu):
        PduRDestPduDataProvision = PDUR_DIRECT
        PduRDestPduHandleId = 8
        PduRTransmissionConfirmation = true
        PduRDestPduRef = CANIF_CAN0_Tx_0x302_Mixed_CONTROLLER_0_S32K312_Tx
      PDUR_ROUTING_CAN0_Tx_0x303_Cyclic_Counter_CONTROLLER_0_S32K312_Tx (PduRRoutingPath):
        PduRRouteType = IF
        PduRDestPduRRef = PduRDestPdu_CAN0_Tx_0x303_Cyclic_Counter_CONTROLLER_0_S32K312_Tx
        PduRSrcPduRRef = PduRSrcPdu_CAN0_Tx_0x303_Cyclic_Counter_CONTROLLER_0_S32K312_Tx
      PduRSrcPdu_CAN0_Tx_0x303_Cyclic_Counter_CONTROLLER_0_S32K312_Tx (PduRSrcPdu): PduRSourcePduHandleId=9, PduRSrcPduUpTxConf=true, PduRSrcPduRef=COM_CAN0_Tx_0x303_Cyclic_Counter_CONTROLLER_0_S32K312_Tx
      PduRDestPdu_CAN0_Tx_0x303_Cyclic_Counter_CONTROLLER_0_S32K312_Tx (PduRDestPdu):
        PduRDestPduDataProvision = PDUR_DIRECT
        PduRDestPduHandleId = 9
        PduRTransmissionConfirmation = true
        PduRDestPduRef = CANIF_CAN0_Tx_0x303_Cyclic_Counter_CONTROLLER_0_S32K312_Tx
      PDUR_ROUTING_CAN0_Tx_0x350_Cyclic_PN17_CONTROLLER_0_S32K312_Tx (PduRRoutingPath):
        PduRRouteType = IF
        PduRDestPduRRef = PduRDestPdu_CAN0_Tx_0x350_Cyclic_PN17_CONTROLLER_0_S32K312_Tx
        PduRSrcPduRRef = PduRSrcPdu_CAN0_Tx_0x350_Cyclic_PN17_CONTROLLER_0_S32K312_Tx
      PduRSrcPdu_CAN0_Tx_0x350_Cyclic_PN17_CONTROLLER_0_S32K312_Tx (PduRSrcPdu): PduRSourcePduHandleId=10, PduRSrcPduUpTxConf=true, PduRSrcPduRef=COM_CAN0_Tx_0x350_Cyclic_PN17_CONTROLLER_0_S32K312_Tx
      PduRDestPdu_CAN0_Tx_0x350_Cyclic_PN17_CONTROLLER_0_S32K312_Tx (PduRDestPdu):
        PduRDestPduDataProvision = PDUR_DIRECT
        PduRDestPduHandleId = 10
        PduRTransmissionConfirmation = true
        PduRDestPduRef = CANIF_CAN0_Tx_0x350_Cyclic_PN17_CONTROLLER_0_S32K312_Tx
      PDUR_ROUTING_CAN0_Tx_0x351_Cyclic_PN29_CONTROLLER_0_S32K312_Tx (PduRRoutingPath):
        PduRRouteType = IF
        PduRDestPduRRef = PduRDestPdu_CAN0_Tx_0x351_Cyclic_PN29_CONTROLLER_0_S32K312_Tx
        PduRSrcPduRRef = PduRSrcPdu_CAN0_Tx_0x351_Cyclic_PN29_CONTROLLER_0_S32K312_Tx
      PduRSrcPdu_CAN0_Tx_0x351_Cyclic_PN29_CONTROLLER_0_S32K312_Tx (PduRSrcPdu): PduRSourcePduHandleId=11, PduRSrcPduUpTxConf=true, PduRSrcPduRef=COM_CAN0_Tx_0x351_Cyclic_PN29_CONTROLLER_0_S32K312_Tx
      PduRDestPdu_CAN0_Tx_0x351_Cyclic_PN29_CONTROLLER_0_S32K312_Tx (PduRDestPdu):
        PduRDestPduDataProvision = PDUR_DIRECT
        PduRDestPduHandleId = 11
        PduRTransmissionConfirmation = true
        PduRDestPduRef = CANIF_CAN0_Tx_0x351_Cyclic_PN29_CONTROLLER_0_S32K312_Tx
      PDUR_ROUTING_CAN0_Tx_0x360_E2E_P01_CONTROLLER_0_S32K312_Tx (PduRRoutingPath):
        PduRRouteType = IF
        PduRDestPduRRef = PduRDestPdu_CAN0_Tx_0x360_E2E_P01_CONTROLLER_0_S32K312_Tx
        PduRSrcPduRRef = PduRSrcPdu_CAN0_Tx_0x360_E2E_P01_CONTROLLER_0_S32K312_Tx
      PduRSrcPdu_CAN0_Tx_0x360_E2E_P01_CONTROLLER_0_S32K312_Tx (PduRSrcPdu): PduRSourcePduHandleId=12, PduRSrcPduUpTxConf=true, PduRSrcPduRef=COM_CAN0_Tx_0x360_E2E_P01_CONTROLLER_0_S32K312_Tx
      PduRDestPdu_CAN0_Tx_0x360_E2E_P01_CONTROLLER_0_S32K312_Tx (PduRDestPdu):
        PduRDestPduDataProvision = PDUR_DIRECT
        PduRDestPduHandleId = 12
        PduRTransmissionConfirmation = true
        PduRDestPduRef = CANIF_CAN0_Tx_0x360_E2E_P01_CONTROLLER_0_S32K312_Tx
      PDUR_ROUTING_CAN0_Rx_0x200_Cyclic_CONTROLLER_0_S32K312_Rx (PduRRoutingPath):
        PduRRouteType = IF
        PduRDestPduRRef = PduRDestPdu_CAN0_Rx_0x200_Cyclic_CONTROLLER_0_S32K312_Rx
        PduRSrcPduRRef = PduRSrcPdu_CAN0_Rx_0x200_Cyclic_CONTROLLER_0_S32K312_Rx
      PduRSrcPdu_CAN0_Rx_0x200_Cyclic_CONTROLLER_0_S32K312_Rx (PduRSrcPdu): PduRSourcePduHandleId=13, PduRSrcPduUpTxConf=true, PduRSrcPduRef=CANIF_CAN0_Rx_0x200_Cyclic_CONTROLLER_0_S32K312_Rx
      PduRDestPdu_CAN0_Rx_0x200_Cyclic_CONTROLLER_0_S32K312_Rx (PduRDestPdu):
        PduRDestPduDataProvision = PDUR_DIRECT
        PduRDestPduHandleId = 13
        PduRTransmissionConfirmation = true
        PduRDestPduRef = COM_CAN0_Rx_0x200_Cyclic_CONTROLLER_0_S32K312_Rx
      PDUR_ROUTING_CAN0_Rx_0x203_Cyclic_Counter_CONTROLLER_0_S32K312_Rx (PduRRoutingPath):
        PduRRouteType = IF
        PduRDestPduRRef = PduRDestPdu_CAN0_Rx_0x203_Cyclic_Counter_CONTROLLER_0_S32K312_Rx
        PduRSrcPduRRef = PduRSrcPdu_CAN0_Rx_0x203_Cyclic_Counter_CONTROLLER_0_S32K312_Rx
      PduRSrcPdu_CAN0_Rx_0x203_Cyclic_Counter_CONTROLLER_0_S32K312_Rx (PduRSrcPdu): PduRSourcePduHandleId=14, PduRSrcPduUpTxConf=true, PduRSrcPduRef=CANIF_CAN0_Rx_0x203_Cyclic_Counter_CONTROLLER_0_S32K312_Rx
      PduRDestPdu_CAN0_Rx_0x203_Cyclic_Counter_CONTROLLER_0_S32K312_Rx (PduRDestPdu):
        PduRDestPduDataProvision = PDUR_DIRECT
        PduRDestPduHandleId = 14
        PduRTransmissionConfirmation = true
        PduRDestPduRef = COM_CAN0_Rx_0x203_Cyclic_Counter_CONTROLLER_0_S32K312_Rx
      PDUR_ROUTING_CAN0_Rx_0x201_Event_CONTROLLER_0_S32K312_Rx (PduRRoutingPath):
        PduRRouteType = IF
        PduRDestPduRRef = PduRDestPdu_CAN0_Rx_0x201_Event_CONTROLLER_0_S32K312_Rx
        PduRSrcPduRRef = PduRSrcPdu_CAN0_Rx_0x201_Event_CONTROLLER_0_S32K312_Rx
      PduRSrcPdu_CAN0_Rx_0x201_Event_CONTROLLER_0_S32K312_Rx (PduRSrcPdu): PduRSourcePduHandleId=15, PduRSrcPduUpTxConf=true, PduRSrcPduRef=CANIF_CAN0_Rx_0x201_Event_CONTROLLER_0_S32K312_Rx
      PduRDestPdu_CAN0_Rx_0x201_Event_CONTROLLER_0_S32K312_Rx (PduRDestPdu):
        PduRDestPduDataProvision = PDUR_DIRECT
        PduRDestPduHandleId = 15
        PduRTransmissionConfirmation = true
        PduRDestPduRef = COM_CAN0_Rx_0x201_Event_CONTROLLER_0_S32K312_Rx
      PDUR_ROUTING_CAN0_Rx_0x250_Cyclic_PN17_CONTROLLER_0_S32K312_Rx (PduRRoutingPath):
        PduRRouteType = IF
        PduRDestPduRRef = PduRDestPdu_CAN0_Rx_0x250_Cyclic_PN17_CONTROLLER_0_S32K312_Rx
        PduRSrcPduRRef = PduRSrcPdu_CAN0_Rx_0x250_Cyclic_PN17_CONTROLLER_0_S32K312_Rx
      PduRSrcPdu_CAN0_Rx_0x250_Cyclic_PN17_CONTROLLER_0_S32K312_Rx (PduRSrcPdu): PduRSourcePduHandleId=16, PduRSrcPduUpTxConf=true, PduRSrcPduRef=CANIF_CAN0_Rx_0x250_Cyclic_PN17_CONTROLLER_0_S32K312_Rx
      PduRDestPdu_CAN0_Rx_0x250_Cyclic_PN17_CONTROLLER_0_S32K312_Rx (PduRDestPdu):
        PduRDestPduDataProvision = PDUR_DIRECT
        PduRDestPduHandleId = 16
        PduRTransmissionConfirmation = true
        PduRDestPduRef = COM_CAN0_Rx_0x250_Cyclic_PN17_CONTROLLER_0_S32K312_Rx
      PDUR_ROUTING_CAN0_Rx_0x202_Mixed_CONTROLLER_0_S32K312_Rx (PduRRoutingPath):
        PduRRouteType = IF
        PduRDestPduRRef = PduRDestPdu_CAN0_Rx_0x202_Mixed_CONTROLLER_0_S32K312_Rx
        PduRSrcPduRRef = PduRSrcPdu_CAN0_Rx_0x202_Mixed_CONTROLLER_0_S32K312_Rx
      PduRSrcPdu_CAN0_Rx_0x202_Mixed_CONTROLLER_0_S32K312_Rx (PduRSrcPdu): PduRSourcePduHandleId=17, PduRSrcPduUpTxConf=true, PduRSrcPduRef=CANIF_CAN0_Rx_0x202_Mixed_CONTROLLER_0_S32K312_Rx
      PduRDestPdu_CAN0_Rx_0x202_Mixed_CONTROLLER_0_S32K312_Rx (PduRDestPdu):
        PduRDestPduDataProvision = PDUR_DIRECT
        PduRDestPduHandleId = 17
        PduRTransmissionConfirmation = true
        PduRDestPduRef = COM_CAN0_Rx_0x202_Mixed_CONTROLLER_0_S32K312_Rx
    PduRBswModules_0 (PduRBswModules):
      PduRCancelReceive = false
      PduRCancelTransmit = false
      PduRCommunicationInterface = true
      PduRCopyRxData = false
      PduRCopyTxData = false
      PduRLowerModule = true
      PduRRetransmission = false
      PduRRxIndication = true
      PduRStartOfReception = false
      PduRTpRxIndication = false
      PduRTpTransmit = false
      PduRTpTxConfirmation = false
      PduRTransmit = true
      PduRTransportProtocol = false
      PduRTriggertransmit = true
      PduRTxConfirmation = true
      PduRUpperModule = false
      PduRBswModuleRef = CanIf
    PduRBswModules_1 (PduRBswModules):
      PduRCancelReceive = true
      PduRCancelTransmit = true
      PduRCommunicationInterface = true
      PduRCopyRxData = true
      PduRCopyTxData = true
      PduRLowerModule = false
      PduRRetransmission = false
      PduRRxIndication = true
      PduRStartOfReception = true
      PduRTpRxIndication = true
      PduRTpTransmit = false
      PduRTpTxConfirmation = true
      PduRTransmit = true
      PduRTransportProtocol = true
      PduRTriggertransmit = true
      PduRTxConfirmation = true
      PduRUpperModule = true
      PduRBswModuleRef = Com
