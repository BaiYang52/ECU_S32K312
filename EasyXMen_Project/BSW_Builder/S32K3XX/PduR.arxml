AUTOSAR XML (schema 00048)
package /S32K3XX
  module config PduR
    PduRGeneral: PduRConfigType=PC_CONFIG, PduRDevErrorDetect=false, PduRMetaDataSupport=false, PduRVersionInfoApi=false, PduRZeroCostOperation=false
    PduRRoutingPaths: PduRConfigurationId=0, PduRMaxRoutingPathCnt=20, PduRMaxRoutingPathGroupCnt=0, PduRMaxRoutingTableCnt=1
      PduRRoutingPath_0x110_Tx (PduRRoutingPath): PduRRouteType=IF, PduRDestPduRRef=PduRDestPdu_0x110_Tx, PduRSrcPduRRef=PduRSrcPdu_0x110_Tx
      PduRRoutingPath_0x12a_Rx (PduRRoutingPath): PduRRouteType=IF, PduRDestPduRRef=PduRDestPdu_0x12a_Rx, PduRSrcPduRRef=PduRSrcPdu_0x12a_Rx
      PduRDestPdu_0x110_Tx (PduRDestPdu): PduRDestPduDataProvision=PDUR_DIRECT, PduRDestPduHandleId=0, PduRTransmissionConfirmation=true, PduRDestPduRef=CanIf_0x110_Tx
      PduRDestPdu_0x12a_Rx (PduRDestPdu): PduRDestPduDataProvision=PDUR_DIRECT, PduRDestPduHandleId=1, PduRTransmissionConfirmation=true, PduRDestPduRef=Com_0x12a_Rx
      3 x PduRSrcPdu, all with PduRSrcPduUpTxConf=true:
        PduRSrcPdu_0x110_Tx: PduRSourcePduHandleId=0, PduRSrcPduRef=Com_0x110_Tx
        PduRSrcPdu_0x12a_Rx: PduRSourcePduHandleId=1, PduRSrcPduRef=CanIf_0x12a_Rx
        PduRSrcPdu_0x119_Routing_Rx: PduRSourcePduHandleId=2, PduRSrcPduRef=CanIf_0x119_Routing_Rx
      PduRRoutingPath_0x119_Routing_Rx_Tx (PduRRoutingPath): PduRRouteType=IF, PduRDestPduRRef=PduRDestPdu_0x119_Routing_Tx, PduRSrcPduRRef=PduRSrcPdu_0x119_Routing_Rx
      PduRDestPdu_0x119_Routing_Tx (PduRDestPdu): PduRDestPduDataProvision=PDUR_DIRECT, PduRDestPduHandleId=2, PduRTransmissionConfirmation=true, PduRDestPduRef=CanIf_0x119_Routing_Tx
      PduRSrcPdu_0x114_SignalRouting_Rx (PduRSrcPdu): PduRSourcePduHandleId=3, PduRSrcPduUpTxConf=true, PduRSrcPduRef=CanIf_0x114_Signal_Routing_Rx
      PduRSrcPdu_0x114_SignalRouting_Tx (PduRSrcPdu): PduRSourcePduHandleId=4, PduRSrcPduUpTxConf=true, PduRSrcPduRef=Com_0x114_Signal_Routing_Tx
      PduRDestPdu_0x114_SignalRouting_Rx (PduRDestPdu): PduRDestPduDataProvision=PDUR_DIRECT, PduRDestPduHandleId=3, PduRTransmissionConfirmation=true, PduRDestPduRef=Com_0x114_Signal_Routing_Rx
      PduRSrcPdu_0x115_SignalRouting_Tx (PduRSrcPdu): PduRSourcePduHandleId=5, PduRSrcPduUpTxConf=true, PduRSrcPduRef=Com_0x115_Signal_Routing_Tx
      PduRDestPdu_0x114_SignalRouting_Tx (PduRDestPdu): PduRDestPduDataProvision=PDUR_DIRECT, PduRDestPduHandleId=4, PduRTransmissionConfirmation=true, PduRDestPduRef=CanIf_0x114_Signal_Routing_Tx
      PduRDestPdu_0x115_SignalRouting_Tx (PduRDestPdu): PduRDestPduDataProvision=PDUR_DIRECT, PduRDestPduHandleId=5, PduRTransmissionConfirmation=true, PduRDestPduRef=CanIf_0x115_Signal_Routing_Tx
      3 x PduRRoutingPath, all with PduRRouteType=IF:
        PduRRoutingPath_0x114_SignalRouting_Rx: PduRDestPduRRef=PduRDestPdu_0x114_SignalRouting_Rx, PduRSrcPduRRef=PduRSrcPdu_0x114_SignalRouting_Rx
        PduRRoutingPath_0x114_SignalRouting_Tx: PduRDestPduRRef=PduRDestPdu_0x114_SignalRouting_Tx, PduRSrcPduRRef=PduRSrcPdu_0x114_SignalRouting_Tx
        PduRRoutingPath_0x115_SignalRouting_Tx: PduRDestPduRRef=PduRDestPdu_0x115_SignalRouting_Tx, PduRSrcPduRRef=PduRSrcPdu_0x115_SignalRouting_Tx
    PduRBswModules_0 (PduRBswModules):
      PduRCancelReceive = false
      PduRCancelTransmit = false
      PduRCommunicationInterface = true
      PduRCopyRxData = false
      PduRCopyTxData = false
      PduRLowerModule = true
      PduRRetransmission = false
      PduRRxIndication = true
      PduRStartOfReception = false
      PduRTpRxIndication = false
      PduRTpTransmit = false
      PduRTpTxConfirmation = false
      PduRTransmit = true
      PduRTransportProtocol = false
      PduRTriggertransmit = true
      PduRTxConfirmation = true
      PduRUpperModule = false
      PduRBswModuleRef = CanIf
    PduRBswModules_1 (PduRBswModules):
      PduRCancelReceive = true
      PduRCancelTransmit = true
      PduRCommunicationInterface = true
      PduRCopyRxData = true
      PduRCopyTxData = true
      PduRLowerModule = false
      PduRRetransmission = false
      PduRRxIndication = true
      PduRStartOfReception = true
      PduRTpRxIndication = true
      PduRTpTransmit = false
      PduRTpTxConfirmation = true
      PduRTransmit = true
      PduRTransportProtocol = true
      PduRTriggertransmit = true
      PduRTxConfirmation = true
      PduRUpperModule = true
      PduRBswModuleRef = Com
