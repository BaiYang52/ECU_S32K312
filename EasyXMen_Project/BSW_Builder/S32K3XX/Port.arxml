AUTOSAR XML (schema 00048)
package /S32K3XX
  module config Port: implementation-config-variant=VARIANT-POST-BUILD
    CommonPublishedInformation:
      ArReleaseMajorVersion = 4
      ArReleaseMinorVersion = 7
      ArReleaseRevisionVersion = 0
      ModuleId = 124
      SwMajorVersion = 4
      SwMinorVersion = 0
      SwPatchVersion = 0
      VendorId = 43
    PortConfigSet
      NotUsedPortPin: PortPinDirection=PORT_PIN_IN, PortPinLevelValue=PORT_PIN_LEVEL_LOW, PortPinPue=0, PortPinPus=0
      PortContainer_0 (PortContainer): PortNumberOfPortPins=5
        5 x PortPin, all with ImcrPdacSlot=VIRTUAL_WRAPPER_PDAC0, MscrPdacSlot=VIRTUAL_WRAPPER_PDAC0, OBEGroupSelect=NO_OBE_GROUP, PortPinDirectionChangeable=1, PortPinDse=0, PortPinIfe=0, PortPinInitialMode=PORT_GPIO_MODE, PortPinInvertControl=0, PortPinLevelValue=PORT_PIN_LEVEL_LOW, PortPinModeChangeable=1, PortPinPke=0, PortPinPue=0, PortPinPus=0, PortPinSafeMode=0, PortPinSiul2Instance=SIUL2_0, PortPinSlewRate=SLEW_RATE_NOT_AVAILABLE, PortPinWithReadBack=0:
          PortPin_B10: index=0, PortPinDirection=PORT_PIN_OUT, PortPinId=1, PortPinMode=GPIO, PortPinPcr=42
          PortPin_A7_CANTX: index=1, PortPinDirection=PORT_PIN_OUT, PortPinId=2, PortPinMode=CAN0_CAN0_TX_OUT, PortPinPcr=7
          PortPin_A6_CANRX: index=2, PortPinDirection=PORT_PIN_IN, PortPinId=3, PortPinMode=CAN0_CAN0_RX_IN, PortPinPcr=6
          PortPin_C8_CANTX: index=3, PortPinDirection=PORT_PIN_OUT, PortPinId=4, PortPinMode=CAN1_CAN1_TX_OUT, PortPinPcr=72
          PortPin_C9_CANRX: index=4, PortPinDirection=PORT_PIN_IN, PortPinId=5, PortPinMode=CAN1_CAN1_RX_IN, PortPinPcr=73
      4 x UnTouchedPortPin, all with PortPinSiul2Instance=SIUL2_0:
        JTAGC_TCK: PortPinPcr=68
        JTAGC_TDI: PortPinPcr=4
        JTAGC_TDO: PortPinPcr=10
        JTAGC_TMS: PortPinPcr=69
    PortGeneral:
      PortCodeSizeOptimization = 0
      PortDevErrorDetect = 0
      PortEnableUserModeSupport = 0
      PortMulticoreSupport = 0
      PortResetPinModeApi = 0
      PortSetAsUnusedPinApi = 0
      PortSetPinDirectionApi = 1
      PortSetPinModeApi = 1
      PortSetPinModeDoesNotTouchGpioLevel = 0
      PortTspcSupport = 0
      PortVersionInfoApi = 1
      SIUL2PortIPDevErrorDetect = 0
      SignalInversionConfigEnable = 0
      VirtWrapperSupport = 0
