AUTOSAR XML (schema 00048)
package /S32K3XX
  ecuc value collection S32K3XX: ecuc-values=[Can, Port, Gpt, Dio, Mcu, CanIf, Com, CanSM, BswM, EcuC, PduR, ComM, EcuM, iRte]
