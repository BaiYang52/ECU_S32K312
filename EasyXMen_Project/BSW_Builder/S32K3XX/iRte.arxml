AUTOSAR XML (schema 00048)
package /S32K3XX
  module config iRte
    RteOsInteraction
